/begin MEASUREMENT dataJ1939Dm1Failrs_as[69].dtc_as[20].spn_u32 "" ULONG CnvRule_NumberOneToOne 1 0 0 4294967295 ECU_ADDRESS 0x70017BA8 /end MEASUREMENT
/begin MEASUREMENT dataJ1939Dm1Failrs_as[69].dtc_as[20].fmi_u8 "" UBYTE CnvRule_NumberOneToOne 1 0 0 255 ECU_ADDRESS 0x70017BAC /end MEASUREMENT
/begin MEASUREMENT dataJ1939Dm1Failrs_as[69].dtc_as[20].occ_u8 "" UBYTE CnvRule_NumberOneToOne 1 0 0 255 ECU_ADDRESS 0x70017BAD /end MEASUREMENT
/begin MEASUREMENT dataJ1939Dm1Failrs_as[69].dtc_as "" UBYTE CnvRule_NumberOneToOne 1 0 0 255 ECU_ADDRESS 0x70017B10 ARRAY_SIZE 160 /end MEASUREMENT
/begin MEASUREMENT dataJ1939Dm1Failrs_as[70].dtc_as[1].spn_u32 "" ULONG CnvRule_NumberOneToOne 1 0 0 4294967295 ECU_ADDRESS 0x70017BB4 /end MEASUREMENT
/begin MEASUREMENT dataJ1939Dm1Failrs_as[70].dtc_as[1].fmi_u8 "" UBYTE CnvRule_NumberOneToOne 1 0 0 255 ECU_ADDRESS 0x70017BB8 /end MEASUREMENT
/begin MEASUREMENT dataJ1939Dm1Failrs_as[70].dtc_as[1].occ_u8 "" UBYTE CnvRule_NumberOneToOne 1 0 0 255 ECU_ADDRESS 0x70017BB9 /end MEASUREMENT
/begin MEASUREMENT dataJ1939Dm1Failrs_as[70].dtc_as[2].spn_u32 "" ULONG CnvRule_NumberOneToOne 1 0 0 4294967295 ECU_ADDRESS 0x70017BBC /end MEASUREMENT
/begin MEASUREMENT dataJ1939Dm1Failrs_as[70].dtc_as[2].fmi_u8 "" UBYTE CnvRule_NumberOneToOne 1 0 0 255 ECU_ADDRESS 0x70017BC0 /end MEASUREMENT
/begin MEASUREMENT dataJ1939Dm1Failrs_as[70].dtc_as[2].occ_u8 "" UBYTE CnvRule_NumberOneToOne 1 0 0 255 ECU_ADDRESS 0x70017BC1 /end MEASUREMENT
/begin MEASUREMENT dataJ1939Dm1Failrs_as[70].dtc_as[3].spn_u32 "" ULONG CnvRule_NumberOneToOne 1 0 0 4294967295 ECU_ADDRESS 0x70017BC4 /end MEASUREMENT
/begin MEASUREMENT dataJ1939Dm1Failrs_as[70].dtc_as[3].fmi_u8 "" UBYTE CnvRule_NumberOneToOne 1 0 0 255 ECU_ADDRESS 0x70017BC8 /end MEASUREMENT
/begin MEASUREMENT dataJ1939Dm1Failrs_as[70].dtc_as[3].occ_u8 "" UBYTE CnvRule_NumberOneToOne 1 0 0 255 ECU_ADDRESS 0x70017BC9 /end MEASUREMENT
/begin MEASUREMENT dataJ1939Dm1Failrs_as[70].dtc_as[4].spn_u32 "" ULONG CnvRule_NumberOneToOne 1 0 0 4294967295 ECU_ADDRESS 0x70017BCC /end MEASUREMENT
/begin MEASUREMENT dataJ1939Dm1Failrs_as[70].dtc_as[4].fmi_u8 "" UBYTE CnvRule_NumberOneToOne 1 0 0 255 ECU_ADDRESS 0x70017BD0 /end MEASUREMENT
/begin MEASUREMENT dataJ1939Dm1Failrs_as[70].dtc_as[4].occ_u8 "" UBYTE CnvRule_NumberOneToOne 1 0 0 255 ECU_ADDRESS 0x70017BD1 /end MEASUREMENT
/begin MEASUREMENT dataJ1939Dm1Failrs_as[70].dtc_as[5].spn_u32 "" ULONG CnvRule_NumberOneToOne 1 0 0 4294967295 ECU_ADDRESS 0x70017BD4 /end MEASUREMENT
/begin MEASUREMENT dataJ1939Dm1Failrs_as[70].dtc_as[5].fmi_u8 "" UBYTE CnvRule_NumberOneToOne 1 0 0 255 ECU_ADDRESS 0x70017BD8 /end MEASUREMENT
/begin MEASUREMENT dataJ1939Dm1Failrs_as[70].dtc_as[5].occ_u8 "" UBYTE CnvRule_NumberOneToOne 1 0 0 255 ECU_ADDRESS 0x70017BD9 /end MEASUREMENT
/begin MEASUREMENT dataJ1939Dm1Failrs_as[70].dtc_as[6].spn_u32 "" ULONG CnvRule_NumberOneToOne 1 0 0 4294967295 ECU_ADDRESS 0x70017BDC /end MEASUREMENT
/begin MEASUREMENT dataJ1939Dm1Failrs_as[70].dtc_as[6].fmi_u8 "" UBYTE CnvRule_NumberOneToOne 1 0 0 255 ECU_ADDRESS 0x70017BE0 /end MEASUREMENT
/begin MEASUREMENT dataJ1939Dm1Failrs_as[70].dtc_as[6].occ_u8 "" UBYTE CnvRule_NumberOneToOne 1 0 0 255 ECU_ADDRESS 0x70017BE1 /end MEASUREMENT
/begin MEASUREMENT dataJ1939Dm1Failrs_as[70].dtc_as[7].spn_u32 "" ULONG CnvRule_NumberOneToOne 1 0 0 4294967295 ECU_ADDRESS 0x70017BE4 /end MEASUREMENT
/begin MEASUREMENT dataJ1939Dm1Failrs_as[70].dtc_as[7].fmi_u8 "" UBYTE CnvRule_NumberOneToOne 1 0 0 255 ECU_ADDRESS 0x70017BE8 /end MEASUREMENT
/begin MEASUREMENT dataJ1939Dm1Failrs_as[70].dtc_as[7].occ_u8 "" UBYTE CnvRule_NumberOneToOne 1 0 0 255 ECU_ADDRESS 0x70017BE9 /end MEASUREMENT
/begin MEASUREMENT dataJ1939Dm1Failrs_as[70].dtc_as[8].spn_u32 "" ULONG CnvRule_NumberOneToOne 1 0 0 4294967295 ECU_ADDRESS 0x70017BEC /end MEASUREMENT
/begin MEASUREMENT dataJ1939Dm1Failrs_as[70].dtc_as[8].fmi_u8 "" UBYTE CnvRule_NumberOneToOne 1 0 0 255 ECU_ADDRESS 0x70017BF0 /end MEASUREMENT
/begin MEASUREMENT dataJ1939Dm1Failrs_as[70].dtc_as[8].occ_u8 "" UBYTE CnvRule_NumberOneToOne 1 0 0 255 ECU_ADDRESS 0x70017BF1 /end MEASUREMENT
/begin MEASUREMENT dataJ1939Dm1Failrs_as[70].dtc_as[9].spn_u32 "" ULONG CnvRule_NumberOneToOne 1 0 0 4294967295 ECU_ADDRESS 0x70017BF4 /end MEASUREMENT
/begin MEASUREMENT dataJ1939Dm1Failrs_as[70].dtc_as[9].fmi_u8 "" UBYTE CnvRule_NumberOneToOne 1 0 0 255 ECU_ADDRESS 0x70017BF8 /end MEASUREMENT
/begin MEASUREMENT dataJ1939Dm1Failrs_as[70].dtc_as[9].occ_u8 "" UBYTE CnvRule_NumberOneToOne 1 0 0 255 ECU_ADDRESS 0x70017BF9 /end MEASUREMENT
/begin MEASUREMENT dataJ1939Dm1Failrs_as[70].dtc_as[10].spn_u32 "" ULONG CnvRule_NumberOneToOne 1 0 0 4294967295 ECU_ADDRESS 0x70017BFC /end MEASUREMENT
/begin MEASUREMENT dataJ1939Dm1Failrs_as[70].dtc_as[10].fmi_u8 "" UBYTE CnvRule_NumberOneToOne 1 0 0 255 ECU_ADDRESS 0x70017C00 /end MEASUREMENT
/begin MEASUREMENT dataJ1939Dm1Failrs_as[70].dtc_as[10].occ_u8 "" UBYTE CnvRule_NumberOneToOne 1 0 0 255 ECU_ADDRESS 0x70017C01 /end MEASUREMENT
/begin MEASUREMENT dataJ1939Dm1Failrs_as[70].dtc_as[11].spn_u32 "" ULONG CnvRule_NumberOneToOne 1 0 0 4294967295 ECU_ADDRESS 0x70017C04 /end MEASUREMENT
/begin MEASUREMENT dataJ1939Dm1Failrs_as[70].dtc_as[11].fmi_u8 "" UBYTE CnvRule_NumberOneToOne 1 0 0 255 ECU_ADDRESS 0x70017C08 /end MEASUREMENT
/begin MEASUREMENT dataJ1939Dm1Failrs_as[70].dtc_as[11].occ_u8 "" UBYTE CnvRule_NumberOneToOne 1 0 0 255 ECU_ADDRESS 0x70017C09 /end MEASUREMENT
/begin MEASUREMENT dataJ1939Dm1Failrs_as[70].dtc_as[12].spn_u32 "" ULONG CnvRule_NumberOneToOne 1 0 0 4294967295 ECU_ADDRESS 0x70017C0C /end MEASUREMENT
/begin MEASUREMENT dataJ1939Dm1Failrs_as[70].dtc_as[12].fmi_u8 "" UBYTE CnvRule_NumberOneToOne 1 0 0 255 ECU_ADDRESS 0x70017C10 /end MEASUREMENT
/begin MEASUREMENT dataJ1939Dm1Failrs_as[70].dtc_as[12].occ_u8 "" UBYTE CnvRule_NumberOneToOne 1 0 0 255 ECU_ADDRESS 0x70017C11 /end MEASUREMENT
/begin MEASUREMENT dataJ1939Dm1Failrs_as[70].dtc_as[13].spn_u32 "" ULONG CnvRule_NumberOneToOne 1 0 0 4294967295 ECU_ADDRESS 0x70017C14 /end MEASUREMENT
/begin MEASUREMENT dataJ1939Dm1Failrs_as[70].dtc_as[13].fmi_u8 "" UBYTE CnvRule_NumberOneToOne 1 0 0 255 ECU_ADDRESS 0x70017C18 /end MEASUREMENT
/begin MEASUREMENT dataJ1939Dm1Failrs_as[70].dtc_as[13].occ_u8 "" UBYTE CnvRule_NumberOneToOne 1 0 0 255 ECU_ADDRESS 0x70017C19 /end MEASUREMENT
/begin MEASUREMENT dataJ1939Dm1Failrs_as[70].dtc_as[14].spn_u32 "" ULONG CnvRule_NumberOneToOne 1 0 0 4294967295 ECU_ADDRESS 0x70017C1C /end MEASUREMENT
/begin MEASUREMENT dataJ1939Dm1Failrs_as[70].dtc_as[14].fmi_u8 "" UBYTE CnvRule_NumberOneToOne 1 0 0 255 ECU_ADDRESS 0x70017C20 /end MEASUREMENT
/begin MEASUREMENT dataJ1939Dm1Failrs_as[70].dtc_as[14].occ_u8 "" UBYTE CnvRule_NumberOneToOne 1 0 0 255 ECU_ADDRESS 0x70017C21 /end MEASUREMENT
/begin MEASUREMENT dataJ1939Dm1Failrs_as[70].dtc_as[15].spn_u32 "" ULONG CnvRule_NumberOneToOne 1 0 0 4294967295 ECU_ADDRESS 0x70017C24 /end MEASUREMENT
/begin MEASUREMENT dataJ1939Dm1Failrs_as[70].dtc_as[15].fmi_u8 "" UBYTE CnvRule_NumberOneToOne 1 0 0 255 ECU_ADDRESS 0x70017C28 /end MEASUREMENT
/begin MEASUREMENT dataJ1939Dm1Failrs_as[70].dtc_as[15].occ_u8 "" UBYTE CnvRule_NumberOneToOne 1 0 0 255 ECU_ADDRESS 0x70017C29 /end MEASUREMENT
/begin MEASUREMENT dataJ1939Dm1Failrs_as[70].dtc_as[16].spn_u32 "" ULONG CnvRule_NumberOneToOne 1 0 0 4294967295 ECU_ADDRESS 0x70017C2C /end MEASUREMENT
/begin MEASUREMENT dataJ1939Dm1Failrs_as[70].dtc_as[16].fmi_u8 "" UBYTE CnvRule_NumberOneToOne 1 0 0 255 ECU_ADDRESS 0x70017C30 /end MEASUREMENT
/begin MEASUREMENT dataJ1939Dm1Failrs_as[70].dtc_as[16].occ_u8 "" UBYTE CnvRule_NumberOneToOne 1 0 0 255 ECU_ADDRESS 0x70017C31 /end MEASUREMENT
/begin MEASUREMENT dataJ1939Dm1Failrs_as[70].dtc_as[17].spn_u32 "" ULONG CnvRule_NumberOneToOne 1 0 0 4294967295 ECU_ADDRESS 0x70017C34 /end MEASUREMENT
/begin MEASUREMENT dataJ1939Dm1Failrs_as[70].dtc_as[17].fmi_u8 "" UBYTE CnvRule_NumberOneToOne 1 0 0 255 ECU_ADDRESS 0x70017C38 /end MEASUREMENT
/begin MEASUREMENT dataJ1939Dm1Failrs_as[70].dtc_as[17].occ_u8 "" UBYTE CnvRule_NumberOneToOne 1 0 0 255 ECU_ADDRESS 0x70017C39 /end MEASUREMENT
/begin MEASUREMENT dataJ1939Dm1Failrs_as[70].dtc_as[18].spn_u32 "" ULONG CnvRule_NumberOneToOne 1 0 0 4294967295 ECU_ADDRESS 0x70017C3C /end MEASUREMENT
/begin MEASUREMENT dataJ1939Dm1Failrs_as[70].dtc_as[18].fmi_u8 "" UBYTE CnvRule_NumberOneToOne 1 0 0 255 ECU_ADDRESS 0x70017C40 /end MEASUREMENT
/begin MEASUREMENT dataJ1939Dm1Failrs_as[70].dtc_as[18].occ_u8 "" UBYTE CnvRule_NumberOneToOne 1 0 0 255 ECU_ADDRESS 0x70017C41 /end MEASUREMENT
/begin MEASUREMENT dataJ1939Dm1Failrs_as[70].dtc_as[19].spn_u32 "" ULONG CnvRule_NumberOneToOne 1 0 0 4294967295 ECU_ADDRESS 0x70017C44 /end MEASUREMENT
/begin MEASUREMENT dataJ1939Dm1Failrs_as[70].dtc_as[19].fmi_u8 "" UBYTE CnvRule_NumberOneToOne 1 0 0 255 ECU_ADDRESS 0x70017C48 /end MEASUREMENT
/begin MEASUREMENT dataJ1939Dm1Failrs_as[70].dtc_as[19].occ_u8 "" UBYTE CnvRule_NumberOneToOne 1 0 0 255 ECU_ADDRESS 0x70017C49 /end MEASUREMENT
/begin MEASUREMENT dataJ1939Dm1Failrs_as[70].dtc_as[20].spn_u32 "" ULONG CnvRule_NumberOneToOne 1 0 0 4294967295 ECU_ADDRESS 0x70017C4C /end MEASUREMENT
/begin MEASUREMENT dataJ1939Dm1Failrs_as[70].dtc_as[20].fmi_u8 "" UBYTE CnvRule_NumberOneToOne 1 0 0 255 ECU_ADDRESS 0x70017C50 /end MEASUREMENT
/begin MEASUREMENT dataJ1939Dm1Failrs_as[70].dtc_as[20].occ_u8 "" UBYTE CnvRule_NumberOneToOne 1 0 0 255 ECU_ADDRESS 0x70017C51 /end MEASUREMENT
/begin MEASUREMENT dataJ1939Dm1Failrs_as[70].dtc_as "" UBYTE CnvRule_NumberOneToOne 1 0 0 255 ECU_ADDRESS 0x70017BB4 ARRAY_SIZE 160 /end MEASUREMENT
/begin MEASUREMENT dataJ1939Dm1Failrs_as[71].dtc_as[1].spn_u32 "" ULONG CnvRule_NumberOneToOne 1 0 0 4294967295 ECU_ADDRESS 0x70017C58 /end MEASUREMENT
/begin MEASUREMENT dataJ1939Dm1Failrs_as[71].dtc_as[1].fmi_u8 "" UBYTE CnvRule_NumberOneToOne 1 0 0 255 ECU_ADDRESS 0x70017C5C /end MEASUREMENT
/begin MEASUREMENT dataJ1939Dm1Failrs_as[71].dtc_as[1].occ_u8 "" UBYTE CnvRule_NumberOneToOne 1 0 0 255 ECU_ADDRESS 0x70017C5D /end MEASUREMENT
/begin MEASUREMENT dataJ1939Dm1Failrs_as[71].dtc_as[2].spn_u32 "" ULONG CnvRule_NumberOneToOne 1 0 0 4294967295 ECU_ADDRESS 0x70017C60 /end MEASUREMENT
/begin MEASUREMENT dataJ1939Dm1Failrs_as[71].dtc_as[2].fmi_u8 "" UBYTE CnvRule_NumberOneToOne 1 0 0 255 ECU_ADDRESS 0x70017C64 /end MEASUREMENT
/begin MEASUREMENT dataJ1939Dm1Failrs_as[71].dtc_as[2].occ_u8 "" UBYTE CnvRule_NumberOneToOne 1 0 0 255 ECU_ADDRESS 0x70017C65 /end MEASUREMENT
/begin MEASUREMENT dataJ1939Dm1Failrs_as[71].dtc_as[3].spn_u32 "" ULONG CnvRule_NumberOneToOne 1 0 0 4294967295 ECU_ADDRESS 0x70017C68 /end MEASUREMENT
/begin MEASUREMENT dataJ1939Dm1Failrs_as[71].dtc_as[3].fmi_u8 "" UBYTE CnvRule_NumberOneToOne 1 0 0 255 ECU_ADDRESS 0x70017C6C /end MEASUREMENT
/begin MEASUREMENT dataJ1939Dm1Failrs_as[71].dtc_as[3].occ_u8 "" UBYTE CnvRule_NumberOneToOne 1 0 0 255 ECU_ADDRESS 0x70017C6D /end MEASUREMENT
/begin MEASUREMENT dataJ1939Dm1Failrs_as[71].dtc_as[4].spn_u32 "" ULONG CnvRule_NumberOneToOne 1 0 0 4294967295 ECU_ADDRESS 0x70017C70 /end MEASUREMENT
/begin MEASUREMENT dataJ1939Dm1Failrs_as[71].dtc_as[4].fmi_u8 "" UBYTE CnvRule_NumberOneToOne 1 0 0 255 ECU_ADDRESS 0x70017C74 /end MEASUREMENT
/begin MEASUREMENT dataJ1939Dm1Failrs_as[71].dtc_as[4].occ_u8 "" UBYTE CnvRule_NumberOneToOne 1 0 0 255 ECU_ADDRESS 0x70017C75 /end MEASUREMENT
/begin MEASUREMENT dataJ1939Dm1Failrs_as[71].dtc_as[5].spn_u32 "" ULONG CnvRule_NumberOneToOne 1 0 0 4294967295 ECU_ADDRESS 0x70017C78 /end MEASUREMENT
/begin MEASUREMENT dataJ1939Dm1Failrs_as[71].dtc_as[5].fmi_u8 "" UBYTE CnvRule_NumberOneToOne 1 0 0 255 ECU_ADDRESS 0x70017C7C /end MEASUREMENT
/begin MEASUREMENT dataJ1939Dm1Failrs_as[71].dtc_as[5].occ_u8 "" UBYTE CnvRule_NumberOneToOne 1 0 0 255 ECU_ADDRESS 0x70017C7D /end MEASUREMENT
/begin MEASUREMENT dataJ1939Dm1Failrs_as[71].dtc_as[6].spn_u32 "" ULONG CnvRule_NumberOneToOne 1 0 0 4294967295 ECU_ADDRESS 0x70017C80 /end MEASUREMENT
/begin MEASUREMENT dataJ1939Dm1Failrs_as[71].dtc_as[6].fmi_u8 "" UBYTE CnvRule_NumberOneToOne 1 0 0 255 ECU_ADDRESS 0x70017C84 /end MEASUREMENT
/begin MEASUREMENT dataJ1939Dm1Failrs_as[71].dtc_as[6].occ_u8 "" UBYTE CnvRule_NumberOneToOne 1 0 0 255 ECU_ADDRESS 0x70017C85 /end MEASUREMENT
/begin MEASUREMENT dataJ1939Dm1Failrs_as[71].dtc_as[7].spn_u32 "" ULONG CnvRule_NumberOneToOne 1 0 0 4294967295 ECU_ADDRESS 0x70017C88 /end MEASUREMENT
/begin MEASUREMENT dataJ1939Dm1Failrs_as[71].dtc_as[7].fmi_u8 "" UBYTE CnvRule_NumberOneToOne 1 0 0 255 ECU_ADDRESS 0x70017C8C /end MEASUREMENT
/begin MEASUREMENT dataJ1939Dm1Failrs_as[71].dtc_as[7].occ_u8 "" UBYTE CnvRule_NumberOneToOne 1 0 0 255 ECU_ADDRESS 0x70017C8D /end MEASUREMENT
/begin MEASUREMENT dataJ1939Dm1Failrs_as[71].dtc_as[8].spn_u32 "" ULONG CnvRule_NumberOneToOne 1 0 0 4294967295 ECU_ADDRESS 0x70017C90 /end MEASUREMENT
/begin MEASUREMENT dataJ1939Dm1Failrs_as[71].dtc_as[8].fmi_u8 "" UBYTE CnvRule_NumberOneToOne 1 0 0 255 ECU_ADDRESS 0x70017C94 /end MEASUREMENT
/begin MEASUREMENT dataJ1939Dm1Failrs_as[71].dtc_as[8].occ_u8 "" UBYTE CnvRule_NumberOneToOne 1 0 0 255 ECU_ADDRESS 0x70017C95 /end MEASUREMENT
/begin MEASUREMENT dataJ1939Dm1Failrs_as[71].dtc_as[9].spn_u32 "" ULONG CnvRule_NumberOneToOne 1 0 0 4294967295 ECU_ADDRESS 0x70017C98 /end MEASUREMENT
/begin MEASUREMENT dataJ1939Dm1Failrs_as[71].dtc_as[9].fmi_u8 "" UBYTE CnvRule_NumberOneToOne 1 0 0 255 ECU_ADDRESS 0x70017C9C /end MEASUREMENT
/begin MEASUREMENT dataJ1939Dm1Failrs_as[71].dtc_as[9].occ_u8 "" UBYTE CnvRule_NumberOneToOne 1 0 0 255 ECU_ADDRESS 0x70017C9D /end MEASUREMENT
/begin MEASUREMENT dataJ1939Dm1Failrs_as[71].dtc_as[10].spn_u32 "" ULONG CnvRule_NumberOneToOne 1 0 0 4294967295 ECU_ADDRESS 0x70017CA0 /end MEASUREMENT
/begin MEASUREMENT dataJ1939Dm1Failrs_as[71].dtc_as[10].fmi_u8 "" UBYTE CnvRule_NumberOneToOne 1 0 0 255 ECU_ADDRESS 0x70017CA4 /end MEASUREMENT
/begin MEASUREMENT dataJ1939Dm1Failrs_as[71].dtc_as[10].occ_u8 "" UBYTE CnvRule_NumberOneToOne 1 0 0 255 ECU_ADDRESS 0x70017CA5 /end MEASUREMENT
/begin MEASUREMENT dataJ1939Dm1Failrs_as[71].dtc_as[11].spn_u32 "" ULONG CnvRule_NumberOneToOne 1 0 0 4294967295 ECU_ADDRESS 0x70017CA8 /end MEASUREMENT
/begin MEASUREMENT dataJ1939Dm1Failrs_as[71].dtc_as[11].fmi_u8 "" UBYTE CnvRule_NumberOneToOne 1 0 0 255 ECU_ADDRESS 0x70017CAC /end MEASUREMENT
/begin MEASUREMENT dataJ1939Dm1Failrs_as[71].dtc_as[11].occ_u8 "" UBYTE CnvRule_NumberOneToOne 1 0 0 255 ECU_ADDRESS 0x70017CAD /end MEASUREMENT
/begin MEASUREMENT dataJ1939Dm1Failrs_as[71].dtc_as[12].spn_u32 "" ULONG CnvRule_NumberOneToOne 1 0 0 4294967295 ECU_ADDRESS 0x70017CB0 /end MEASUREMENT
/begin MEASUREMENT dataJ1939Dm1Failrs_as[71].dtc_as[12].fmi_u8 "" UBYTE CnvRule_NumberOneToOne 1 0 0 255 ECU_ADDRESS 0x70017CB4 /end MEASUREMENT
/begin MEASUREMENT dataJ1939Dm1Failrs_as[71].dtc_as[12].occ_u8 "" UBYTE CnvRule_NumberOneToOne 1 0 0 255 ECU_ADDRESS 0x70017CB5 /end MEASUREMENT
/begin MEASUREMENT dataJ1939Dm1Failrs_as[71].dtc_as[13].spn_u32 "" ULONG CnvRule_NumberOneToOne 1 0 0 4294967295 ECU_ADDRESS 0x70017CB8 /end MEASUREMENT
/begin MEASUREMENT dataJ1939Dm1Failrs_as[71].dtc_as[13].fmi_u8 "" UBYTE CnvRule_NumberOneToOne 1 0 0 255 ECU_ADDRESS 0x70017CBC /end MEASUREMENT
/begin MEASUREMENT dataJ1939Dm1Failrs_as[71].dtc_as[13].occ_u8 "" UBYTE CnvRule_NumberOneToOne 1 0 0 255 ECU_ADDRESS 0x70017CBD /end MEASUREMENT
/begin MEASUREMENT dataJ1939Dm1Failrs_as[71].dtc_as[14].spn_u32 "" ULONG CnvRule_NumberOneToOne 1 0 0 4294967295 ECU_ADDRESS 0x70017CC0 /end MEASUREMENT
/begin MEASUREMENT dataJ1939Dm1Failrs_as[71].dtc_as[14].fmi_u8 "" UBYTE CnvRule_NumberOneToOne 1 0 0 255 ECU_ADDRESS 0x70017CC4 /end MEASUREMENT
/begin MEASUREMENT dataJ1939Dm1Failrs_as[71].dtc_as[14].occ_u8 "" UBYTE CnvRule_NumberOneToOne 1 0 0 255 ECU_ADDRESS 0x70017CC5 /end MEASUREMENT
/begin MEASUREMENT dataJ1939Dm1Failrs_as[71].dtc_as[15].spn_u32 "" ULONG CnvRule_NumberOneToOne 1 0 0 4294967295 ECU_ADDRESS 0x70017CC8 /end MEASUREMENT
/begin MEASUREMENT dataJ1939Dm1Failrs_as[71].dtc_as[15].fmi_u8 "" UBYTE CnvRule_NumberOneToOne 1 0 0 255 ECU_ADDRESS 0x70017CCC /end MEASUREMENT
/begin MEASUREMENT dataJ1939Dm1Failrs_as[71].dtc_as[15].occ_u8 "" UBYTE CnvRule_NumberOneToOne 1 0 0 255 ECU_ADDRESS 0x70017CCD /end MEASUREMENT
/begin MEASUREMENT dataJ1939Dm1Failrs_as[71].dtc_as[16].spn_u32 "" ULONG CnvRule_NumberOneToOne 1 0 0 4294967295 ECU_ADDRESS 0x70017CD0 /end MEASUREMENT
/begin MEASUREMENT dataJ1939Dm1Failrs_as[71].dtc_as[16].fmi_u8 "" UBYTE CnvRule_NumberOneToOne 1 0 0 255 ECU_ADDRESS 0x70017CD4 /end MEASUREMENT
/begin MEASUREMENT dataJ1939Dm1Failrs_as[71].dtc_as[16].occ_u8 "" UBYTE CnvRule_NumberOneToOne 1 0 0 255 ECU_ADDRESS 0x70017CD5 /end MEASUREMENT
/begin MEASUREMENT dataJ1939Dm1Failrs_as[71].dtc_as[17].spn_u32 "" ULONG CnvRule_NumberOneToOne 1 0 0 4294967295 ECU_ADDRESS 0x70017CD8 /end MEASUREMENT
/begin MEASUREMENT dataJ1939Dm1Failrs_as[71].dtc_as[17].fmi_u8 "" UBYTE CnvRule_NumberOneToOne 1 0 0 255 ECU_ADDRESS 0x70017CDC /end MEASUREMENT
/begin MEASUREMENT dataJ1939Dm1Failrs_as[71].dtc_as[17].occ_u8 "" UBYTE CnvRule_NumberOneToOne 1 0 0 255 ECU_ADDRESS 0x70017CDD /end MEASUREMENT
/begin MEASUREMENT dataJ1939Dm1Failrs_as[71].dtc_as[18].spn_u32 "" ULONG CnvRule_NumberOneToOne 1 0 0 4294967295 ECU_ADDRESS 0x70017CE0 /end MEASUREMENT
/begin MEASUREMENT dataJ1939Dm1Failrs_as[71].dtc_as[18].fmi_u8 "" UBYTE CnvRule_NumberOneToOne 1 0 0 255 ECU_ADDRESS 0x70017CE4 /end MEASUREMENT
/begin MEASUREMENT dataJ1939Dm1Failrs_as[71].dtc_as[18].occ_u8 "" UBYTE CnvRule_NumberOneToOne 1 0 0 255 ECU_ADDRESS 0x70017CE5 /end MEASUREMENT
/begin MEASUREMENT dataJ1939Dm1Failrs_as[71].dtc_as[19].spn_u32 "" ULONG CnvRule_NumberOneToOne 1 0 0 4294967295 ECU_ADDRESS 0x70017CE8 /end MEASUREMENT
/begin MEASUREMENT dataJ1939Dm1Failrs_as[71].dtc_as[19].fmi_u8 "" UBYTE CnvRule_NumberOneToOne 1 0 0 255 ECU_ADDRESS 0x70017CEC /end MEASUREMENT
/begin MEASUREMENT dataJ1939Dm1Failrs_as[71].dtc_as[19].occ_u8 "" UBYTE CnvRule_NumberOneToOne 1 0 0 255 ECU_ADDRESS 0x70017CED /end MEASUREMENT
/begin MEASUREMENT dataJ1939Dm1Failrs_as[71].dtc_as[20].spn_u32 "" ULONG CnvRule_NumberOneToOne 1 0 0 4294967295 ECU_ADDRESS 0x70017CF0 /end MEASUREMENT
/begin MEASUREMENT dataJ1939Dm1Failrs_as[71].dtc_as[20].fmi_u8 "" UBYTE CnvRule_NumberOneToOne 1 0 0 255 ECU_ADDRESS 0x70017CF4 /end MEASUREMENT
/begin MEASUREMENT dataJ1939Dm1Failrs_as[71].dtc_as[20].occ_u8 "" UBYTE CnvRule_NumberOneToOne 1 0 0 255 ECU_ADDRESS 0x70017CF5 /end MEASUREMENT
/begin MEASUREMENT dataJ1939Dm1Failrs_as[71].dtc_as "" UBYTE CnvRule_NumberOneToOne 1 0 0 255 ECU_ADDRESS 0x70017C58 ARRAY_SIZE 160 /end MEASUREMENT
/begin MEASUREMENT dataJ1939Dm1Failrs_as[72].dtc_as[1].spn_u32 "" ULONG CnvRule_NumberOneToOne 1 0 0 4294967295 ECU_ADDRESS 0x70017CFC /end MEASUREMENT
/begin MEASUREMENT dataJ1939Dm1Failrs_as[72].dtc_as[1].fmi_u8 "" UBYTE CnvRule_NumberOneToOne 1 0 0 255 ECU_ADDRESS 0x70017D00 /end MEASUREMENT
/begin MEASUREMENT dataJ1939Dm1Failrs_as[72].dtc_as[1].occ_u8 "" UBYTE CnvRule_NumberOneToOne 1 0 0 255 ECU_ADDRESS 0x70017D01 /end MEASUREMENT
/begin MEASUREMENT dataJ1939Dm1Failrs_as[72].dtc_as[2].spn_u32 "" ULONG CnvRule_NumberOneToOne 1 0 0 4294967295 ECU_ADDRESS 0x70017D04 /end MEASUREMENT
/begin MEASUREMENT dataJ1939Dm1Failrs_as[72].dtc_as[2].fmi_u8 "" UBYTE CnvRule_NumberOneToOne 1 0 0 255 ECU_ADDRESS 0x70017D08 /end MEASUREMENT
/begin MEASUREMENT dataJ1939Dm1Failrs_as[72].dtc_as[2].occ_u8 "" UBYTE CnvRule_NumberOneToOne 1 0 0 255 ECU_ADDRESS 0x70017D09 /end MEASUREMENT
/begin MEASUREMENT dataJ1939Dm1Failrs_as[72].dtc_as[3].spn_u32 "" ULONG CnvRule_NumberOneToOne 1 0 0 4294967295 ECU_ADDRESS 0x70017D0C /end MEASUREMENT
/begin MEASUREMENT dataJ1939Dm1Failrs_as[72].dtc_as[3].fmi_u8 "" UBYTE CnvRule_NumberOneToOne 1 0 0 255 ECU_ADDRESS 0x70017D10 /end MEASUREMENT
/begin MEASUREMENT dataJ1939Dm1Failrs_as[72].dtc_as[3].occ_u8 "" UBYTE CnvRule_NumberOneToOne 1 0 0 255 ECU_ADDRESS 0x70017D11 /end MEASUREMENT
/begin MEASUREMENT dataJ1939Dm1Failrs_as[72].dtc_as[4].spn_u32 "" ULONG CnvRule_NumberOneToOne 1 0 0 4294967295 ECU_ADDRESS 0x70017D14 /end MEASUREMENT
/begin MEASUREMENT dataJ1939Dm1Failrs_as[72].dtc_as[4].fmi_u8 "" UBYTE CnvRule_NumberOneToOne 1 0 0 255 ECU_ADDRESS 0x70017D18 /end MEASUREMENT
/begin MEASUREMENT dataJ1939Dm1Failrs_as[72].dtc_as[4].occ_u8 "" UBYTE CnvRule_NumberOneToOne 1 0 0 255 ECU_ADDRESS 0x70017D19 /end MEASUREMENT
/begin MEASUREMENT dataJ1939Dm1Failrs_as[72].dtc_as[5].spn_u32 "" ULONG CnvRule_NumberOneToOne 1 0 0 4294967295 ECU_ADDRESS 0x70017D1C /end MEASUREMENT
/begin MEASUREMENT dataJ1939Dm1Failrs_as[72].dtc_as[5].fmi_u8 "" UBYTE CnvRule_NumberOneToOne 1 0 0 255 ECU_ADDRESS 0x70017D20 /end MEASUREMENT
/begin MEASUREMENT dataJ1939Dm1Failrs_as[72].dtc_as[5].occ_u8 "" UBYTE CnvRule_NumberOneToOne 1 0 0 255 ECU_ADDRESS 0x70017D21 /end MEASUREMENT
/begin MEASUREMENT dataJ1939Dm1Failrs_as[72].dtc_as[6].spn_u32 "" ULONG CnvRule_NumberOneToOne 1 0 0 4294967295 ECU_ADDRESS 0x70017D24 /end MEASUREMENT
/begin MEASUREMENT dataJ1939Dm1Failrs_as[72].dtc_as[6].fmi_u8 "" UBYTE CnvRule_NumberOneToOne 1 0 0 255 ECU_ADDRESS 0x70017D28 /end MEASUREMENT
/begin MEASUREMENT dataJ1939Dm1Failrs_as[72].dtc_as[6].occ_u8 "" UBYTE CnvRule_NumberOneToOne 1 0 0 255 ECU_ADDRESS 0x70017D29 /end MEASUREMENT
/begin MEASUREMENT dataJ1939Dm1Failrs_as[72].dtc_as[7].spn_u32 "" ULONG CnvRule_NumberOneToOne 1 0 0 4294967295 ECU_ADDRESS 0x70017D2C /end MEASUREMENT
/begin MEASUREMENT dataJ1939Dm1Failrs_as[72].dtc_as[7].fmi_u8 "" UBYTE CnvRule_NumberOneToOne 1 0 0 255 ECU_ADDRESS 0x70017D30 /end MEASUREMENT
/begin MEASUREMENT dataJ1939Dm1Failrs_as[72].dtc_as[7].occ_u8 "" UBYTE CnvRule_NumberOneToOne 1 0 0 255 ECU_ADDRESS 0x70017D31 /end MEASUREMENT
/begin MEASUREMENT dataJ1939Dm1Failrs_as[72].dtc_as[8].spn_u32 "" ULONG CnvRule_NumberOneToOne 1 0 0 4294967295 ECU_ADDRESS 0x70017D34 /end MEASUREMENT
/begin MEASUREMENT dataJ1939Dm1Failrs_as[72].dtc_as[8].fmi_u8 "" UBYTE CnvRule_NumberOneToOne 1 0 0 255 ECU_ADDRESS 0x70017D38 /end MEASUREMENT
/begin MEASUREMENT dataJ1939Dm1Failrs_as[72].dtc_as[8].occ_u8 "" UBYTE CnvRule_NumberOneToOne 1 0 0 255 ECU_ADDRESS 0x70017D39 /end MEASUREMENT
/begin MEASUREMENT dataJ1939Dm1Failrs_as[72].dtc_as[9].spn_u32 "" ULONG CnvRule_NumberOneToOne 1 0 0 4294967295 ECU_ADDRESS 0x70017D3C /end MEASUREMENT
/begin MEASUREMENT dataJ1939Dm1Failrs_as[72].dtc_as[9].fmi_u8 "" UBYTE CnvRule_NumberOneToOne 1 0 0 255 ECU_ADDRESS 0x70017D40 /end MEASUREMENT
/begin MEASUREMENT dataJ1939Dm1Failrs_as[72].dtc_as[9].occ_u8 "" UBYTE CnvRule_NumberOneToOne 1 0 0 255 ECU_ADDRESS 0x70017D41 /end MEASUREMENT
/begin MEASUREMENT dataJ1939Dm1Failrs_as[72].dtc_as[10].spn_u32 "" ULONG CnvRule_NumberOneToOne 1 0 0 4294967295 ECU_ADDRESS 0x70017D44 /end MEASUREMENT
/begin MEASUREMENT dataJ1939Dm1Failrs_as[72].dtc_as[10].fmi_u8 "" UBYTE CnvRule_NumberOneToOne 1 0 0 255 ECU_ADDRESS 0x70017D48 /end MEASUREMENT
/begin MEASUREMENT dataJ1939Dm1Failrs_as[72].dtc_as[10].occ_u8 "" UBYTE CnvRule_NumberOneToOne 1 0 0 255 ECU_ADDRESS 0x70017D49 /end MEASUREMENT
/begin MEASUREMENT dataJ1939Dm1Failrs_as[72].dtc_as[11].spn_u32 "" ULONG CnvRule_NumberOneToOne 1 0 0 4294967295 ECU_ADDRESS 0x70017D4C /end MEASUREMENT
/begin MEASUREMENT dataJ1939Dm1Failrs_as[72].dtc_as[11].fmi_u8 "" UBYTE CnvRule_NumberOneToOne 1 0 0 255 ECU_ADDRESS 0x70017D50 /end MEASUREMENT
/begin MEASUREMENT dataJ1939Dm1Failrs_as[72].dtc_as[11].occ_u8 "" UBYTE CnvRule_NumberOneToOne 1 0 0 255 ECU_ADDRESS 0x70017D51 /end MEASUREMENT
/begin MEASUREMENT dataJ1939Dm1Failrs_as[72].dtc_as[12].spn_u32 "" ULONG CnvRule_NumberOneToOne 1 0 0 4294967295 ECU_ADDRESS 0x70017D54 /end MEASUREMENT
/begin MEASUREMENT dataJ1939Dm1Failrs_as[72].dtc_as[12].fmi_u8 "" UBYTE CnvRule_NumberOneToOne 1 0 0 255 ECU_ADDRESS 0x70017D58 /end MEASUREMENT
/begin MEASUREMENT dataJ1939Dm1Failrs_as[72].dtc_as[12].occ_u8 "" UBYTE CnvRule_NumberOneToOne 1 0 0 255 ECU_ADDRESS 0x70017D59 /end MEASUREMENT
/begin MEASUREMENT dataJ1939Dm1Failrs_as[72].dtc_as[13].spn_u32 "" ULONG CnvRule_NumberOneToOne 1 0 0 4294967295 ECU_ADDRESS 0x70017D5C /end MEASUREMENT
/begin MEASUREMENT dataJ1939Dm1Failrs_as[72].dtc_as[13].fmi_u8 "" UBYTE CnvRule_NumberOneToOne 1 0 0 255 ECU_ADDRESS 0x70017D60 /end MEASUREMENT
/begin MEASUREMENT dataJ1939Dm1Failrs_as[72].dtc_as[13].occ_u8 "" UBYTE CnvRule_NumberOneToOne 1 0 0 255 ECU_ADDRESS 0x70017D61 /end MEASUREMENT
/begin MEASUREMENT dataJ1939Dm1Failrs_as[72].dtc_as[14].spn_u32 "" ULONG CnvRule_NumberOneToOne 1 0 0 4294967295 ECU_ADDRESS 0x70017D64 /end MEASUREMENT
/begin MEASUREMENT dataJ1939Dm1Failrs_as[72].dtc_as[14].fmi_u8 "" UBYTE CnvRule_NumberOneToOne 1 0 0 255 ECU_ADDRESS 0x70017D68 /end MEASUREMENT
/begin MEASUREMENT dataJ1939Dm1Failrs_as[72].dtc_as[14].occ_u8 "" UBYTE CnvRule_NumberOneToOne 1 0 0 255 ECU_ADDRESS 0x70017D69 /end MEASUREMENT
/begin MEASUREMENT dataJ1939Dm1Failrs_as[72].dtc_as[15].spn_u32 "" ULONG CnvRule_NumberOneToOne 1 0 0 4294967295 ECU_ADDRESS 0x70017D6C /end MEASUREMENT
/begin MEASUREMENT dataJ1939Dm1Failrs_as[72].dtc_as[15].fmi_u8 "" UBYTE CnvRule_NumberOneToOne 1 0 0 255 ECU_ADDRESS 0x70017D70 /end MEASUREMENT
/begin MEASUREMENT dataJ1939Dm1Failrs_as[72].dtc_as[15].occ_u8 "" UBYTE CnvRule_NumberOneToOne 1 0 0 255 ECU_ADDRESS 0x70017D71 /end MEASUREMENT
/begin MEASUREMENT dataJ1939Dm1Failrs_as[72].dtc_as[16].spn_u32 "" ULONG CnvRule_NumberOneToOne 1 0 0 4294967295 ECU_ADDRESS 0x70017D74 /end MEASUREMENT
/begin MEASUREMENT dataJ1939Dm1Failrs_as[72].dtc_as[16].fmi_u8 "" UBYTE CnvRule_NumberOneToOne 1 0 0 255 ECU_ADDRESS 0x70017D78 /end MEASUREMENT
/begin MEASUREMENT dataJ1939Dm1Failrs_as[72].dtc_as[16].occ_u8 "" UBYTE CnvRule_NumberOneToOne 1 0 0 255 ECU_ADDRESS 0x70017D79 /end MEASUREMENT
/begin MEASUREMENT dataJ1939Dm1Failrs_as[72].dtc_as[17].spn_u32 "" ULONG CnvRule_NumberOneToOne 1 0 0 4294967295 ECU_ADDRESS 0x70017D7C /end MEASUREMENT
/begin MEASUREMENT dataJ1939Dm1Failrs_as[72].dtc_as[17].fmi_u8 "" UBYTE CnvRule_NumberOneToOne 1 0 0 255 ECU_ADDRESS 0x70017D80 /end MEASUREMENT
/begin MEASUREMENT dataJ1939Dm1Failrs_as[72].dtc_as[17].occ_u8 "" UBYTE CnvRule_NumberOneToOne 1 0 0 255 ECU_ADDRESS 0x70017D81 /end MEASUREMENT
/begin MEASUREMENT dataJ1939Dm1Failrs_as[72].dtc_as[18].spn_u32 "" ULONG CnvRule_NumberOneToOne 1 0 0 4294967295 ECU_ADDRESS 0x70017D84 /end MEASUREMENT
/begin MEASUREMENT dataJ1939Dm1Failrs_as[72].dtc_as[18].fmi_u8 "" UBYTE CnvRule_NumberOneToOne 1 0 0 255 ECU_ADDRESS 0x70017D88 /end MEASUREMENT
/begin MEASUREMENT dataJ1939Dm1Failrs_as[72].dtc_as[18].occ_u8 "" UBYTE CnvRule_NumberOneToOne 1 0 0 255 ECU_ADDRESS 0x70017D89 /end MEASUREMENT
/begin MEASUREMENT dataJ1939Dm1Failrs_as[72].dtc_as[19].spn_u32 "" ULONG CnvRule_NumberOneToOne 1 0 0 4294967295 ECU_ADDRESS 0x70017D8C /end MEASUREMENT
/begin MEASUREMENT dataJ1939Dm1Failrs_as[72].dtc_as[19].fmi_u8 "" UBYTE CnvRule_NumberOneToOne 1 0 0 255 ECU_ADDRESS 0x70017D90 /end MEASUREMENT
/begin MEASUREMENT dataJ1939Dm1Failrs_as[72].dtc_as[19].occ_u8 "" UBYTE CnvRule_NumberOneToOne 1 0 0 255 ECU_ADDRESS 0x70017D91 /end MEASUREMENT
/begin MEASUREMENT dataJ1939Dm1Failrs_as[72].dtc_as[20].spn_u32 "" ULONG CnvRule_NumberOneToOne 1 0 0 4294967295 ECU_ADDRESS 0x70017D94 /end MEASUREMENT
/begin MEASUREMENT dataJ1939Dm1Failrs_as[72].dtc_as[20].fmi_u8 "" UBYTE CnvRule_NumberOneToOne 1 0 0 255 ECU_ADDRESS 0x70017D98 /end MEASUREMENT
/begin MEASUREMENT dataJ1939Dm1Failrs_as[72].dtc_as[20].occ_u8 "" UBYTE CnvRule_NumberOneToOne 1 0 0 255 ECU_ADDRESS 0x70017D99 /end MEASUREMENT
/begin MEASUREMENT dataJ1939Dm1Failrs_as[72].dtc_as "" UBYTE CnvRule_NumberOneToOne 1 0 0 255 ECU_ADDRESS 0x70017CFC ARRAY_SIZE 160 /end MEASUREMENT
/begin MEASUREMENT dataJ1939Dm1Failrs_as[73].dtc_as[1].spn_u32 "" ULONG CnvRule_NumberOneToOne 1 0 0 4294967295 ECU_ADDRESS 0x70017DA0 /end MEASUREMENT
/begin MEASUREMENT dataJ1939Dm1Failrs_as[73].dtc_as[1].fmi_u8 "" UBYTE CnvRule_NumberOneToOne 1 0 0 255 ECU_ADDRESS 0x70017DA4 /end MEASUREMENT
/begin MEASUREMENT dataJ1939Dm1Failrs_as[73].dtc_as[1].occ_u8 "" UBYTE CnvRule_NumberOneToOne 1 0 0 255 ECU_ADDRESS 0x70017DA5 /end MEASUREMENT
/begin MEASUREMENT dataJ1939Dm1Failrs_as[73].dtc_as[2].spn_u32 "" ULONG CnvRule_NumberOneToOne 1 0 0 4294967295 ECU_ADDRESS 0x70017DA8 /end MEASUREMENT
/begin MEASUREMENT dataJ1939Dm1Failrs_as[73].dtc_as[2].fmi_u8 "" UBYTE CnvRule_NumberOneToOne 1 0 0 255 ECU_ADDRESS 0x70017DAC /end MEASUREMENT
/begin MEASUREMENT dataJ1939Dm1Failrs_as[73].dtc_as[2].occ_u8 "" UBYTE CnvRule_NumberOneToOne 1 0 0 255 ECU_ADDRESS 0x70017DAD /end MEASUREMENT
/begin MEASUREMENT dataJ1939Dm1Failrs_as[73].dtc_as[3].spn_u32 "" ULONG CnvRule_NumberOneToOne 1 0 0 4294967295 ECU_ADDRESS 0x70017DB0 /end MEASUREMENT
/begin MEASUREMENT dataJ1939Dm1Failrs_as[73].dtc_as[3].fmi_u8 "" UBYTE CnvRule_NumberOneToOne 1 0 0 255 ECU_ADDRESS 0x70017DB4 /end MEASUREMENT
/begin MEASUREMENT dataJ1939Dm1Failrs_as[73].dtc_as[3].occ_u8 "" UBYTE CnvRule_NumberOneToOne 1 0 0 255 ECU_ADDRESS 0x70017DB5 /end MEASUREMENT
/begin MEASUREMENT dataJ1939Dm1Failrs_as[73].dtc_as[4].spn_u32 "" ULONG CnvRule_NumberOneToOne 1 0 0 4294967295 ECU_ADDRESS 0x70017DB8 /end MEASUREMENT
/begin MEASUREMENT dataJ1939Dm1Failrs_as[73].dtc_as[4].fmi_u8 "" UBYTE CnvRule_NumberOneToOne 1 0 0 255 ECU_ADDRESS 0x70017DBC /end MEASUREMENT
/begin MEASUREMENT dataJ1939Dm1Failrs_as[73].dtc_as[4].occ_u8 "" UBYTE CnvRule_NumberOneToOne 1 0 0 255 ECU_ADDRESS 0x70017DBD /end MEASUREMENT
/begin MEASUREMENT dataJ1939Dm1Failrs_as[73].dtc_as[5].spn_u32 "" ULONG CnvRule_NumberOneToOne 1 0 0 4294967295 ECU_ADDRESS 0x70017DC0 /end MEASUREMENT
/begin MEASUREMENT dataJ1939Dm1Failrs_as[73].dtc_as[5].fmi_u8 "" UBYTE CnvRule_NumberOneToOne 1 0 0 255 ECU_ADDRESS 0x70017DC4 /end MEASUREMENT
/begin MEASUREMENT dataJ1939Dm1Failrs_as[73].dtc_as[5].occ_u8 "" UBYTE CnvRule_NumberOneToOne 1 0 0 255 ECU_ADDRESS 0x70017DC5 /end MEASUREMENT
/begin MEASUREMENT dataJ1939Dm1Failrs_as[73].dtc_as[6].spn_u32 "" ULONG CnvRule_NumberOneToOne 1 0 0 4294967295 ECU_ADDRESS 0x70017DC8 /end MEASUREMENT
/begin MEASUREMENT dataJ1939Dm1Failrs_as[73].dtc_as[6].fmi_u8 "" UBYTE CnvRule_NumberOneToOne 1 0 0 255 ECU_ADDRESS 0x70017DCC /end MEASUREMENT
/begin MEASUREMENT dataJ1939Dm1Failrs_as[73].dtc_as[6].occ_u8 "" UBYTE CnvRule_NumberOneToOne 1 0 0 255 ECU_ADDRESS 0x70017DCD /end MEASUREMENT
/begin MEASUREMENT dataJ1939Dm1Failrs_as[73].dtc_as[7].spn_u32 "" ULONG CnvRule_NumberOneToOne 1 0 0 4294967295 ECU_ADDRESS 0x70017DD0 /end MEASUREMENT
/begin MEASUREMENT dataJ1939Dm1Failrs_as[73].dtc_as[7].fmi_u8 "" UBYTE CnvRule_NumberOneToOne 1 0 0 255 ECU_ADDRESS 0x70017DD4 /end MEASUREMENT
/begin MEASUREMENT dataJ1939Dm1Failrs_as[73].dtc_as[7].occ_u8 "" UBYTE CnvRule_NumberOneToOne 1 0 0 255 ECU_ADDRESS 0x70017DD5 /end MEASUREMENT
/begin MEASUREMENT dataJ1939Dm1Failrs_as[73].dtc_as[8].spn_u32 "" ULONG CnvRule_NumberOneToOne 1 0 0 4294967295 ECU_ADDRESS 0x70017DD8 /end MEASUREMENT
/begin MEASUREMENT dataJ1939Dm1Failrs_as[73].dtc_as[8].fmi_u8 "" UBYTE CnvRule_NumberOneToOne 1 0 0 255 ECU_ADDRESS 0x70017DDC /end MEASUREMENT
/begin MEASUREMENT dataJ1939Dm1Failrs_as[73].dtc_as[8].occ_u8 "" UBYTE CnvRule_NumberOneToOne 1 0 0 255 ECU_ADDRESS 0x70017DDD /end MEASUREMENT
/begin MEASUREMENT dataJ1939Dm1Failrs_as[73].dtc_as[9].spn_u32 "" ULONG CnvRule_NumberOneToOne 1 0 0 4294967295 ECU_ADDRESS 0x70017DE0 /end MEASUREMENT
/begin MEASUREMENT dataJ1939Dm1Failrs_as[73].dtc_as[9].fmi_u8 "" UBYTE CnvRule_NumberOneToOne 1 0 0 255 ECU_ADDRESS 0x70017DE4 /end MEASUREMENT
/begin MEASUREMENT dataJ1939Dm1Failrs_as[73].dtc_as[9].occ_u8 "" UBYTE CnvRule_NumberOneToOne 1 0 0 255 ECU_ADDRESS 0x70017DE5 /end MEASUREMENT
/begin MEASUREMENT dataJ1939Dm1Failrs_as[73].dtc_as[10].spn_u32 "" ULONG CnvRule_NumberOneToOne 1 0 0 4294967295 ECU_ADDRESS 0x70017DE8 /end MEASUREMENT
/begin MEASUREMENT dataJ1939Dm1Failrs_as[73].dtc_as[10].fmi_u8 "" UBYTE CnvRule_NumberOneToOne 1 0 0 255 ECU_ADDRESS 0x70017DEC /end MEASUREMENT
/begin MEASUREMENT dataJ1939Dm1Failrs_as[73].dtc_as[10].occ_u8 "" UBYTE CnvRule_NumberOneToOne 1 0 0 255 ECU_ADDRESS 0x70017DED /end MEASUREMENT
/begin MEASUREMENT dataJ1939Dm1Failrs_as[73].dtc_as[11].spn_u32 "" ULONG CnvRule_NumberOneToOne 1 0 0 4294967295 ECU_ADDRESS 0x70017DF0 /end MEASUREMENT
/begin MEASUREMENT dataJ1939Dm1Failrs_as[73].dtc_as[11].fmi_u8 "" UBYTE CnvRule_NumberOneToOne 1 0 0 255 ECU_ADDRESS 0x70017DF4 /end MEASUREMENT
/begin MEASUREMENT dataJ1939Dm1Failrs_as[73].dtc_as[11].occ_u8 "" UBYTE CnvRule_NumberOneToOne 1 0 0 255 ECU_ADDRESS 0x70017DF5 /end MEASUREMENT
/begin MEASUREMENT dataJ1939Dm1Failrs_as[73].dtc_as[12].spn_u32 "" ULONG CnvRule_NumberOneToOne 1 0 0 4294967295 ECU_ADDRESS 0x70017DF8 /end MEASUREMENT
/begin MEASUREMENT dataJ1939Dm1Failrs_as[73].dtc_as[12].fmi_u8 "" UBYTE CnvRule_NumberOneToOne 1 0 0 255 ECU_ADDRESS 0x70017DFC /end MEASUREMENT
/begin MEASUREMENT dataJ1939Dm1Failrs_as[73].dtc_as[12].occ_u8 "" UBYTE CnvRule_NumberOneToOne 1 0 0 255 ECU_ADDRESS 0x70017DFD /end MEASUREMENT
/begin MEASUREMENT dataJ1939Dm1Failrs_as[73].dtc_as[13].spn_u32 "" ULONG CnvRule_NumberOneToOne 1 0 0 4294967295 ECU_ADDRESS 0x70017E00 /end MEASUREMENT
/begin MEASUREMENT dataJ1939Dm1Failrs_as[73].dtc_as[13].fmi_u8 "" UBYTE CnvRule_NumberOneToOne 1 0 0 255 ECU_ADDRESS 0x70017E04 /end MEASUREMENT
/begin MEASUREMENT dataJ1939Dm1Failrs_as[73].dtc_as[13].occ_u8 "" UBYTE CnvRule_NumberOneToOne 1 0 0 255 ECU_ADDRESS 0x70017E05 /end MEASUREMENT
/begin MEASUREMENT dataJ1939Dm1Failrs_as[73].dtc_as[14].spn_u32 "" ULONG CnvRule_NumberOneToOne 1 0 0 4294967295 ECU_ADDRESS 0x70017E08 /end MEASUREMENT
/begin MEASUREMENT dataJ1939Dm1Failrs_as[73].dtc_as[14].fmi_u8 "" UBYTE CnvRule_NumberOneToOne 1 0 0 255 ECU_ADDRESS 0x70017E0C /end MEASUREMENT
/begin MEASUREMENT dataJ1939Dm1Failrs_as[73].dtc_as[14].occ_u8 "" UBYTE CnvRule_NumberOneToOne 1 0 0 255 ECU_ADDRESS 0x70017E0D /end MEASUREMENT
/begin MEASUREMENT dataJ1939Dm1Failrs_as[73].dtc_as[15].spn_u32 "" ULONG CnvRule_NumberOneToOne 1 0 0 4294967295 ECU_ADDRESS 0x70017E10 /end MEASUREMENT
/begin MEASUREMENT dataJ1939Dm1Failrs_as[73].dtc_as[15].fmi_u8 "" UBYTE CnvRule_NumberOneToOne 1 0 0 255 ECU_ADDRESS 0x70017E14 /end MEASUREMENT
/begin MEASUREMENT dataJ1939Dm1Failrs_as[73].dtc_as[15].occ_u8 "" UBYTE CnvRule_NumberOneToOne 1 0 0 255 ECU_ADDRESS 0x70017E15 /end MEASUREMENT
/begin MEASUREMENT dataJ1939Dm1Failrs_as[73].dtc_as[16].spn_u32 "" ULONG CnvRule_NumberOneToOne 1 0 0 4294967295 ECU_ADDRESS 0x70017E18 /end MEASUREMENT
/begin MEASUREMENT dataJ1939Dm1Failrs_as[73].dtc_as[16].fmi_u8 "" UBYTE CnvRule_NumberOneToOne 1 0 0 255 ECU_ADDRESS 0x70017E1C /end MEASUREMENT
/begin MEASUREMENT dataJ1939Dm1Failrs_as[73].dtc_as[16].occ_u8 "" UBYTE CnvRule_NumberOneToOne 1 0 0 255 ECU_ADDRESS 0x70017E1D /end MEASUREMENT
/begin MEASUREMENT dataJ1939Dm1Failrs_as[73].dtc_as[17].spn_u32 "" ULONG CnvRule_NumberOneToOne 1 0 0 4294967295 ECU_ADDRESS 0x70017E20 /end MEASUREMENT
/begin MEASUREMENT dataJ1939Dm1Failrs_as[73].dtc_as[17].fmi_u8 "" UBYTE CnvRule_NumberOneToOne 1 0 0 255 ECU_ADDRESS 0x70017E24 /end MEASUREMENT
/begin MEASUREMENT dataJ1939Dm1Failrs_as[73].dtc_as[17].occ_u8 "" UBYTE CnvRule_NumberOneToOne 1 0 0 255 ECU_ADDRESS 0x70017E25 /end MEASUREMENT
/begin MEASUREMENT dataJ1939Dm1Failrs_as[73].dtc_as[18].spn_u32 "" ULONG CnvRule_NumberOneToOne 1 0 0 4294967295 ECU_ADDRESS 0x70017E28 /end MEASUREMENT
/begin MEASUREMENT dataJ1939Dm1Failrs_as[73].dtc_as[18].fmi_u8 "" UBYTE CnvRule_NumberOneToOne 1 0 0 255 ECU_ADDRESS 0x70017E2C /end MEASUREMENT
/begin MEASUREMENT dataJ1939Dm1Failrs_as[73].dtc_as[18].occ_u8 "" UBYTE CnvRule_NumberOneToOne 1 0 0 255 ECU_ADDRESS 0x70017E2D /end MEASUREMENT
/begin MEASUREMENT dataJ1939Dm1Failrs_as[73].dtc_as[19].spn_u32 "" ULONG CnvRule_NumberOneToOne 1 0 0 4294967295 ECU_ADDRESS 0x70017E30 /end MEASUREMENT
/begin MEASUREMENT dataJ1939Dm1Failrs_as[73].dtc_as[19].fmi_u8 "" UBYTE CnvRule_NumberOneToOne 1 0 0 255 ECU_ADDRESS 0x70017E34 /end MEASUREMENT
/begin MEASUREMENT dataJ1939Dm1Failrs_as[73].dtc_as[19].occ_u8 "" UBYTE CnvRule_NumberOneToOne 1 0 0 255 ECU_ADDRESS 0x70017E35 /end MEASUREMENT
/begin MEASUREMENT dataJ1939Dm1Failrs_as[73].dtc_as[20].spn_u32 "" ULONG CnvRule_NumberOneToOne 1 0 0 4294967295 ECU_ADDRESS 0x70017E38 /end MEASUREMENT
/begin MEASUREMENT dataJ1939Dm1Failrs_as[73].dtc_as[20].fmi_u8 "" UBYTE CnvRule_NumberOneToOne 1 0 0 255 ECU_ADDRESS 0x70017E3C /end MEASUREMENT
/begin MEASUREMENT dataJ1939Dm1Failrs_as[73].dtc_as[20].occ_u8 "" UBYTE CnvRule_NumberOneToOne 1 0 0 255 ECU_ADDRESS 0x70017E3D /end MEASUREMENT
/begin MEASUREMENT dataJ1939Dm1Failrs_as[73].dtc_as "" UBYTE CnvRule_NumberOneToOne 1 0 0 255 ECU_ADDRESS 0x70017DA0 ARRAY_SIZE 160 /end MEASUREMENT
/begin MEASUREMENT dataJ1939Dm1Failrs_as[74].dtc_as[1].spn_u32 "" ULONG CnvRule_NumberOneToOne 1 0 0 4294967295 ECU_ADDRESS 0x70017E44 /end MEASUREMENT
/begin MEASUREMENT dataJ1939Dm1Failrs_as[74].dtc_as[1].fmi_u8 "" UBYTE CnvRule_NumberOneToOne 1 0 0 255 ECU_ADDRESS 0x70017E48 /end MEASUREMENT
/begin MEASUREMENT dataJ1939Dm1Failrs_as[74].dtc_as[1].occ_u8 "" UBYTE CnvRule_NumberOneToOne 1 0 0 255 ECU_ADDRESS 0x70017E49 /end MEASUREMENT
/begin MEASUREMENT dataJ1939Dm1Failrs_as[74].dtc_as[2].spn_u32 "" ULONG CnvRule_NumberOneToOne 1 0 0 4294967295 ECU_ADDRESS 0x70017E4C /end MEASUREMENT
/begin MEASUREMENT dataJ1939Dm1Failrs_as[74].dtc_as[2].fmi_u8 "" UBYTE CnvRule_NumberOneToOne 1 0 0 255 ECU_ADDRESS 0x70017E50 /end MEASUREMENT
/begin MEASUREMENT dataJ1939Dm1Failrs_as[74].dtc_as[2].occ_u8 "" UBYTE CnvRule_NumberOneToOne 1 0 0 255 ECU_ADDRESS 0x70017E51 /end MEASUREMENT
/begin MEASUREMENT dataJ1939Dm1Failrs_as[74].dtc_as[3].spn_u32 "" ULONG CnvRule_NumberOneToOne 1 0 0 4294967295 ECU_ADDRESS 0x70017E54 /end MEASUREMENT
/begin MEASUREMENT dataJ1939Dm1Failrs_as[74].dtc_as[3].fmi_u8 "" UBYTE CnvRule_NumberOneToOne 1 0 0 255 ECU_ADDRESS 0x70017E58 /end MEASUREMENT
/begin MEASUREMENT dataJ1939Dm1Failrs_as[74].dtc_as[3].occ_u8 "" UBYTE CnvRule_NumberOneToOne 1 0 0 255 ECU_ADDRESS 0x70017E59 /end MEASUREMENT
/begin MEASUREMENT dataJ1939Dm1Failrs_as[74].dtc_as[4].spn_u32 "" ULONG CnvRule_NumberOneToOne 1 0 0 4294967295 ECU_ADDRESS 0x70017E5C /end MEASUREMENT
/begin MEASUREMENT dataJ1939Dm1Failrs_as[74].dtc_as[4].fmi_u8 "" UBYTE CnvRule_NumberOneToOne 1 0 0 255 ECU_ADDRESS 0x70017E60 /end MEASUREMENT
/begin MEASUREMENT dataJ1939Dm1Failrs_as[74].dtc_as[4].occ_u8 "" UBYTE CnvRule_NumberOneToOne 1 0 0 255 ECU_ADDRESS 0x70017E61 /end MEASUREMENT
/begin MEASUREMENT dataJ1939Dm1Failrs_as[74].dtc_as[5].spn_u32 "" ULONG CnvRule_NumberOneToOne 1 0 0 4294967295 ECU_ADDRESS 0x70017E64 /end MEASUREMENT
/begin MEASUREMENT dataJ1939Dm1Failrs_as[74].dtc_as[5].fmi_u8 "" UBYTE CnvRule_NumberOneToOne 1 0 0 255 ECU_ADDRESS 0x70017E68 /end MEASUREMENT
/begin MEASUREMENT dataJ1939Dm1Failrs_as[74].dtc_as[5].occ_u8 "" UBYTE CnvRule_NumberOneToOne 1 0 0 255 ECU_ADDRESS 0x70017E69 /end MEASUREMENT
/begin MEASUREMENT dataJ1939Dm1Failrs_as[74].dtc_as[6].spn_u32 "" ULONG CnvRule_NumberOneToOne 1 0 0 4294967295 ECU_ADDRESS 0x70017E6C /end MEASUREMENT
/begin MEASUREMENT dataJ1939Dm1Failrs_as[74].dtc_as[6].fmi_u8 "" UBYTE CnvRule_NumberOneToOne 1 0 0 255 ECU_ADDRESS 0x70017E70 /end MEASUREMENT
/begin MEASUREMENT dataJ1939Dm1Failrs_as[74].dtc_as[6].occ_u8 "" UBYTE CnvRule_NumberOneToOne 1 0 0 255 ECU_ADDRESS 0x70017E71 /end MEASUREMENT
/begin MEASUREMENT dataJ1939Dm1Failrs_as[74].dtc_as[7].spn_u32 "" ULONG CnvRule_NumberOneToOne 1 0 0 4294967295 ECU_ADDRESS 0x70017E74 /end MEASUREMENT
/begin MEASUREMENT dataJ1939Dm1Failrs_as[74].dtc_as[7].fmi_u8 "" UBYTE CnvRule_NumberOneToOne 1 0 0 255 ECU_ADDRESS 0x70017E78 /end MEASUREMENT
/begin MEASUREMENT dataJ1939Dm1Failrs_as[74].dtc_as[7].occ_u8 "" UBYTE CnvRule_NumberOneToOne 1 0 0 255 ECU_ADDRESS 0x70017E79 /end MEASUREMENT
/begin MEASUREMENT dataJ1939Dm1Failrs_as[74].dtc_as[8].spn_u32 "" ULONG CnvRule_NumberOneToOne 1 0 0 4294967295 ECU_ADDRESS 0x70017E7C /end MEASUREMENT
/begin MEASUREMENT dataJ1939Dm1Failrs_as[74].dtc_as[8].fmi_u8 "" UBYTE CnvRule_NumberOneToOne 1 0 0 255 ECU_ADDRESS 0x70017E80 /end MEASUREMENT
/begin MEASUREMENT dataJ1939Dm1Failrs_as[74].dtc_as[8].occ_u8 "" UBYTE CnvRule_NumberOneToOne 1 0 0 255 ECU_ADDRESS 0x70017E81 /end MEASUREMENT
/begin MEASUREMENT dataJ1939Dm1Failrs_as[74].dtc_as[9].spn_u32 "" ULONG CnvRule_NumberOneToOne 1 0 0 4294967295 ECU_ADDRESS 0x70017E84 /end MEASUREMENT
/begin MEASUREMENT dataJ1939Dm1Failrs_as[74].dtc_as[9].fmi_u8 "" UBYTE CnvRule_NumberOneToOne 1 0 0 255 ECU_ADDRESS 0x70017E88 /end MEASUREMENT
/begin MEASUREMENT dataJ1939Dm1Failrs_as[74].dtc_as[9].occ_u8 "" UBYTE CnvRule_NumberOneToOne 1 0 0 255 ECU_ADDRESS 0x70017E89 /end MEASUREMENT
/begin MEASUREMENT dataJ1939Dm1Failrs_as[74].dtc_as[10].spn_u32 "" ULONG CnvRule_NumberOneToOne 1 0 0 4294967295 ECU_ADDRESS 0x70017E8C /end MEASUREMENT
/begin MEASUREMENT dataJ1939Dm1Failrs_as[74].dtc_as[10].fmi_u8 "" UBYTE CnvRule_NumberOneToOne 1 0 0 255 ECU_ADDRESS 0x70017E90 /end MEASUREMENT
/begin MEASUREMENT dataJ1939Dm1Failrs_as[74].dtc_as[10].occ_u8 "" UBYTE CnvRule_NumberOneToOne 1 0 0 255 ECU_ADDRESS 0x70017E91 /end MEASUREMENT
/begin MEASUREMENT dataJ1939Dm1Failrs_as[74].dtc_as[11].spn_u32 "" ULONG CnvRule_NumberOneToOne 1 0 0 4294967295 ECU_ADDRESS 0x70017E94 /end MEASUREMENT
/begin MEASUREMENT dataJ1939Dm1Failrs_as[74].dtc_as[11].fmi_u8 "" UBYTE CnvRule_NumberOneToOne 1 0 0 255 ECU_ADDRESS 0x70017E98 /end MEASUREMENT
/begin MEASUREMENT dataJ1939Dm1Failrs_as[74].dtc_as[11].occ_u8 "" UBYTE CnvRule_NumberOneToOne 1 0 0 255 ECU_ADDRESS 0x70017E99 /end MEASUREMENT
/begin MEASUREMENT dataJ1939Dm1Failrs_as[74].dtc_as[12].spn_u32 "" ULONG CnvRule_NumberOneToOne 1 0 0 4294967295 ECU_ADDRESS 0x70017E9C /end MEASUREMENT
/begin MEASUREMENT dataJ1939Dm1Failrs_as[74].dtc_as[12].fmi_u8 "" UBYTE CnvRule_NumberOneToOne 1 0 0 255 ECU_ADDRESS 0x70017EA0 /end MEASUREMENT
/begin MEASUREMENT dataJ1939Dm1Failrs_as[74].dtc_as[12].occ_u8 "" UBYTE CnvRule_NumberOneToOne 1 0 0 255 ECU_ADDRESS 0x70017EA1 /end MEASUREMENT
/begin MEASUREMENT dataJ1939Dm1Failrs_as[74].dtc_as[13].spn_u32 "" ULONG CnvRule_NumberOneToOne 1 0 0 4294967295 ECU_ADDRESS 0x70017EA4 /end MEASUREMENT
/begin MEASUREMENT dataJ1939Dm1Failrs_as[74].dtc_as[13].fmi_u8 "" UBYTE CnvRule_NumberOneToOne 1 0 0 255 ECU_ADDRESS 0x70017EA8 /end MEASUREMENT
/begin MEASUREMENT dataJ1939Dm1Failrs_as[74].dtc_as[13].occ_u8 "" UBYTE CnvRule_NumberOneToOne 1 0 0 255 ECU_ADDRESS 0x70017EA9 /end MEASUREMENT
/begin MEASUREMENT dataJ1939Dm1Failrs_as[74].dtc_as[14].spn_u32 "" ULONG CnvRule_NumberOneToOne 1 0 0 4294967295 ECU_ADDRESS 0x70017EAC /end MEASUREMENT
/begin MEASUREMENT dataJ1939Dm1Failrs_as[74].dtc_as[14].fmi_u8 "" UBYTE CnvRule_NumberOneToOne 1 0 0 255 ECU_ADDRESS 0x70017EB0 /end MEASUREMENT
/begin MEASUREMENT dataJ1939Dm1Failrs_as[74].dtc_as[14].occ_u8 "" UBYTE CnvRule_NumberOneToOne 1 0 0 255 ECU_ADDRESS 0x70017EB1 /end MEASUREMENT
/begin MEASUREMENT dataJ1939Dm1Failrs_as[74].dtc_as[15].spn_u32 "" ULONG CnvRule_NumberOneToOne 1 0 0 4294967295 ECU_ADDRESS 0x70017EB4 /end MEASUREMENT
/begin MEASUREMENT dataJ1939Dm1Failrs_as[74].dtc_as[15].fmi_u8 "" UBYTE CnvRule_NumberOneToOne 1 0 0 255 ECU_ADDRESS 0x70017EB8 /end MEASUREMENT
/begin MEASUREMENT dataJ1939Dm1Failrs_as[74].dtc_as[15].occ_u8 "" UBYTE CnvRule_NumberOneToOne 1 0 0 255 ECU_ADDRESS 0x70017EB9 /end MEASUREMENT
/begin MEASUREMENT dataJ1939Dm1Failrs_as[74].dtc_as[16].spn_u32 "" ULONG CnvRule_NumberOneToOne 1 0 0 4294967295 ECU_ADDRESS 0x70017EBC /end MEASUREMENT
/begin MEASUREMENT dataJ1939Dm1Failrs_as[74].dtc_as[16].fmi_u8 "" UBYTE CnvRule_NumberOneToOne 1 0 0 255 ECU_ADDRESS 0x70017EC0 /end MEASUREMENT
/begin MEASUREMENT dataJ1939Dm1Failrs_as[74].dtc_as[16].occ_u8 "" UBYTE CnvRule_NumberOneToOne 1 0 0 255 ECU_ADDRESS 0x70017EC1 /end MEASUREMENT
/begin MEASUREMENT dataJ1939Dm1Failrs_as[74].dtc_as[17].spn_u32 "" ULONG CnvRule_NumberOneToOne 1 0 0 4294967295 ECU_ADDRESS 0x70017EC4 /end MEASUREMENT
/begin MEASUREMENT dataJ1939Dm1Failrs_as[74].dtc_as[17].fmi_u8 "" UBYTE CnvRule_NumberOneToOne 1 0 0 255 ECU_ADDRESS 0x70017EC8 /end MEASUREMENT
/begin MEASUREMENT dataJ1939Dm1Failrs_as[74].dtc_as[17].occ_u8 "" UBYTE CnvRule_NumberOneToOne 1 0 0 255 ECU_ADDRESS 0x70017EC9 /end MEASUREMENT
/begin MEASUREMENT dataJ1939Dm1Failrs_as[74].dtc_as[18].spn_u32 "" ULONG CnvRule_NumberOneToOne 1 0 0 4294967295 ECU_ADDRESS 0x70017ECC /end MEASUREMENT
/begin MEASUREMENT dataJ1939Dm1Failrs_as[74].dtc_as[18].fmi_u8 "" UBYTE CnvRule_NumberOneToOne 1 0 0 255 ECU_ADDRESS 0x70017ED0 /end MEASUREMENT
/begin MEASUREMENT dataJ1939Dm1Failrs_as[74].dtc_as[18].occ_u8 "" UBYTE CnvRule_NumberOneToOne 1 0 0 255 ECU_ADDRESS 0x70017ED1 /end MEASUREMENT
/begin MEASUREMENT dataJ1939Dm1Failrs_as[74].dtc_as[19].spn_u32 "" ULONG CnvRule_NumberOneToOne 1 0 0 4294967295 ECU_ADDRESS 0x70017ED4 /end MEASUREMENT
/begin MEASUREMENT dataJ1939Dm1Failrs_as[74].dtc_as[19].fmi_u8 "" UBYTE CnvRule_NumberOneToOne 1 0 0 255 ECU_ADDRESS 0x70017ED8 /end MEASUREMENT
/begin MEASUREMENT dataJ1939Dm1Failrs_as[74].dtc_as[19].occ_u8 "" UBYTE CnvRule_NumberOneToOne 1 0 0 255 ECU_ADDRESS 0x70017ED9 /end MEASUREMENT
/begin MEASUREMENT dataJ1939Dm1Failrs_as[74].dtc_as[20].spn_u32 "" ULONG CnvRule_NumberOneToOne 1 0 0 4294967295 ECU_ADDRESS 0x70017EDC /end MEASUREMENT
/begin MEASUREMENT dataJ1939Dm1Failrs_as[74].dtc_as[20].fmi_u8 "" UBYTE CnvRule_NumberOneToOne 1 0 0 255 ECU_ADDRESS 0x70017EE0 /end MEASUREMENT
/begin MEASUREMENT dataJ1939Dm1Failrs_as[74].dtc_as[20].occ_u8 "" UBYTE CnvRule_NumberOneToOne 1 0 0 255 ECU_ADDRESS 0x70017EE1 /end MEASUREMENT
/begin MEASUREMENT dataJ1939Dm1Failrs_as[74].dtc_as "" UBYTE CnvRule_NumberOneToOne 1 0 0 255 ECU_ADDRESS 0x70017E44 ARRAY_SIZE 160 /end MEASUREMENT
/begin MEASUREMENT dataJ1939Dm1Failrs_as[75].dtc_as[1].spn_u32 "" ULONG CnvRule_NumberOneToOne 1 0 0 4294967295 ECU_ADDRESS 0x70017EE8 /end MEASUREMENT
/begin MEASUREMENT dataJ1939Dm1Failrs_as[75].dtc_as[1].fmi_u8 "" UBYTE CnvRule_NumberOneToOne 1 0 0 255 ECU_ADDRESS 0x70017EEC /end MEASUREMENT
/begin MEASUREMENT dataJ1939Dm1Failrs_as[75].dtc_as[1].occ_u8 "" UBYTE CnvRule_NumberOneToOne 1 0 0 255 ECU_ADDRESS 0x70017EED /end MEASUREMENT
/begin MEASUREMENT dataJ1939Dm1Failrs_as[75].dtc_as[2].spn_u32 "" ULONG CnvRule_NumberOneToOne 1 0 0 4294967295 ECU_ADDRESS 0x70017EF0 /end MEASUREMENT
/begin MEASUREMENT dataJ1939Dm1Failrs_as[75].dtc_as[2].fmi_u8 "" UBYTE CnvRule_NumberOneToOne 1 0 0 255 ECU_ADDRESS 0x70017EF4 /end MEASUREMENT
/begin MEASUREMENT dataJ1939Dm1Failrs_as[75].dtc_as[2].occ_u8 "" UBYTE CnvRule_NumberOneToOne 1 0 0 255 ECU_ADDRESS 0x70017EF5 /end MEASUREMENT
/begin MEASUREMENT dataJ1939Dm1Failrs_as[75].dtc_as[3].spn_u32 "" ULONG CnvRule_NumberOneToOne 1 0 0 4294967295 ECU_ADDRESS 0x70017EF8 /end MEASUREMENT
/begin MEASUREMENT dataJ1939Dm1Failrs_as[75].dtc_as[3].fmi_u8 "" UBYTE CnvRule_NumberOneToOne 1 0 0 255 ECU_ADDRESS 0x70017EFC /end MEASUREMENT
/begin MEASUREMENT dataJ1939Dm1Failrs_as[75].dtc_as[3].occ_u8 "" UBYTE CnvRule_NumberOneToOne 1 0 0 255 ECU_ADDRESS 0x70017EFD /end MEASUREMENT
/begin MEASUREMENT dataJ1939Dm1Failrs_as[75].dtc_as[4].spn_u32 "" ULONG CnvRule_NumberOneToOne 1 0 0 4294967295 ECU_ADDRESS 0x70017F00 /end MEASUREMENT
/begin MEASUREMENT dataJ1939Dm1Failrs_as[75].dtc_as[4].fmi_u8 "" UBYTE CnvRule_NumberOneToOne 1 0 0 255 ECU_ADDRESS 0x70017F04 /end MEASUREMENT
/begin MEASUREMENT dataJ1939Dm1Failrs_as[75].dtc_as[4].occ_u8 "" UBYTE CnvRule_NumberOneToOne 1 0 0 255 ECU_ADDRESS 0x70017F05 /end MEASUREMENT
/begin MEASUREMENT dataJ1939Dm1Failrs_as[75].dtc_as[5].spn_u32 "" ULONG CnvRule_NumberOneToOne 1 0 0 4294967295 ECU_ADDRESS 0x70017F08 /end MEASUREMENT
/begin MEASUREMENT dataJ1939Dm1Failrs_as[75].dtc_as[5].fmi_u8 "" UBYTE CnvRule_NumberOneToOne 1 0 0 255 ECU_ADDRESS 0x70017F0C /end MEASUREMENT
/begin MEASUREMENT dataJ1939Dm1Failrs_as[75].dtc_as[5].occ_u8 "" UBYTE CnvRule_NumberOneToOne 1 0 0 255 ECU_ADDRESS 0x70017F0D /end MEASUREMENT
/begin MEASUREMENT dataJ1939Dm1Failrs_as[75].dtc_as[6].spn_u32 "" ULONG CnvRule_NumberOneToOne 1 0 0 4294967295 ECU_ADDRESS 0x70017F10 /end MEASUREMENT
/begin MEASUREMENT dataJ1939Dm1Failrs_as[75].dtc_as[6].fmi_u8 "" UBYTE CnvRule_NumberOneToOne 1 0 0 255 ECU_ADDRESS 0x70017F14 /end MEASUREMENT
/begin MEASUREMENT dataJ1939Dm1Failrs_as[75].dtc_as[6].occ_u8 "" UBYTE CnvRule_NumberOneToOne 1 0 0 255 ECU_ADDRESS 0x70017F15 /end MEASUREMENT
/begin MEASUREMENT dataJ1939Dm1Failrs_as[75].dtc_as[7].spn_u32 "" ULONG CnvRule_NumberOneToOne 1 0 0 4294967295 ECU_ADDRESS 0x70017F18 /end MEASUREMENT
/begin MEASUREMENT dataJ1939Dm1Failrs_as[75].dtc_as[7].fmi_u8 "" UBYTE CnvRule_NumberOneToOne 1 0 0 255 ECU_ADDRESS 0x70017F1C /end MEASUREMENT
/begin MEASUREMENT dataJ1939Dm1Failrs_as[75].dtc_as[7].occ_u8 "" UBYTE CnvRule_NumberOneToOne 1 0 0 255 ECU_ADDRESS 0x70017F1D /end MEASUREMENT
/begin MEASUREMENT dataJ1939Dm1Failrs_as[75].dtc_as[8].spn_u32 "" ULONG CnvRule_NumberOneToOne 1 0 0 4294967295 ECU_ADDRESS 0x70017F20 /end MEASUREMENT
/begin MEASUREMENT dataJ1939Dm1Failrs_as[75].dtc_as[8].fmi_u8 "" UBYTE CnvRule_NumberOneToOne 1 0 0 255 ECU_ADDRESS 0x70017F24 /end MEASUREMENT
/begin MEASUREMENT dataJ1939Dm1Failrs_as[75].dtc_as[8].occ_u8 "" UBYTE CnvRule_NumberOneToOne 1 0 0 255 ECU_ADDRESS 0x70017F25 /end MEASUREMENT
/begin MEASUREMENT dataJ1939Dm1Failrs_as[75].dtc_as[9].spn_u32 "" ULONG CnvRule_NumberOneToOne 1 0 0 4294967295 ECU_ADDRESS 0x70017F28 /end MEASUREMENT
/begin MEASUREMENT dataJ1939Dm1Failrs_as[75].dtc_as[9].fmi_u8 "" UBYTE CnvRule_NumberOneToOne 1 0 0 255 ECU_ADDRESS 0x70017F2C /end MEASUREMENT
/begin MEASUREMENT dataJ1939Dm1Failrs_as[75].dtc_as[9].occ_u8 "" UBYTE CnvRule_NumberOneToOne 1 0 0 255 ECU_ADDRESS 0x70017F2D /end MEASUREMENT
/begin MEASUREMENT dataJ1939Dm1Failrs_as[75].dtc_as[10].spn_u32 "" ULONG CnvRule_NumberOneToOne 1 0 0 4294967295 ECU_ADDRESS 0x70017F30 /end MEASUREMENT
/begin MEASUREMENT dataJ1939Dm1Failrs_as[75].dtc_as[10].fmi_u8 "" UBYTE CnvRule_NumberOneToOne 1 0 0 255 ECU_ADDRESS 0x70017F34 /end MEASUREMENT
/begin MEASUREMENT dataJ1939Dm1Failrs_as[75].dtc_as[10].occ_u8 "" UBYTE CnvRule_NumberOneToOne 1 0 0 255 ECU_ADDRESS 0x70017F35 /end MEASUREMENT
/begin MEASUREMENT dataJ1939Dm1Failrs_as[75].dtc_as[11].spn_u32 "" ULONG CnvRule_NumberOneToOne 1 0 0 4294967295 ECU_ADDRESS 0x70017F38 /end MEASUREMENT
/begin MEASUREMENT dataJ1939Dm1Failrs_as[75].dtc_as[11].fmi_u8 "" UBYTE CnvRule_NumberOneToOne 1 0 0 255 ECU_ADDRESS 0x70017F3C /end MEASUREMENT
/begin MEASUREMENT dataJ1939Dm1Failrs_as[75].dtc_as[11].occ_u8 "" UBYTE CnvRule_NumberOneToOne 1 0 0 255 ECU_ADDRESS 0x70017F3D /end MEASUREMENT
/begin MEASUREMENT dataJ1939Dm1Failrs_as[75].dtc_as[12].spn_u32 "" ULONG CnvRule_NumberOneToOne 1 0 0 4294967295 ECU_ADDRESS 0x70017F40 /end MEASUREMENT
/begin MEASUREMENT dataJ1939Dm1Failrs_as[75].dtc_as[12].fmi_u8 "" UBYTE CnvRule_NumberOneToOne 1 0 0 255 ECU_ADDRESS 0x70017F44 /end MEASUREMENT
/begin MEASUREMENT dataJ1939Dm1Failrs_as[75].dtc_as[12].occ_u8 "" UBYTE CnvRule_NumberOneToOne 1 0 0 255 ECU_ADDRESS 0x70017F45 /end MEASUREMENT
/begin MEASUREMENT dataJ1939Dm1Failrs_as[75].dtc_as[13].spn_u32 "" ULONG CnvRule_NumberOneToOne 1 0 0 4294967295 ECU_ADDRESS 0x70017F48 /end MEASUREMENT
/begin MEASUREMENT dataJ1939Dm1Failrs_as[75].dtc_as[13].fmi_u8 "" UBYTE CnvRule_NumberOneToOne 1 0 0 255 ECU_ADDRESS 0x70017F4C /end MEASUREMENT
/begin MEASUREMENT dataJ1939Dm1Failrs_as[75].dtc_as[13].occ_u8 "" UBYTE CnvRule_NumberOneToOne 1 0 0 255 ECU_ADDRESS 0x70017F4D /end MEASUREMENT
/begin MEASUREMENT dataJ1939Dm1Failrs_as[75].dtc_as[14].spn_u32 "" ULONG CnvRule_NumberOneToOne 1 0 0 4294967295 ECU_ADDRESS 0x70017F50 /end MEASUREMENT
/begin MEASUREMENT dataJ1939Dm1Failrs_as[75].dtc_as[14].fmi_u8 "" UBYTE CnvRule_NumberOneToOne 1 0 0 255 ECU_ADDRESS 0x70017F54 /end MEASUREMENT
/begin MEASUREMENT dataJ1939Dm1Failrs_as[75].dtc_as[14].occ_u8 "" UBYTE CnvRule_NumberOneToOne 1 0 0 255 ECU_ADDRESS 0x70017F55 /end MEASUREMENT
/begin MEASUREMENT dataJ1939Dm1Failrs_as[75].dtc_as[15].spn_u32 "" ULONG CnvRule_NumberOneToOne 1 0 0 4294967295 ECU_ADDRESS 0x70017F58 /end MEASUREMENT
/begin MEASUREMENT dataJ1939Dm1Failrs_as[75].dtc_as[15].fmi_u8 "" UBYTE CnvRule_NumberOneToOne 1 0 0 255 ECU_ADDRESS 0x70017F5C /end MEASUREMENT
/begin MEASUREMENT dataJ1939Dm1Failrs_as[75].dtc_as[15].occ_u8 "" UBYTE CnvRule_NumberOneToOne 1 0 0 255 ECU_ADDRESS 0x70017F5D /end MEASUREMENT
/begin MEASUREMENT dataJ1939Dm1Failrs_as[75].dtc_as[16].spn_u32 "" ULONG CnvRule_NumberOneToOne 1 0 0 4294967295 ECU_ADDRESS 0x70017F60 /end MEASUREMENT
/begin MEASUREMENT dataJ1939Dm1Failrs_as[75].dtc_as[16].fmi_u8 "" UBYTE CnvRule_NumberOneToOne 1 0 0 255 ECU_ADDRESS 0x70017F64 /end MEASUREMENT
/begin MEASUREMENT dataJ1939Dm1Failrs_as[75].dtc_as[16].occ_u8 "" UBYTE CnvRule_NumberOneToOne 1 0 0 255 ECU_ADDRESS 0x70017F65 /end MEASUREMENT
/begin MEASUREMENT dataJ1939Dm1Failrs_as[75].dtc_as[17].spn_u32 "" ULONG CnvRule_NumberOneToOne 1 0 0 4294967295 ECU_ADDRESS 0x70017F68 /end MEASUREMENT
/begin MEASUREMENT dataJ1939Dm1Failrs_as[75].dtc_as[17].fmi_u8 "" UBYTE CnvRule_NumberOneToOne 1 0 0 255 ECU_ADDRESS 0x70017F6C /end MEASUREMENT
/begin MEASUREMENT dataJ1939Dm1Failrs_as[75].dtc_as[17].occ_u8 "" UBYTE CnvRule_NumberOneToOne 1 0 0 255 ECU_ADDRESS 0x70017F6D /end MEASUREMENT
/begin MEASUREMENT dataJ1939Dm1Failrs_as[75].dtc_as[18].spn_u32 "" ULONG CnvRule_NumberOneToOne 1 0 0 4294967295 ECU_ADDRESS 0x70017F70 /end MEASUREMENT
/begin MEASUREMENT dataJ1939Dm1Failrs_as[75].dtc_as[18].fmi_u8 "" UBYTE CnvRule_NumberOneToOne 1 0 0 255 ECU_ADDRESS 0x70017F74 /end MEASUREMENT
/begin MEASUREMENT dataJ1939Dm1Failrs_as[75].dtc_as[18].occ_u8 "" UBYTE CnvRule_NumberOneToOne 1 0 0 255 ECU_ADDRESS 0x70017F75 /end MEASUREMENT
/begin MEASUREMENT dataJ1939Dm1Failrs_as[75].dtc_as[19].spn_u32 "" ULONG CnvRule_NumberOneToOne 1 0 0 4294967295 ECU_ADDRESS 0x70017F78 /end MEASUREMENT
/begin MEASUREMENT dataJ1939Dm1Failrs_as[75].dtc_as[19].fmi_u8 "" UBYTE CnvRule_NumberOneToOne 1 0 0 255 ECU_ADDRESS 0x70017F7C /end MEASUREMENT
/begin MEASUREMENT dataJ1939Dm1Failrs_as[75].dtc_as[19].occ_u8 "" UBYTE CnvRule_NumberOneToOne 1 0 0 255 ECU_ADDRESS 0x70017F7D /end MEASUREMENT
/begin MEASUREMENT dataJ1939Dm1Failrs_as[75].dtc_as[20].spn_u32 "" ULONG CnvRule_NumberOneToOne 1 0 0 4294967295 ECU_ADDRESS 0x70017F80 /end MEASUREMENT
/begin MEASUREMENT dataJ1939Dm1Failrs_as[75].dtc_as[20].fmi_u8 "" UBYTE CnvRule_NumberOneToOne 1 0 0 255 ECU_ADDRESS 0x70017F84 /end MEASUREMENT
/begin MEASUREMENT dataJ1939Dm1Failrs_as[75].dtc_as[20].occ_u8 "" UBYTE CnvRule_NumberOneToOne 1 0 0 255 ECU_ADDRESS 0x70017F85 /end MEASUREMENT
/begin MEASUREMENT dataJ1939Dm1Failrs_as[75].dtc_as "" UBYTE CnvRule_NumberOneToOne 1 0 0 255 ECU_ADDRESS 0x70017EE8 ARRAY_SIZE 160 /end MEASUREMENT
/begin MEASUREMENT dataJ1939Dm1Failrs_as[76].dtc_as[1].spn_u32 "" ULONG CnvRule_NumberOneToOne 1 0 0 4294967295 ECU_ADDRESS 0x70017F8C /end MEASUREMENT
/begin MEASUREMENT dataJ1939Dm1Failrs_as[76].dtc_as[1].fmi_u8 "" UBYTE CnvRule_NumberOneToOne 1 0 0 255 ECU_ADDRESS 0x70017F90 /end MEASUREMENT
/begin MEASUREMENT dataJ1939Dm1Failrs_as[76].dtc_as[1].occ_u8 "" UBYTE CnvRule_NumberOneToOne 1 0 0 255 ECU_ADDRESS 0x70017F91 /end MEASUREMENT
/begin MEASUREMENT dataJ1939Dm1Failrs_as[76].dtc_as[2].spn_u32 "" ULONG CnvRule_NumberOneToOne 1 0 0 4294967295 ECU_ADDRESS 0x70017F94 /end MEASUREMENT
/begin MEASUREMENT dataJ1939Dm1Failrs_as[76].dtc_as[2].fmi_u8 "" UBYTE CnvRule_NumberOneToOne 1 0 0 255 ECU_ADDRESS 0x70017F98 /end MEASUREMENT
/begin MEASUREMENT dataJ1939Dm1Failrs_as[76].dtc_as[2].occ_u8 "" UBYTE CnvRule_NumberOneToOne 1 0 0 255 ECU_ADDRESS 0x70017F99 /end MEASUREMENT
/begin MEASUREMENT dataJ1939Dm1Failrs_as[76].dtc_as[3].spn_u32 "" ULONG CnvRule_NumberOneToOne 1 0 0 4294967295 ECU_ADDRESS 0x70017F9C /end MEASUREMENT
/begin MEASUREMENT dataJ1939Dm1Failrs_as[76].dtc_as[3].fmi_u8 "" UBYTE CnvRule_NumberOneToOne 1 0 0 255 ECU_ADDRESS 0x70017FA0 /end MEASUREMENT
/begin MEASUREMENT dataJ1939Dm1Failrs_as[76].dtc_as[3].occ_u8 "" UBYTE CnvRule_NumberOneToOne 1 0 0 255 ECU_ADDRESS 0x70017FA1 /end MEASUREMENT
/begin MEASUREMENT dataJ1939Dm1Failrs_as[76].dtc_as[4].spn_u32 "" ULONG CnvRule_NumberOneToOne 1 0 0 4294967295 ECU_ADDRESS 0x70017FA4 /end MEASUREMENT
/begin MEASUREMENT dataJ1939Dm1Failrs_as[76].dtc_as[4].fmi_u8 "" UBYTE CnvRule_NumberOneToOne 1 0 0 255 ECU_ADDRESS 0x70017FA8 /end MEASUREMENT
/begin MEASUREMENT dataJ1939Dm1Failrs_as[76].dtc_as[4].occ_u8 "" UBYTE CnvRule_NumberOneToOne 1 0 0 255 ECU_ADDRESS 0x70017FA9 /end MEASUREMENT
/begin MEASUREMENT dataJ1939Dm1Failrs_as[76].dtc_as[5].spn_u32 "" ULONG CnvRule_NumberOneToOne 1 0 0 4294967295 ECU_ADDRESS 0x70017FAC /end MEASUREMENT
/begin MEASUREMENT dataJ1939Dm1Failrs_as[76].dtc_as[5].fmi_u8 "" UBYTE CnvRule_NumberOneToOne 1 0 0 255 ECU_ADDRESS 0x70017FB0 /end MEASUREMENT
/begin MEASUREMENT dataJ1939Dm1Failrs_as[76].dtc_as[5].occ_u8 "" UBYTE CnvRule_NumberOneToOne 1 0 0 255 ECU_ADDRESS 0x70017FB1 /end MEASUREMENT
/begin MEASUREMENT dataJ1939Dm1Failrs_as[76].dtc_as[6].spn_u32 "" ULONG CnvRule_NumberOneToOne 1 0 0 4294967295 ECU_ADDRESS 0x70017FB4 /end MEASUREMENT
/begin MEASUREMENT dataJ1939Dm1Failrs_as[76].dtc_as[6].fmi_u8 "" UBYTE CnvRule_NumberOneToOne 1 0 0 255 ECU_ADDRESS 0x70017FB8 /end MEASUREMENT
/begin MEASUREMENT dataJ1939Dm1Failrs_as[76].dtc_as[6].occ_u8 "" UBYTE CnvRule_NumberOneToOne 1 0 0 255 ECU_ADDRESS 0x70017FB9 /end MEASUREMENT
/begin MEASUREMENT dataJ1939Dm1Failrs_as[76].dtc_as[7].spn_u32 "" ULONG CnvRule_NumberOneToOne 1 0 0 4294967295 ECU_ADDRESS 0x70017FBC /end MEASUREMENT
/begin MEASUREMENT dataJ1939Dm1Failrs_as[76].dtc_as[7].fmi_u8 "" UBYTE CnvRule_NumberOneToOne 1 0 0 255 ECU_ADDRESS 0x70017FC0 /end MEASUREMENT
/begin MEASUREMENT dataJ1939Dm1Failrs_as[76].dtc_as[7].occ_u8 "" UBYTE CnvRule_NumberOneToOne 1 0 0 255 ECU_ADDRESS 0x70017FC1 /end MEASUREMENT
/begin MEASUREMENT dataJ1939Dm1Failrs_as[76].dtc_as[8].spn_u32 "" ULONG CnvRule_NumberOneToOne 1 0 0 4294967295 ECU_ADDRESS 0x70017FC4 /end MEASUREMENT
/begin MEASUREMENT dataJ1939Dm1Failrs_as[76].dtc_as[8].fmi_u8 "" UBYTE CnvRule_NumberOneToOne 1 0 0 255 ECU_ADDRESS 0x70017FC8 /end MEASUREMENT
/begin MEASUREMENT dataJ1939Dm1Failrs_as[76].dtc_as[8].occ_u8 "" UBYTE CnvRule_NumberOneToOne 1 0 0 255 ECU_ADDRESS 0x70017FC9 /end MEASUREMENT
/begin MEASUREMENT dataJ1939Dm1Failrs_as[76].dtc_as[9].spn_u32 "" ULONG CnvRule_NumberOneToOne 1 0 0 4294967295 ECU_ADDRESS 0x70017FCC /end MEASUREMENT
/begin MEASUREMENT dataJ1939Dm1Failrs_as[76].dtc_as[9].fmi_u8 "" UBYTE CnvRule_NumberOneToOne 1 0 0 255 ECU_ADDRESS 0x70017FD0 /end MEASUREMENT
/begin MEASUREMENT dataJ1939Dm1Failrs_as[76].dtc_as[9].occ_u8 "" UBYTE CnvRule_NumberOneToOne 1 0 0 255 ECU_ADDRESS 0x70017FD1 /end MEASUREMENT
/begin MEASUREMENT dataJ1939Dm1Failrs_as[76].dtc_as[10].spn_u32 "" ULONG CnvRule_NumberOneToOne 1 0 0 4294967295 ECU_ADDRESS 0x70017FD4 /end MEASUREMENT
/begin MEASUREMENT dataJ1939Dm1Failrs_as[76].dtc_as[10].fmi_u8 "" UBYTE CnvRule_NumberOneToOne 1 0 0 255 ECU_ADDRESS 0x70017FD8 /end MEASUREMENT
/begin MEASUREMENT dataJ1939Dm1Failrs_as[76].dtc_as[10].occ_u8 "" UBYTE CnvRule_NumberOneToOne 1 0 0 255 ECU_ADDRESS 0x70017FD9 /end MEASUREMENT
/begin MEASUREMENT dataJ1939Dm1Failrs_as[76].dtc_as[11].spn_u32 "" ULONG CnvRule_NumberOneToOne 1 0 0 4294967295 ECU_ADDRESS 0x70017FDC /end MEASUREMENT
/begin MEASUREMENT dataJ1939Dm1Failrs_as[76].dtc_as[11].fmi_u8 "" UBYTE CnvRule_NumberOneToOne 1 0 0 255 ECU_ADDRESS 0x70017FE0 /end MEASUREMENT
/begin MEASUREMENT dataJ1939Dm1Failrs_as[76].dtc_as[11].occ_u8 "" UBYTE CnvRule_NumberOneToOne 1 0 0 255 ECU_ADDRESS 0x70017FE1 /end MEASUREMENT
/begin MEASUREMENT dataJ1939Dm1Failrs_as[76].dtc_as[12].spn_u32 "" ULONG CnvRule_NumberOneToOne 1 0 0 4294967295 ECU_ADDRESS 0x70017FE4 /end MEASUREMENT
/begin MEASUREMENT dataJ1939Dm1Failrs_as[76].dtc_as[12].fmi_u8 "" UBYTE CnvRule_NumberOneToOne 1 0 0 255 ECU_ADDRESS 0x70017FE8 /end MEASUREMENT
/begin MEASUREMENT dataJ1939Dm1Failrs_as[76].dtc_as[12].occ_u8 "" UBYTE CnvRule_NumberOneToOne 1 0 0 255 ECU_ADDRESS 0x70017FE9 /end MEASUREMENT
/begin MEASUREMENT dataJ1939Dm1Failrs_as[76].dtc_as[13].spn_u32 "" ULONG CnvRule_NumberOneToOne 1 0 0 4294967295 ECU_ADDRESS 0x70017FEC /end MEASUREMENT
/begin MEASUREMENT dataJ1939Dm1Failrs_as[76].dtc_as[13].fmi_u8 "" UBYTE CnvRule_NumberOneToOne 1 0 0 255 ECU_ADDRESS 0x70017FF0 /end MEASUREMENT
/begin MEASUREMENT dataJ1939Dm1Failrs_as[76].dtc_as[13].occ_u8 "" UBYTE CnvRule_NumberOneToOne 1 0 0 255 ECU_ADDRESS 0x70017FF1 /end MEASUREMENT
/begin MEASUREMENT dataJ1939Dm1Failrs_as[76].dtc_as[14].spn_u32 "" ULONG CnvRule_NumberOneToOne 1 0 0 4294967295 ECU_ADDRESS 0x70017FF4 /end MEASUREMENT
/begin MEASUREMENT dataJ1939Dm1Failrs_as[76].dtc_as[14].fmi_u8 "" UBYTE CnvRule_NumberOneToOne 1 0 0 255 ECU_ADDRESS 0x70017FF8 /end MEASUREMENT
/begin MEASUREMENT dataJ1939Dm1Failrs_as[76].dtc_as[14].occ_u8 "" UBYTE CnvRule_NumberOneToOne 1 0 0 255 ECU_ADDRESS 0x70017FF9 /end MEASUREMENT
/begin MEASUREMENT dataJ1939Dm1Failrs_as[76].dtc_as[15].spn_u32 "" ULONG CnvRule_NumberOneToOne 1 0 0 4294967295 ECU_ADDRESS 0x70017FFC /end MEASUREMENT
/begin MEASUREMENT dataJ1939Dm1Failrs_as[76].dtc_as[15].fmi_u8 "" UBYTE CnvRule_NumberOneToOne 1 0 0 255 ECU_ADDRESS 0x70018000 /end MEASUREMENT
/begin MEASUREMENT dataJ1939Dm1Failrs_as[76].dtc_as[15].occ_u8 "" UBYTE CnvRule_NumberOneToOne 1 0 0 255 ECU_ADDRESS 0x70018001 /end MEASUREMENT
/begin MEASUREMENT dataJ1939Dm1Failrs_as[76].dtc_as[16].spn_u32 "" ULONG CnvRule_NumberOneToOne 1 0 0 4294967295 ECU_ADDRESS 0x70018004 /end MEASUREMENT
/begin MEASUREMENT dataJ1939Dm1Failrs_as[76].dtc_as[16].fmi_u8 "" UBYTE CnvRule_NumberOneToOne 1 0 0 255 ECU_ADDRESS 0x70018008 /end MEASUREMENT
/begin MEASUREMENT dataJ1939Dm1Failrs_as[76].dtc_as[16].occ_u8 "" UBYTE CnvRule_NumberOneToOne 1 0 0 255 ECU_ADDRESS 0x70018009 /end MEASUREMENT
/begin MEASUREMENT dataJ1939Dm1Failrs_as[76].dtc_as[17].spn_u32 "" ULONG CnvRule_NumberOneToOne 1 0 0 4294967295 ECU_ADDRESS 0x7001800C /end MEASUREMENT
/begin MEASUREMENT dataJ1939Dm1Failrs_as[76].dtc_as[17].fmi_u8 "" UBYTE CnvRule_NumberOneToOne 1 0 0 255 ECU_ADDRESS 0x70018010 /end MEASUREMENT
/begin MEASUREMENT dataJ1939Dm1Failrs_as[76].dtc_as[17].occ_u8 "" UBYTE CnvRule_NumberOneToOne 1 0 0 255 ECU_ADDRESS 0x70018011 /end MEASUREMENT
/begin MEASUREMENT dataJ1939Dm1Failrs_as[76].dtc_as[18].spn_u32 "" ULONG CnvRule_NumberOneToOne 1 0 0 4294967295 ECU_ADDRESS 0x70018014 /end MEASUREMENT
/begin MEASUREMENT dataJ1939Dm1Failrs_as[76].dtc_as[18].fmi_u8 "" UBYTE CnvRule_NumberOneToOne 1 0 0 255 ECU_ADDRESS 0x70018018 /end MEASUREMENT
/begin MEASUREMENT dataJ1939Dm1Failrs_as[76].dtc_as[18].occ_u8 "" UBYTE CnvRule_NumberOneToOne 1 0 0 255 ECU_ADDRESS 0x70018019 /end MEASUREMENT
/begin MEASUREMENT dataJ1939Dm1Failrs_as[76].dtc_as[19].spn_u32 "" ULONG CnvRule_NumberOneToOne 1 0 0 4294967295 ECU_ADDRESS 0x7001801C /end MEASUREMENT
/begin MEASUREMENT dataJ1939Dm1Failrs_as[76].dtc_as[19].fmi_u8 "" UBYTE CnvRule_NumberOneToOne 1 0 0 255 ECU_ADDRESS 0x70018020 /end MEASUREMENT
/begin MEASUREMENT dataJ1939Dm1Failrs_as[76].dtc_as[19].occ_u8 "" UBYTE CnvRule_NumberOneToOne 1 0 0 255 ECU_ADDRESS 0x70018021 /end MEASUREMENT
/begin MEASUREMENT dataJ1939Dm1Failrs_as[76].dtc_as[20].spn_u32 "" ULONG CnvRule_NumberOneToOne 1 0 0 4294967295 ECU_ADDRESS 0x70018024 /end MEASUREMENT
/begin MEASUREMENT dataJ1939Dm1Failrs_as[76].dtc_as[20].fmi_u8 "" UBYTE CnvRule_NumberOneToOne 1 0 0 255 ECU_ADDRESS 0x70018028 /end MEASUREMENT
/begin MEASUREMENT dataJ1939Dm1Failrs_as[76].dtc_as[20].occ_u8 "" UBYTE CnvRule_NumberOneToOne 1 0 0 255 ECU_ADDRESS 0x70018029 /end MEASUREMENT
/begin MEASUREMENT dataJ1939Dm1Failrs_as[76].dtc_as "" UBYTE CnvRule_NumberOneToOne 1 0 0 255 ECU_ADDRESS 0x70017F8C ARRAY_SIZE 160 /end MEASUREMENT
/begin MEASUREMENT dataJ1939Dm1Failrs_as[77].dtc_as[1].spn_u32 "" ULONG CnvRule_NumberOneToOne 1 0 0 4294967295 ECU_ADDRESS 0x70018030 /end MEASUREMENT
/begin MEASUREMENT dataJ1939Dm1Failrs_as[77].dtc_as[1].fmi_u8 "" UBYTE CnvRule_NumberOneToOne 1 0 0 255 ECU_ADDRESS 0x70018034 /end MEASUREMENT
/begin MEASUREMENT dataJ1939Dm1Failrs_as[77].dtc_as[1].occ_u8 "" UBYTE CnvRule_NumberOneToOne 1 0 0 255 ECU_ADDRESS 0x70018035 /end MEASUREMENT
/begin MEASUREMENT dataJ1939Dm1Failrs_as[77].dtc_as[2].spn_u32 "" ULONG CnvRule_NumberOneToOne 1 0 0 4294967295 ECU_ADDRESS 0x70018038 /end MEASUREMENT
/begin MEASUREMENT dataJ1939Dm1Failrs_as[77].dtc_as[2].fmi_u8 "" UBYTE CnvRule_NumberOneToOne 1 0 0 255 ECU_ADDRESS 0x7001803C /end MEASUREMENT
/begin MEASUREMENT dataJ1939Dm1Failrs_as[77].dtc_as[2].occ_u8 "" UBYTE CnvRule_NumberOneToOne 1 0 0 255 ECU_ADDRESS 0x7001803D /end MEASUREMENT
/begin MEASUREMENT dataJ1939Dm1Failrs_as[77].dtc_as[3].spn_u32 "" ULONG CnvRule_NumberOneToOne 1 0 0 4294967295 ECU_ADDRESS 0x70018040 /end MEASUREMENT
/begin MEASUREMENT dataJ1939Dm1Failrs_as[77].dtc_as[3].fmi_u8 "" UBYTE CnvRule_NumberOneToOne 1 0 0 255 ECU_ADDRESS 0x70018044 /end MEASUREMENT
/begin MEASUREMENT dataJ1939Dm1Failrs_as[77].dtc_as[3].occ_u8 "" UBYTE CnvRule_NumberOneToOne 1 0 0 255 ECU_ADDRESS 0x70018045 /end MEASUREMENT
/begin MEASUREMENT dataJ1939Dm1Failrs_as[77].dtc_as[4].spn_u32 "" ULONG CnvRule_NumberOneToOne 1 0 0 4294967295 ECU_ADDRESS 0x70018048 /end MEASUREMENT
/begin MEASUREMENT dataJ1939Dm1Failrs_as[77].dtc_as[4].fmi_u8 "" UBYTE CnvRule_NumberOneToOne 1 0 0 255 ECU_ADDRESS 0x7001804C /end MEASUREMENT
/begin MEASUREMENT dataJ1939Dm1Failrs_as[77].dtc_as[4].occ_u8 "" UBYTE CnvRule_NumberOneToOne 1 0 0 255 ECU_ADDRESS 0x7001804D /end MEASUREMENT
/begin MEASUREMENT dataJ1939Dm1Failrs_as[77].dtc_as[5].spn_u32 "" ULONG CnvRule_NumberOneToOne 1 0 0 4294967295 ECU_ADDRESS 0x70018050 /end MEASUREMENT
/begin MEASUREMENT dataJ1939Dm1Failrs_as[77].dtc_as[5].fmi_u8 "" UBYTE CnvRule_NumberOneToOne 1 0 0 255 ECU_ADDRESS 0x70018054 /end MEASUREMENT
/begin MEASUREMENT dataJ1939Dm1Failrs_as[77].dtc_as[5].occ_u8 "" UBYTE CnvRule_NumberOneToOne 1 0 0 255 ECU_ADDRESS 0x70018055 /end MEASUREMENT
/begin MEASUREMENT dataJ1939Dm1Failrs_as[77].dtc_as[6].spn_u32 "" ULONG CnvRule_NumberOneToOne 1 0 0 4294967295 ECU_ADDRESS 0x70018058 /end MEASUREMENT
/begin MEASUREMENT dataJ1939Dm1Failrs_as[77].dtc_as[6].fmi_u8 "" UBYTE CnvRule_NumberOneToOne 1 0 0 255 ECU_ADDRESS 0x7001805C /end MEASUREMENT
/begin MEASUREMENT dataJ1939Dm1Failrs_as[77].dtc_as[6].occ_u8 "" UBYTE CnvRule_NumberOneToOne 1 0 0 255 ECU_ADDRESS 0x7001805D /end MEASUREMENT
/begin MEASUREMENT dataJ1939Dm1Failrs_as[77].dtc_as[7].spn_u32 "" ULONG CnvRule_NumberOneToOne 1 0 0 4294967295 ECU_ADDRESS 0x70018060 /end MEASUREMENT
/begin MEASUREMENT dataJ1939Dm1Failrs_as[77].dtc_as[7].fmi_u8 "" UBYTE CnvRule_NumberOneToOne 1 0 0 255 ECU_ADDRESS 0x70018064 /end MEASUREMENT
/begin MEASUREMENT dataJ1939Dm1Failrs_as[77].dtc_as[7].occ_u8 "" UBYTE CnvRule_NumberOneToOne 1 0 0 255 ECU_ADDRESS 0x70018065 /end MEASUREMENT
/begin MEASUREMENT dataJ1939Dm1Failrs_as[77].dtc_as[8].spn_u32 "" ULONG CnvRule_NumberOneToOne 1 0 0 4294967295 ECU_ADDRESS 0x70018068 /end MEASUREMENT
/begin MEASUREMENT dataJ1939Dm1Failrs_as[77].dtc_as[8].fmi_u8 "" UBYTE CnvRule_NumberOneToOne 1 0 0 255 ECU_ADDRESS 0x7001806C /end MEASUREMENT
/begin MEASUREMENT dataJ1939Dm1Failrs_as[77].dtc_as[8].occ_u8 "" UBYTE CnvRule_NumberOneToOne 1 0 0 255 ECU_ADDRESS 0x7001806D /end MEASUREMENT
/begin MEASUREMENT dataJ1939Dm1Failrs_as[77].dtc_as[9].spn_u32 "" ULONG CnvRule_NumberOneToOne 1 0 0 4294967295 ECU_ADDRESS 0x70018070 /end MEASUREMENT
/begin MEASUREMENT dataJ1939Dm1Failrs_as[77].dtc_as[9].fmi_u8 "" UBYTE CnvRule_NumberOneToOne 1 0 0 255 ECU_ADDRESS 0x70018074 /end MEASUREMENT
/begin MEASUREMENT dataJ1939Dm1Failrs_as[77].dtc_as[9].occ_u8 "" UBYTE CnvRule_NumberOneToOne 1 0 0 255 ECU_ADDRESS 0x70018075 /end MEASUREMENT
/begin MEASUREMENT dataJ1939Dm1Failrs_as[77].dtc_as[10].spn_u32 "" ULONG CnvRule_NumberOneToOne 1 0 0 4294967295 ECU_ADDRESS 0x70018078 /end MEASUREMENT
/begin MEASUREMENT dataJ1939Dm1Failrs_as[77].dtc_as[10].fmi_u8 "" UBYTE CnvRule_NumberOneToOne 1 0 0 255 ECU_ADDRESS 0x7001807C /end MEASUREMENT
/begin MEASUREMENT dataJ1939Dm1Failrs_as[77].dtc_as[10].occ_u8 "" UBYTE CnvRule_NumberOneToOne 1 0 0 255 ECU_ADDRESS 0x7001807D /end MEASUREMENT
/begin MEASUREMENT dataJ1939Dm1Failrs_as[77].dtc_as[11].spn_u32 "" ULONG CnvRule_NumberOneToOne 1 0 0 4294967295 ECU_ADDRESS 0x70018080 /end MEASUREMENT
/begin MEASUREMENT dataJ1939Dm1Failrs_as[77].dtc_as[11].fmi_u8 "" UBYTE CnvRule_NumberOneToOne 1 0 0 255 ECU_ADDRESS 0x70018084 /end MEASUREMENT
/begin MEASUREMENT dataJ1939Dm1Failrs_as[77].dtc_as[11].occ_u8 "" UBYTE CnvRule_NumberOneToOne 1 0 0 255 ECU_ADDRESS 0x70018085 /end MEASUREMENT
/begin MEASUREMENT dataJ1939Dm1Failrs_as[77].dtc_as[12].spn_u32 "" ULONG CnvRule_NumberOneToOne 1 0 0 4294967295 ECU_ADDRESS 0x70018088 /end MEASUREMENT
/begin MEASUREMENT dataJ1939Dm1Failrs_as[77].dtc_as[12].fmi_u8 "" UBYTE CnvRule_NumberOneToOne 1 0 0 255 ECU_ADDRESS 0x7001808C /end MEASUREMENT
/begin MEASUREMENT dataJ1939Dm1Failrs_as[77].dtc_as[12].occ_u8 "" UBYTE CnvRule_NumberOneToOne 1 0 0 255 ECU_ADDRESS 0x7001808D /end MEASUREMENT
/begin MEASUREMENT dataJ1939Dm1Failrs_as[77].dtc_as[13].spn_u32 "" ULONG CnvRule_NumberOneToOne 1 0 0 4294967295 ECU_ADDRESS 0x70018090 /end MEASUREMENT
/begin MEASUREMENT dataJ1939Dm1Failrs_as[77].dtc_as[13].fmi_u8 "" UBYTE CnvRule_NumberOneToOne 1 0 0 255 ECU_ADDRESS 0x70018094 /end MEASUREMENT
/begin MEASUREMENT dataJ1939Dm1Failrs_as[77].dtc_as[13].occ_u8 "" UBYTE CnvRule_NumberOneToOne 1 0 0 255 ECU_ADDRESS 0x70018095 /end MEASUREMENT
/begin MEASUREMENT dataJ1939Dm1Failrs_as[77].dtc_as[14].spn_u32 "" ULONG CnvRule_NumberOneToOne 1 0 0 4294967295 ECU_ADDRESS 0x70018098 /end MEASUREMENT
/begin MEASUREMENT dataJ1939Dm1Failrs_as[77].dtc_as[14].fmi_u8 "" UBYTE CnvRule_NumberOneToOne 1 0 0 255 ECU_ADDRESS 0x7001809C /end MEASUREMENT
/begin MEASUREMENT dataJ1939Dm1Failrs_as[77].dtc_as[14].occ_u8 "" UBYTE CnvRule_NumberOneToOne 1 0 0 255 ECU_ADDRESS 0x7001809D /end MEASUREMENT
/begin MEASUREMENT dataJ1939Dm1Failrs_as[77].dtc_as[15].spn_u32 "" ULONG CnvRule_NumberOneToOne 1 0 0 4294967295 ECU_ADDRESS 0x700180A0 /end MEASUREMENT
/begin MEASUREMENT dataJ1939Dm1Failrs_as[77].dtc_as[15].fmi_u8 "" UBYTE CnvRule_NumberOneToOne 1 0 0 255 ECU_ADDRESS 0x700180A4 /end MEASUREMENT
/begin MEASUREMENT dataJ1939Dm1Failrs_as[77].dtc_as[15].occ_u8 "" UBYTE CnvRule_NumberOneToOne 1 0 0 255 ECU_ADDRESS 0x700180A5 /end MEASUREMENT
/begin MEASUREMENT dataJ1939Dm1Failrs_as[77].dtc_as[16].spn_u32 "" ULONG CnvRule_NumberOneToOne 1 0 0 4294967295 ECU_ADDRESS 0x700180A8 /end MEASUREMENT
/begin MEASUREMENT dataJ1939Dm1Failrs_as[77].dtc_as[16].fmi_u8 "" UBYTE CnvRule_NumberOneToOne 1 0 0 255 ECU_ADDRESS 0x700180AC /end MEASUREMENT
/begin MEASUREMENT dataJ1939Dm1Failrs_as[77].dtc_as[16].occ_u8 "" UBYTE CnvRule_NumberOneToOne 1 0 0 255 ECU_ADDRESS 0x700180AD /end MEASUREMENT
/begin MEASUREMENT dataJ1939Dm1Failrs_as[77].dtc_as[17].spn_u32 "" ULONG CnvRule_NumberOneToOne 1 0 0 4294967295 ECU_ADDRESS 0x700180B0 /end MEASUREMENT
/begin MEASUREMENT dataJ1939Dm1Failrs_as[77].dtc_as[17].fmi_u8 "" UBYTE CnvRule_NumberOneToOne 1 0 0 255 ECU_ADDRESS 0x700180B4 /end MEASUREMENT
/begin MEASUREMENT dataJ1939Dm1Failrs_as[77].dtc_as[17].occ_u8 "" UBYTE CnvRule_NumberOneToOne 1 0 0 255 ECU_ADDRESS 0x700180B5 /end MEASUREMENT
/begin MEASUREMENT dataJ1939Dm1Failrs_as[77].dtc_as[18].spn_u32 "" ULONG CnvRule_NumberOneToOne 1 0 0 4294967295 ECU_ADDRESS 0x700180B8 /end MEASUREMENT
/begin MEASUREMENT dataJ1939Dm1Failrs_as[77].dtc_as[18].fmi_u8 "" UBYTE CnvRule_NumberOneToOne 1 0 0 255 ECU_ADDRESS 0x700180BC /end MEASUREMENT
/begin MEASUREMENT dataJ1939Dm1Failrs_as[77].dtc_as[18].occ_u8 "" UBYTE CnvRule_NumberOneToOne 1 0 0 255 ECU_ADDRESS 0x700180BD /end MEASUREMENT
/begin MEASUREMENT dataJ1939Dm1Failrs_as[77].dtc_as[19].spn_u32 "" ULONG CnvRule_NumberOneToOne 1 0 0 4294967295 ECU_ADDRESS 0x700180C0 /end MEASUREMENT
/begin MEASUREMENT dataJ1939Dm1Failrs_as[77].dtc_as[19].fmi_u8 "" UBYTE CnvRule_NumberOneToOne 1 0 0 255 ECU_ADDRESS 0x700180C4 /end MEASUREMENT
/begin MEASUREMENT dataJ1939Dm1Failrs_as[77].dtc_as[19].occ_u8 "" UBYTE CnvRule_NumberOneToOne 1 0 0 255 ECU_ADDRESS 0x700180C5 /end MEASUREMENT
/begin MEASUREMENT dataJ1939Dm1Failrs_as[77].dtc_as[20].spn_u32 "" ULONG CnvRule_NumberOneToOne 1 0 0 4294967295 ECU_ADDRESS 0x700180C8 /end MEASUREMENT
/begin MEASUREMENT dataJ1939Dm1Failrs_as[77].dtc_as[20].fmi_u8 "" UBYTE CnvRule_NumberOneToOne 1 0 0 255 ECU_ADDRESS 0x700180CC /end MEASUREMENT
/begin MEASUREMENT dataJ1939Dm1Failrs_as[77].dtc_as[20].occ_u8 "" UBYTE CnvRule_NumberOneToOne 1 0 0 255 ECU_ADDRESS 0x700180CD /end MEASUREMENT
/begin MEASUREMENT dataJ1939Dm1Failrs_as[77].dtc_as "" UBYTE CnvRule_NumberOneToOne 1 0 0 255 ECU_ADDRESS 0x70018030 ARRAY_SIZE 160 /end MEASUREMENT
/begin MEASUREMENT dataJ1939Dm1Failrs_as[78].dtc_as[1].spn_u32 "" ULONG CnvRule_NumberOneToOne 1 0 0 4294967295 ECU_ADDRESS 0x700180D4 /end MEASUREMENT
/begin MEASUREMENT dataJ1939Dm1Failrs_as[78].dtc_as[1].fmi_u8 "" UBYTE CnvRule_NumberOneToOne 1 0 0 255 ECU_ADDRESS 0x700180D8 /end MEASUREMENT
/begin MEASUREMENT dataJ1939Dm1Failrs_as[78].dtc_as[1].occ_u8 "" UBYTE CnvRule_NumberOneToOne 1 0 0 255 ECU_ADDRESS 0x700180D9 /end MEASUREMENT
/begin MEASUREMENT dataJ1939Dm1Failrs_as[78].dtc_as[2].spn_u32 "" ULONG CnvRule_NumberOneToOne 1 0 0 4294967295 ECU_ADDRESS 0x700180DC /end MEASUREMENT
/begin MEASUREMENT dataJ1939Dm1Failrs_as[78].dtc_as[2].fmi_u8 "" UBYTE CnvRule_NumberOneToOne 1 0 0 255 ECU_ADDRESS 0x700180E0 /end MEASUREMENT
/begin MEASUREMENT dataJ1939Dm1Failrs_as[78].dtc_as[2].occ_u8 "" UBYTE CnvRule_NumberOneToOne 1 0 0 255 ECU_ADDRESS 0x700180E1 /end MEASUREMENT
/begin MEASUREMENT dataJ1939Dm1Failrs_as[78].dtc_as[3].spn_u32 "" ULONG CnvRule_NumberOneToOne 1 0 0 4294967295 ECU_ADDRESS 0x700180E4 /end MEASUREMENT
/begin MEASUREMENT dataJ1939Dm1Failrs_as[78].dtc_as[3].fmi_u8 "" UBYTE CnvRule_NumberOneToOne 1 0 0 255 ECU_ADDRESS 0x700180E8 /end MEASUREMENT
/begin MEASUREMENT dataJ1939Dm1Failrs_as[78].dtc_as[3].occ_u8 "" UBYTE CnvRule_NumberOneToOne 1 0 0 255 ECU_ADDRESS 0x700180E9 /end MEASUREMENT
/begin MEASUREMENT dataJ1939Dm1Failrs_as[78].dtc_as[4].spn_u32 "" ULONG CnvRule_NumberOneToOne 1 0 0 4294967295 ECU_ADDRESS 0x700180EC /end MEASUREMENT
/begin MEASUREMENT dataJ1939Dm1Failrs_as[78].dtc_as[4].fmi_u8 "" UBYTE CnvRule_NumberOneToOne 1 0 0 255 ECU_ADDRESS 0x700180F0 /end MEASUREMENT
/begin MEASUREMENT dataJ1939Dm1Failrs_as[78].dtc_as[4].occ_u8 "" UBYTE CnvRule_NumberOneToOne 1 0 0 255 ECU_ADDRESS 0x700180F1 /end MEASUREMENT
/begin MEASUREMENT dataJ1939Dm1Failrs_as[78].dtc_as[5].spn_u32 "" ULONG CnvRule_NumberOneToOne 1 0 0 4294967295 ECU_ADDRESS 0x700180F4 /end MEASUREMENT
/begin MEASUREMENT dataJ1939Dm1Failrs_as[78].dtc_as[5].fmi_u8 "" UBYTE CnvRule_NumberOneToOne 1 0 0 255 ECU_ADDRESS 0x700180F8 /end MEASUREMENT
/begin MEASUREMENT dataJ1939Dm1Failrs_as[78].dtc_as[5].occ_u8 "" UBYTE CnvRule_NumberOneToOne 1 0 0 255 ECU_ADDRESS 0x700180F9 /end MEASUREMENT
/begin MEASUREMENT dataJ1939Dm1Failrs_as[78].dtc_as[6].spn_u32 "" ULONG CnvRule_NumberOneToOne 1 0 0 4294967295 ECU_ADDRESS 0x700180FC /end MEASUREMENT
/begin MEASUREMENT dataJ1939Dm1Failrs_as[78].dtc_as[6].fmi_u8 "" UBYTE CnvRule_NumberOneToOne 1 0 0 255 ECU_ADDRESS 0x70018100 /end MEASUREMENT
/begin MEASUREMENT dataJ1939Dm1Failrs_as[78].dtc_as[6].occ_u8 "" UBYTE CnvRule_NumberOneToOne 1 0 0 255 ECU_ADDRESS 0x70018101 /end MEASUREMENT
/begin MEASUREMENT dataJ1939Dm1Failrs_as[78].dtc_as[7].spn_u32 "" ULONG CnvRule_NumberOneToOne 1 0 0 4294967295 ECU_ADDRESS 0x70018104 /end MEASUREMENT
/begin MEASUREMENT dataJ1939Dm1Failrs_as[78].dtc_as[7].fmi_u8 "" UBYTE CnvRule_NumberOneToOne 1 0 0 255 ECU_ADDRESS 0x70018108 /end MEASUREMENT
/begin MEASUREMENT dataJ1939Dm1Failrs_as[78].dtc_as[7].occ_u8 "" UBYTE CnvRule_NumberOneToOne 1 0 0 255 ECU_ADDRESS 0x70018109 /end MEASUREMENT
/begin MEASUREMENT dataJ1939Dm1Failrs_as[78].dtc_as[8].spn_u32 "" ULONG CnvRule_NumberOneToOne 1 0 0 4294967295 ECU_ADDRESS 0x7001810C /end MEASUREMENT
/begin MEASUREMENT dataJ1939Dm1Failrs_as[78].dtc_as[8].fmi_u8 "" UBYTE CnvRule_NumberOneToOne 1 0 0 255 ECU_ADDRESS 0x70018110 /end MEASUREMENT
/begin MEASUREMENT dataJ1939Dm1Failrs_as[78].dtc_as[8].occ_u8 "" UBYTE CnvRule_NumberOneToOne 1 0 0 255 ECU_ADDRESS 0x70018111 /end MEASUREMENT
/begin MEASUREMENT dataJ1939Dm1Failrs_as[78].dtc_as[9].spn_u32 "" ULONG CnvRule_NumberOneToOne 1 0 0 4294967295 ECU_ADDRESS 0x70018114 /end MEASUREMENT
/begin MEASUREMENT dataJ1939Dm1Failrs_as[78].dtc_as[9].fmi_u8 "" UBYTE CnvRule_NumberOneToOne 1 0 0 255 ECU_ADDRESS 0x70018118 /end MEASUREMENT
/begin MEASUREMENT dataJ1939Dm1Failrs_as[78].dtc_as[9].occ_u8 "" UBYTE CnvRule_NumberOneToOne 1 0 0 255 ECU_ADDRESS 0x70018119 /end MEASUREMENT
/begin MEASUREMENT dataJ1939Dm1Failrs_as[78].dtc_as[10].spn_u32 "" ULONG CnvRule_NumberOneToOne 1 0 0 4294967295 ECU_ADDRESS 0x7001811C /end MEASUREMENT
/begin MEASUREMENT dataJ1939Dm1Failrs_as[78].dtc_as[10].fmi_u8 "" UBYTE CnvRule_NumberOneToOne 1 0 0 255 ECU_ADDRESS 0x70018120 /end MEASUREMENT
/begin MEASUREMENT dataJ1939Dm1Failrs_as[78].dtc_as[10].occ_u8 "" UBYTE CnvRule_NumberOneToOne 1 0 0 255 ECU_ADDRESS 0x70018121 /end MEASUREMENT
/begin MEASUREMENT dataJ1939Dm1Failrs_as[78].dtc_as[11].spn_u32 "" ULONG CnvRule_NumberOneToOne 1 0 0 4294967295 ECU_ADDRESS 0x70018124 /end MEASUREMENT
/begin MEASUREMENT dataJ1939Dm1Failrs_as[78].dtc_as[11].fmi_u8 "" UBYTE CnvRule_NumberOneToOne 1 0 0 255 ECU_ADDRESS 0x70018128 /end MEASUREMENT
/begin MEASUREMENT dataJ1939Dm1Failrs_as[78].dtc_as[11].occ_u8 "" UBYTE CnvRule_NumberOneToOne 1 0 0 255 ECU_ADDRESS 0x70018129 /end MEASUREMENT
/begin MEASUREMENT dataJ1939Dm1Failrs_as[78].dtc_as[12].spn_u32 "" ULONG CnvRule_NumberOneToOne 1 0 0 4294967295 ECU_ADDRESS 0x7001812C /end MEASUREMENT
/begin MEASUREMENT dataJ1939Dm1Failrs_as[78].dtc_as[12].fmi_u8 "" UBYTE CnvRule_NumberOneToOne 1 0 0 255 ECU_ADDRESS 0x70018130 /end MEASUREMENT
/begin MEASUREMENT dataJ1939Dm1Failrs_as[78].dtc_as[12].occ_u8 "" UBYTE CnvRule_NumberOneToOne 1 0 0 255 ECU_ADDRESS 0x70018131 /end MEASUREMENT
/begin MEASUREMENT dataJ1939Dm1Failrs_as[78].dtc_as[13].spn_u32 "" ULONG CnvRule_NumberOneToOne 1 0 0 4294967295 ECU_ADDRESS 0x70018134 /end MEASUREMENT
/begin MEASUREMENT dataJ1939Dm1Failrs_as[78].dtc_as[13].fmi_u8 "" UBYTE CnvRule_NumberOneToOne 1 0 0 255 ECU_ADDRESS 0x70018138 /end MEASUREMENT
/begin MEASUREMENT dataJ1939Dm1Failrs_as[78].dtc_as[13].occ_u8 "" UBYTE CnvRule_NumberOneToOne 1 0 0 255 ECU_ADDRESS 0x70018139 /end MEASUREMENT
/begin MEASUREMENT dataJ1939Dm1Failrs_as[78].dtc_as[14].spn_u32 "" ULONG CnvRule_NumberOneToOne 1 0 0 4294967295 ECU_ADDRESS 0x7001813C /end MEASUREMENT
/begin MEASUREMENT dataJ1939Dm1Failrs_as[78].dtc_as[14].fmi_u8 "" UBYTE CnvRule_NumberOneToOne 1 0 0 255 ECU_ADDRESS 0x70018140 /end MEASUREMENT
/begin MEASUREMENT dataJ1939Dm1Failrs_as[78].dtc_as[14].occ_u8 "" UBYTE CnvRule_NumberOneToOne 1 0 0 255 ECU_ADDRESS 0x70018141 /end MEASUREMENT
/begin MEASUREMENT dataJ1939Dm1Failrs_as[78].dtc_as[15].spn_u32 "" ULONG CnvRule_NumberOneToOne 1 0 0 4294967295 ECU_ADDRESS 0x70018144 /end MEASUREMENT
/begin MEASUREMENT dataJ1939Dm1Failrs_as[78].dtc_as[15].fmi_u8 "" UBYTE CnvRule_NumberOneToOne 1 0 0 255 ECU_ADDRESS 0x70018148 /end MEASUREMENT
/begin MEASUREMENT dataJ1939Dm1Failrs_as[78].dtc_as[15].occ_u8 "" UBYTE CnvRule_NumberOneToOne 1 0 0 255 ECU_ADDRESS 0x70018149 /end MEASUREMENT
/begin MEASUREMENT dataJ1939Dm1Failrs_as[78].dtc_as[16].spn_u32 "" ULONG CnvRule_NumberOneToOne 1 0 0 4294967295 ECU_ADDRESS 0x7001814C /end MEASUREMENT
/begin MEASUREMENT dataJ1939Dm1Failrs_as[78].dtc_as[16].fmi_u8 "" UBYTE CnvRule_NumberOneToOne 1 0 0 255 ECU_ADDRESS 0x70018150 /end MEASUREMENT
/begin MEASUREMENT dataJ1939Dm1Failrs_as[78].dtc_as[16].occ_u8 "" UBYTE CnvRule_NumberOneToOne 1 0 0 255 ECU_ADDRESS 0x70018151 /end MEASUREMENT
/begin MEASUREMENT dataJ1939Dm1Failrs_as[78].dtc_as[17].spn_u32 "" ULONG CnvRule_NumberOneToOne 1 0 0 4294967295 ECU_ADDRESS 0x70018154 /end MEASUREMENT
/begin MEASUREMENT dataJ1939Dm1Failrs_as[78].dtc_as[17].fmi_u8 "" UBYTE CnvRule_NumberOneToOne 1 0 0 255 ECU_ADDRESS 0x70018158 /end MEASUREMENT
/begin MEASUREMENT dataJ1939Dm1Failrs_as[78].dtc_as[17].occ_u8 "" UBYTE CnvRule_NumberOneToOne 1 0 0 255 ECU_ADDRESS 0x70018159 /end MEASUREMENT
/begin MEASUREMENT dataJ1939Dm1Failrs_as[78].dtc_as[18].spn_u32 "" ULONG CnvRule_NumberOneToOne 1 0 0 4294967295 ECU_ADDRESS 0x7001815C /end MEASUREMENT
/begin MEASUREMENT dataJ1939Dm1Failrs_as[78].dtc_as[18].fmi_u8 "" UBYTE CnvRule_NumberOneToOne 1 0 0 255 ECU_ADDRESS 0x70018160 /end MEASUREMENT
/begin MEASUREMENT dataJ1939Dm1Failrs_as[78].dtc_as[18].occ_u8 "" UBYTE CnvRule_NumberOneToOne 1 0 0 255 ECU_ADDRESS 0x70018161 /end MEASUREMENT
/begin MEASUREMENT dataJ1939Dm1Failrs_as[78].dtc_as[19].spn_u32 "" ULONG CnvRule_NumberOneToOne 1 0 0 4294967295 ECU_ADDRESS 0x70018164 /end MEASUREMENT
/begin MEASUREMENT dataJ1939Dm1Failrs_as[78].dtc_as[19].fmi_u8 "" UBYTE CnvRule_NumberOneToOne 1 0 0 255 ECU_ADDRESS 0x70018168 /end MEASUREMENT
/begin MEASUREMENT dataJ1939Dm1Failrs_as[78].dtc_as[19].occ_u8 "" UBYTE CnvRule_NumberOneToOne 1 0 0 255 ECU_ADDRESS 0x70018169 /end MEASUREMENT
/begin MEASUREMENT dataJ1939Dm1Failrs_as[78].dtc_as[20].spn_u32 "" ULONG CnvRule_NumberOneToOne 1 0 0 4294967295 ECU_ADDRESS 0x7001816C /end MEASUREMENT
/begin MEASUREMENT dataJ1939Dm1Failrs_as[78].dtc_as[20].fmi_u8 "" UBYTE CnvRule_NumberOneToOne 1 0 0 255 ECU_ADDRESS 0x70018170 /end MEASUREMENT
/begin MEASUREMENT dataJ1939Dm1Failrs_as[78].dtc_as[20].occ_u8 "" UBYTE CnvRule_NumberOneToOne 1 0 0 255 ECU_ADDRESS 0x70018171 /end MEASUREMENT
/begin MEASUREMENT dataJ1939Dm1Failrs_as[78].dtc_as "" UBYTE CnvRule_NumberOneToOne 1 0 0 255 ECU_ADDRESS 0x700180D4 ARRAY_SIZE 160 /end MEASUREMENT
/begin MEASUREMENT dataJ1939Dm1Failrs_as[79].dtc_as[1].spn_u32 "" ULONG CnvRule_NumberOneToOne 1 0 0 4294967295 ECU_ADDRESS 0x70018178 /end MEASUREMENT
/begin MEASUREMENT dataJ1939Dm1Failrs_as[79].dtc_as[1].fmi_u8 "" UBYTE CnvRule_NumberOneToOne 1 0 0 255 ECU_ADDRESS 0x7001817C /end MEASUREMENT
/begin MEASUREMENT dataJ1939Dm1Failrs_as[79].dtc_as[1].occ_u8 "" UBYTE CnvRule_NumberOneToOne 1 0 0 255 ECU_ADDRESS 0x7001817D /end MEASUREMENT
/begin MEASUREMENT dataJ1939Dm1Failrs_as[79].dtc_as[2].spn_u32 "" ULONG CnvRule_NumberOneToOne 1 0 0 4294967295 ECU_ADDRESS 0x70018180 /end MEASUREMENT
/begin MEASUREMENT dataJ1939Dm1Failrs_as[79].dtc_as[2].fmi_u8 "" UBYTE CnvRule_NumberOneToOne 1 0 0 255 ECU_ADDRESS 0x70018184 /end MEASUREMENT
/begin MEASUREMENT dataJ1939Dm1Failrs_as[79].dtc_as[2].occ_u8 "" UBYTE CnvRule_NumberOneToOne 1 0 0 255 ECU_ADDRESS 0x70018185 /end MEASUREMENT
/begin MEASUREMENT dataJ1939Dm1Failrs_as[79].dtc_as[3].spn_u32 "" ULONG CnvRule_NumberOneToOne 1 0 0 4294967295 ECU_ADDRESS 0x70018188 /end MEASUREMENT
/begin MEASUREMENT dataJ1939Dm1Failrs_as[79].dtc_as[3].fmi_u8 "" UBYTE CnvRule_NumberOneToOne 1 0 0 255 ECU_ADDRESS 0x7001818C /end MEASUREMENT
/begin MEASUREMENT dataJ1939Dm1Failrs_as[79].dtc_as[3].occ_u8 "" UBYTE CnvRule_NumberOneToOne 1 0 0 255 ECU_ADDRESS 0x7001818D /end MEASUREMENT
/begin MEASUREMENT dataJ1939Dm1Failrs_as[79].dtc_as[4].spn_u32 "" ULONG CnvRule_NumberOneToOne 1 0 0 4294967295 ECU_ADDRESS 0x70018190 /end MEASUREMENT
/begin MEASUREMENT dataJ1939Dm1Failrs_as[79].dtc_as[4].fmi_u8 "" UBYTE CnvRule_NumberOneToOne 1 0 0 255 ECU_ADDRESS 0x70018194 /end MEASUREMENT
/begin MEASUREMENT dataJ1939Dm1Failrs_as[79].dtc_as[4].occ_u8 "" UBYTE CnvRule_NumberOneToOne 1 0 0 255 ECU_ADDRESS 0x70018195 /end MEASUREMENT
/begin MEASUREMENT dataJ1939Dm1Failrs_as[79].dtc_as[5].spn_u32 "" ULONG CnvRule_NumberOneToOne 1 0 0 4294967295 ECU_ADDRESS 0x70018198 /end MEASUREMENT
/begin MEASUREMENT dataJ1939Dm1Failrs_as[79].dtc_as[5].fmi_u8 "" UBYTE CnvRule_NumberOneToOne 1 0 0 255 ECU_ADDRESS 0x7001819C /end MEASUREMENT
/begin MEASUREMENT dataJ1939Dm1Failrs_as[79].dtc_as[5].occ_u8 "" UBYTE CnvRule_NumberOneToOne 1 0 0 255 ECU_ADDRESS 0x7001819D /end MEASUREMENT
/begin MEASUREMENT dataJ1939Dm1Failrs_as[79].dtc_as[6].spn_u32 "" ULONG CnvRule_NumberOneToOne 1 0 0 4294967295 ECU_ADDRESS 0x700181A0 /end MEASUREMENT
/begin MEASUREMENT dataJ1939Dm1Failrs_as[79].dtc_as[6].fmi_u8 "" UBYTE CnvRule_NumberOneToOne 1 0 0 255 ECU_ADDRESS 0x700181A4 /end MEASUREMENT
/begin MEASUREMENT dataJ1939Dm1Failrs_as[79].dtc_as[6].occ_u8 "" UBYTE CnvRule_NumberOneToOne 1 0 0 255 ECU_ADDRESS 0x700181A5 /end MEASUREMENT
/begin MEASUREMENT dataJ1939Dm1Failrs_as[79].dtc_as[7].spn_u32 "" ULONG CnvRule_NumberOneToOne 1 0 0 4294967295 ECU_ADDRESS 0x700181A8 /end MEASUREMENT
/begin MEASUREMENT dataJ1939Dm1Failrs_as[79].dtc_as[7].fmi_u8 "" UBYTE CnvRule_NumberOneToOne 1 0 0 255 ECU_ADDRESS 0x700181AC /end MEASUREMENT
/begin MEASUREMENT dataJ1939Dm1Failrs_as[79].dtc_as[7].occ_u8 "" UBYTE CnvRule_NumberOneToOne 1 0 0 255 ECU_ADDRESS 0x700181AD /end MEASUREMENT
/begin MEASUREMENT dataJ1939Dm1Failrs_as[79].dtc_as[8].spn_u32 "" ULONG CnvRule_NumberOneToOne 1 0 0 4294967295 ECU_ADDRESS 0x700181B0 /end MEASUREMENT
/begin MEASUREMENT dataJ1939Dm1Failrs_as[79].dtc_as[8].fmi_u8 "" UBYTE CnvRule_NumberOneToOne 1 0 0 255 ECU_ADDRESS 0x700181B4 /end MEASUREMENT
/begin MEASUREMENT dataJ1939Dm1Failrs_as[79].dtc_as[8].occ_u8 "" UBYTE CnvRule_NumberOneToOne 1 0 0 255 ECU_ADDRESS 0x700181B5 /end MEASUREMENT
/begin MEASUREMENT dataJ1939Dm1Failrs_as[79].dtc_as[9].spn_u32 "" ULONG CnvRule_NumberOneToOne 1 0 0 4294967295 ECU_ADDRESS 0x700181B8 /end MEASUREMENT
/begin MEASUREMENT dataJ1939Dm1Failrs_as[79].dtc_as[9].fmi_u8 "" UBYTE CnvRule_NumberOneToOne 1 0 0 255 ECU_ADDRESS 0x700181BC /end MEASUREMENT
/begin MEASUREMENT dataJ1939Dm1Failrs_as[79].dtc_as[9].occ_u8 "" UBYTE CnvRule_NumberOneToOne 1 0 0 255 ECU_ADDRESS 0x700181BD /end MEASUREMENT
/begin MEASUREMENT dataJ1939Dm1Failrs_as[79].dtc_as[10].spn_u32 "" ULONG CnvRule_NumberOneToOne 1 0 0 4294967295 ECU_ADDRESS 0x700181C0 /end MEASUREMENT
/begin MEASUREMENT dataJ1939Dm1Failrs_as[79].dtc_as[10].fmi_u8 "" UBYTE CnvRule_NumberOneToOne 1 0 0 255 ECU_ADDRESS 0x700181C4 /end MEASUREMENT
/begin MEASUREMENT dataJ1939Dm1Failrs_as[79].dtc_as[10].occ_u8 "" UBYTE CnvRule_NumberOneToOne 1 0 0 255 ECU_ADDRESS 0x700181C5 /end MEASUREMENT
/begin MEASUREMENT dataJ1939Dm1Failrs_as[79].dtc_as[11].spn_u32 "" ULONG CnvRule_NumberOneToOne 1 0 0 4294967295 ECU_ADDRESS 0x700181C8 /end MEASUREMENT
/begin MEASUREMENT dataJ1939Dm1Failrs_as[79].dtc_as[11].fmi_u8 "" UBYTE CnvRule_NumberOneToOne 1 0 0 255 ECU_ADDRESS 0x700181CC /end MEASUREMENT
/begin MEASUREMENT dataJ1939Dm1Failrs_as[79].dtc_as[11].occ_u8 "" UBYTE CnvRule_NumberOneToOne 1 0 0 255 ECU_ADDRESS 0x700181CD /end MEASUREMENT
/begin MEASUREMENT dataJ1939Dm1Failrs_as[79].dtc_as[12].spn_u32 "" ULONG CnvRule_NumberOneToOne 1 0 0 4294967295 ECU_ADDRESS 0x700181D0 /end MEASUREMENT
/begin MEASUREMENT dataJ1939Dm1Failrs_as[79].dtc_as[12].fmi_u8 "" UBYTE CnvRule_NumberOneToOne 1 0 0 255 ECU_ADDRESS 0x700181D4 /end MEASUREMENT
/begin MEASUREMENT dataJ1939Dm1Failrs_as[79].dtc_as[12].occ_u8 "" UBYTE CnvRule_NumberOneToOne 1 0 0 255 ECU_ADDRESS 0x700181D5 /end MEASUREMENT
/begin MEASUREMENT dataJ1939Dm1Failrs_as[79].dtc_as[13].spn_u32 "" ULONG CnvRule_NumberOneToOne 1 0 0 4294967295 ECU_ADDRESS 0x700181D8 /end MEASUREMENT
/begin MEASUREMENT dataJ1939Dm1Failrs_as[79].dtc_as[13].fmi_u8 "" UBYTE CnvRule_NumberOneToOne 1 0 0 255 ECU_ADDRESS 0x700181DC /end MEASUREMENT
/begin MEASUREMENT dataJ1939Dm1Failrs_as[79].dtc_as[13].occ_u8 "" UBYTE CnvRule_NumberOneToOne 1 0 0 255 ECU_ADDRESS 0x700181DD /end MEASUREMENT
/begin MEASUREMENT dataJ1939Dm1Failrs_as[79].dtc_as[14].spn_u32 "" ULONG CnvRule_NumberOneToOne 1 0 0 4294967295 ECU_ADDRESS 0x700181E0 /end MEASUREMENT
/begin MEASUREMENT dataJ1939Dm1Failrs_as[79].dtc_as[14].fmi_u8 "" UBYTE CnvRule_NumberOneToOne 1 0 0 255 ECU_ADDRESS 0x700181E4 /end MEASUREMENT
/begin MEASUREMENT dataJ1939Dm1Failrs_as[79].dtc_as[14].occ_u8 "" UBYTE CnvRule_NumberOneToOne 1 0 0 255 ECU_ADDRESS 0x700181E5 /end MEASUREMENT
/begin MEASUREMENT dataJ1939Dm1Failrs_as[79].dtc_as[15].spn_u32 "" ULONG CnvRule_NumberOneToOne 1 0 0 4294967295 ECU_ADDRESS 0x700181E8 /end MEASUREMENT
/begin MEASUREMENT dataJ1939Dm1Failrs_as[79].dtc_as[15].fmi_u8 "" UBYTE CnvRule_NumberOneToOne 1 0 0 255 ECU_ADDRESS 0x700181EC /end MEASUREMENT
/begin MEASUREMENT dataJ1939Dm1Failrs_as[79].dtc_as[15].occ_u8 "" UBYTE CnvRule_NumberOneToOne 1 0 0 255 ECU_ADDRESS 0x700181ED /end MEASUREMENT
/begin MEASUREMENT dataJ1939Dm1Failrs_as[79].dtc_as[16].spn_u32 "" ULONG CnvRule_NumberOneToOne 1 0 0 4294967295 ECU_ADDRESS 0x700181F0 /end MEASUREMENT
/begin MEASUREMENT dataJ1939Dm1Failrs_as[79].dtc_as[16].fmi_u8 "" UBYTE CnvRule_NumberOneToOne 1 0 0 255 ECU_ADDRESS 0x700181F4 /end MEASUREMENT
/begin MEASUREMENT dataJ1939Dm1Failrs_as[79].dtc_as[16].occ_u8 "" UBYTE CnvRule_NumberOneToOne 1 0 0 255 ECU_ADDRESS 0x700181F5 /end MEASUREMENT
/begin MEASUREMENT dataJ1939Dm1Failrs_as[79].dtc_as[17].spn_u32 "" ULONG CnvRule_NumberOneToOne 1 0 0 4294967295 ECU_ADDRESS 0x700181F8 /end MEASUREMENT
/begin MEASUREMENT dataJ1939Dm1Failrs_as[79].dtc_as[17].fmi_u8 "" UBYTE CnvRule_NumberOneToOne 1 0 0 255 ECU_ADDRESS 0x700181FC /end MEASUREMENT
/begin MEASUREMENT dataJ1939Dm1Failrs_as[79].dtc_as[17].occ_u8 "" UBYTE CnvRule_NumberOneToOne 1 0 0 255 ECU_ADDRESS 0x700181FD /end MEASUREMENT
/begin MEASUREMENT dataJ1939Dm1Failrs_as[79].dtc_as[18].spn_u32 "" ULONG CnvRule_NumberOneToOne 1 0 0 4294967295 ECU_ADDRESS 0x70018200 /end MEASUREMENT
/begin MEASUREMENT dataJ1939Dm1Failrs_as[79].dtc_as[18].fmi_u8 "" UBYTE CnvRule_NumberOneToOne 1 0 0 255 ECU_ADDRESS 0x70018204 /end MEASUREMENT
/begin MEASUREMENT dataJ1939Dm1Failrs_as[79].dtc_as[18].occ_u8 "" UBYTE CnvRule_NumberOneToOne 1 0 0 255 ECU_ADDRESS 0x70018205 /end MEASUREMENT
/begin MEASUREMENT dataJ1939Dm1Failrs_as[79].dtc_as[19].spn_u32 "" ULONG CnvRule_NumberOneToOne 1 0 0 4294967295 ECU_ADDRESS 0x70018208 /end MEASUREMENT
/begin MEASUREMENT dataJ1939Dm1Failrs_as[79].dtc_as[19].fmi_u8 "" UBYTE CnvRule_NumberOneToOne 1 0 0 255 ECU_ADDRESS 0x7001820C /end MEASUREMENT
/begin MEASUREMENT dataJ1939Dm1Failrs_as[79].dtc_as[19].occ_u8 "" UBYTE CnvRule_NumberOneToOne 1 0 0 255 ECU_ADDRESS 0x7001820D /end MEASUREMENT
/begin MEASUREMENT dataJ1939Dm1Failrs_as[79].dtc_as[20].spn_u32 "" ULONG CnvRule_NumberOneToOne 1 0 0 4294967295 ECU_ADDRESS 0x70018210 /end MEASUREMENT
/begin MEASUREMENT dataJ1939Dm1Failrs_as[79].dtc_as[20].fmi_u8 "" UBYTE CnvRule_NumberOneToOne 1 0 0 255 ECU_ADDRESS 0x70018214 /end MEASUREMENT
/begin MEASUREMENT dataJ1939Dm1Failrs_as[79].dtc_as[20].occ_u8 "" UBYTE CnvRule_NumberOneToOne 1 0 0 255 ECU_ADDRESS 0x70018215 /end MEASUREMENT
/begin MEASUREMENT dataJ1939Dm1Failrs_as[79].dtc_as "" UBYTE CnvRule_NumberOneToOne 1 0 0 255 ECU_ADDRESS 0x70018178 ARRAY_SIZE 160 /end MEASUREMENT
/begin MEASUREMENT dataJ1939Dm1Failrs_as[80].dtc_as[1].spn_u32 "" ULONG CnvRule_NumberOneToOne 1 0 0 4294967295 ECU_ADDRESS 0x7001821C /end MEASUREMENT
/begin MEASUREMENT dataJ1939Dm1Failrs_as[80].dtc_as[1].fmi_u8 "" UBYTE CnvRule_NumberOneToOne 1 0 0 255 ECU_ADDRESS 0x70018220 /end MEASUREMENT
/begin MEASUREMENT dataJ1939Dm1Failrs_as[80].dtc_as[1].occ_u8 "" UBYTE CnvRule_NumberOneToOne 1 0 0 255 ECU_ADDRESS 0x70018221 /end MEASUREMENT
/begin MEASUREMENT dataJ1939Dm1Failrs_as[80].dtc_as[2].spn_u32 "" ULONG CnvRule_NumberOneToOne 1 0 0 4294967295 ECU_ADDRESS 0x70018224 /end MEASUREMENT
/begin MEASUREMENT dataJ1939Dm1Failrs_as[80].dtc_as[2].fmi_u8 "" UBYTE CnvRule_NumberOneToOne 1 0 0 255 ECU_ADDRESS 0x70018228 /end MEASUREMENT
/begin MEASUREMENT dataJ1939Dm1Failrs_as[80].dtc_as[2].occ_u8 "" UBYTE CnvRule_NumberOneToOne 1 0 0 255 ECU_ADDRESS 0x70018229 /end MEASUREMENT
/begin MEASUREMENT dataJ1939Dm1Failrs_as[80].dtc_as[3].spn_u32 "" ULONG CnvRule_NumberOneToOne 1 0 0 4294967295 ECU_ADDRESS 0x7001822C /end MEASUREMENT
/begin MEASUREMENT dataJ1939Dm1Failrs_as[80].dtc_as[3].fmi_u8 "" UBYTE CnvRule_NumberOneToOne 1 0 0 255 ECU_ADDRESS 0x70018230 /end MEASUREMENT
/begin MEASUREMENT dataJ1939Dm1Failrs_as[80].dtc_as[3].occ_u8 "" UBYTE CnvRule_NumberOneToOne 1 0 0 255 ECU_ADDRESS 0x70018231 /end MEASUREMENT
/begin MEASUREMENT dataJ1939Dm1Failrs_as[80].dtc_as[4].spn_u32 "" ULONG CnvRule_NumberOneToOne 1 0 0 4294967295 ECU_ADDRESS 0x70018234 /end MEASUREMENT
/begin MEASUREMENT dataJ1939Dm1Failrs_as[80].dtc_as[4].fmi_u8 "" UBYTE CnvRule_NumberOneToOne 1 0 0 255 ECU_ADDRESS 0x70018238 /end MEASUREMENT
/begin MEASUREMENT dataJ1939Dm1Failrs_as[80].dtc_as[4].occ_u8 "" UBYTE CnvRule_NumberOneToOne 1 0 0 255 ECU_ADDRESS 0x70018239 /end MEASUREMENT
/begin MEASUREMENT dataJ1939Dm1Failrs_as[80].dtc_as[5].spn_u32 "" ULONG CnvRule_NumberOneToOne 1 0 0 4294967295 ECU_ADDRESS 0x7001823C /end MEASUREMENT
/begin MEASUREMENT dataJ1939Dm1Failrs_as[80].dtc_as[5].fmi_u8 "" UBYTE CnvRule_NumberOneToOne 1 0 0 255 ECU_ADDRESS 0x70018240 /end MEASUREMENT
/begin MEASUREMENT dataJ1939Dm1Failrs_as[80].dtc_as[5].occ_u8 "" UBYTE CnvRule_NumberOneToOne 1 0 0 255 ECU_ADDRESS 0x70018241 /end MEASUREMENT
/begin MEASUREMENT dataJ1939Dm1Failrs_as[80].dtc_as[6].spn_u32 "" ULONG CnvRule_NumberOneToOne 1 0 0 4294967295 ECU_ADDRESS 0x70018244 /end MEASUREMENT
/begin MEASUREMENT dataJ1939Dm1Failrs_as[80].dtc_as[6].fmi_u8 "" UBYTE CnvRule_NumberOneToOne 1 0 0 255 ECU_ADDRESS 0x70018248 /end MEASUREMENT
/begin MEASUREMENT dataJ1939Dm1Failrs_as[80].dtc_as[6].occ_u8 "" UBYTE CnvRule_NumberOneToOne 1 0 0 255 ECU_ADDRESS 0x70018249 /end MEASUREMENT
/begin MEASUREMENT dataJ1939Dm1Failrs_as[80].dtc_as[7].spn_u32 "" ULONG CnvRule_NumberOneToOne 1 0 0 4294967295 ECU_ADDRESS 0x7001824C /end MEASUREMENT
/begin MEASUREMENT dataJ1939Dm1Failrs_as[80].dtc_as[7].fmi_u8 "" UBYTE CnvRule_NumberOneToOne 1 0 0 255 ECU_ADDRESS 0x70018250 /end MEASUREMENT
/begin MEASUREMENT dataJ1939Dm1Failrs_as[80].dtc_as[7].occ_u8 "" UBYTE CnvRule_NumberOneToOne 1 0 0 255 ECU_ADDRESS 0x70018251 /end MEASUREMENT
/begin MEASUREMENT dataJ1939Dm1Failrs_as[80].dtc_as[8].spn_u32 "" ULONG CnvRule_NumberOneToOne 1 0 0 4294967295 ECU_ADDRESS 0x70018254 /end MEASUREMENT
/begin MEASUREMENT dataJ1939Dm1Failrs_as[80].dtc_as[8].fmi_u8 "" UBYTE CnvRule_NumberOneToOne 1 0 0 255 ECU_ADDRESS 0x70018258 /end MEASUREMENT
/begin MEASUREMENT dataJ1939Dm1Failrs_as[80].dtc_as[8].occ_u8 "" UBYTE CnvRule_NumberOneToOne 1 0 0 255 ECU_ADDRESS 0x70018259 /end MEASUREMENT
/begin MEASUREMENT dataJ1939Dm1Failrs_as[80].dtc_as[9].spn_u32 "" ULONG CnvRule_NumberOneToOne 1 0 0 4294967295 ECU_ADDRESS 0x7001825C /end MEASUREMENT
/begin MEASUREMENT dataJ1939Dm1Failrs_as[80].dtc_as[9].fmi_u8 "" UBYTE CnvRule_NumberOneToOne 1 0 0 255 ECU_ADDRESS 0x70018260 /end MEASUREMENT
/begin MEASUREMENT dataJ1939Dm1Failrs_as[80].dtc_as[9].occ_u8 "" UBYTE CnvRule_NumberOneToOne 1 0 0 255 ECU_ADDRESS 0x70018261 /end MEASUREMENT
/begin MEASUREMENT dataJ1939Dm1Failrs_as[80].dtc_as[10].spn_u32 "" ULONG CnvRule_NumberOneToOne 1 0 0 4294967295 ECU_ADDRESS 0x70018264 /end MEASUREMENT
/begin MEASUREMENT dataJ1939Dm1Failrs_as[80].dtc_as[10].fmi_u8 "" UBYTE CnvRule_NumberOneToOne 1 0 0 255 ECU_ADDRESS 0x70018268 /end MEASUREMENT
/begin MEASUREMENT dataJ1939Dm1Failrs_as[80].dtc_as[10].occ_u8 "" UBYTE CnvRule_NumberOneToOne 1 0 0 255 ECU_ADDRESS 0x70018269 /end MEASUREMENT
/begin MEASUREMENT dataJ1939Dm1Failrs_as[80].dtc_as[11].spn_u32 "" ULONG CnvRule_NumberOneToOne 1 0 0 4294967295 ECU_ADDRESS 0x7001826C /end MEASUREMENT
/begin MEASUREMENT dataJ1939Dm1Failrs_as[80].dtc_as[11].fmi_u8 "" UBYTE CnvRule_NumberOneToOne 1 0 0 255 ECU_ADDRESS 0x70018270 /end MEASUREMENT
/begin MEASUREMENT dataJ1939Dm1Failrs_as[80].dtc_as[11].occ_u8 "" UBYTE CnvRule_NumberOneToOne 1 0 0 255 ECU_ADDRESS 0x70018271 /end MEASUREMENT
/begin MEASUREMENT dataJ1939Dm1Failrs_as[80].dtc_as[12].spn_u32 "" ULONG CnvRule_NumberOneToOne 1 0 0 4294967295 ECU_ADDRESS 0x70018274 /end MEASUREMENT
/begin MEASUREMENT dataJ1939Dm1Failrs_as[80].dtc_as[12].fmi_u8 "" UBYTE CnvRule_NumberOneToOne 1 0 0 255 ECU_ADDRESS 0x70018278 /end MEASUREMENT
/begin MEASUREMENT dataJ1939Dm1Failrs_as[80].dtc_as[12].occ_u8 "" UBYTE CnvRule_NumberOneToOne 1 0 0 255 ECU_ADDRESS 0x70018279 /end MEASUREMENT
/begin MEASUREMENT dataJ1939Dm1Failrs_as[80].dtc_as[13].spn_u32 "" ULONG CnvRule_NumberOneToOne 1 0 0 4294967295 ECU_ADDRESS 0x7001827C /end MEASUREMENT
/begin MEASUREMENT dataJ1939Dm1Failrs_as[80].dtc_as[13].fmi_u8 "" UBYTE CnvRule_NumberOneToOne 1 0 0 255 ECU_ADDRESS 0x70018280 /end MEASUREMENT
/begin MEASUREMENT dataJ1939Dm1Failrs_as[80].dtc_as[13].occ_u8 "" UBYTE CnvRule_NumberOneToOne 1 0 0 255 ECU_ADDRESS 0x70018281 /end MEASUREMENT
/begin MEASUREMENT dataJ1939Dm1Failrs_as[80].dtc_as[14].spn_u32 "" ULONG CnvRule_NumberOneToOne 1 0 0 4294967295 ECU_ADDRESS 0x70018284 /end MEASUREMENT
/begin MEASUREMENT dataJ1939Dm1Failrs_as[80].dtc_as[14].fmi_u8 "" UBYTE CnvRule_NumberOneToOne 1 0 0 255 ECU_ADDRESS 0x70018288 /end MEASUREMENT
/begin MEASUREMENT dataJ1939Dm1Failrs_as[80].dtc_as[14].occ_u8 "" UBYTE CnvRule_NumberOneToOne 1 0 0 255 ECU_ADDRESS 0x70018289 /end MEASUREMENT
/begin MEASUREMENT dataJ1939Dm1Failrs_as[80].dtc_as[15].spn_u32 "" ULONG CnvRule_NumberOneToOne 1 0 0 4294967295 ECU_ADDRESS 0x7001828C /end MEASUREMENT
/begin MEASUREMENT dataJ1939Dm1Failrs_as[80].dtc_as[15].fmi_u8 "" UBYTE CnvRule_NumberOneToOne 1 0 0 255 ECU_ADDRESS 0x70018290 /end MEASUREMENT
/begin MEASUREMENT dataJ1939Dm1Failrs_as[80].dtc_as[15].occ_u8 "" UBYTE CnvRule_NumberOneToOne 1 0 0 255 ECU_ADDRESS 0x70018291 /end MEASUREMENT
/begin MEASUREMENT dataJ1939Dm1Failrs_as[80].dtc_as[16].spn_u32 "" ULONG CnvRule_NumberOneToOne 1 0 0 4294967295 ECU_ADDRESS 0x70018294 /end MEASUREMENT
/begin MEASUREMENT dataJ1939Dm1Failrs_as[80].dtc_as[16].fmi_u8 "" UBYTE CnvRule_NumberOneToOne 1 0 0 255 ECU_ADDRESS 0x70018298 /end MEASUREMENT
/begin MEASUREMENT dataJ1939Dm1Failrs_as[80].dtc_as[16].occ_u8 "" UBYTE CnvRule_NumberOneToOne 1 0 0 255 ECU_ADDRESS 0x70018299 /end MEASUREMENT
/begin MEASUREMENT dataJ1939Dm1Failrs_as[80].dtc_as[17].spn_u32 "" ULONG CnvRule_NumberOneToOne 1 0 0 4294967295 ECU_ADDRESS 0x7001829C /end MEASUREMENT
/begin MEASUREMENT dataJ1939Dm1Failrs_as[80].dtc_as[17].fmi_u8 "" UBYTE CnvRule_NumberOneToOne 1 0 0 255 ECU_ADDRESS 0x700182A0 /end MEASUREMENT
/begin MEASUREMENT dataJ1939Dm1Failrs_as[80].dtc_as[17].occ_u8 "" UBYTE CnvRule_NumberOneToOne 1 0 0 255 ECU_ADDRESS 0x700182A1 /end MEASUREMENT
/begin MEASUREMENT dataJ1939Dm1Failrs_as[80].dtc_as[18].spn_u32 "" ULONG CnvRule_NumberOneToOne 1 0 0 4294967295 ECU_ADDRESS 0x700182A4 /end MEASUREMENT
/begin MEASUREMENT dataJ1939Dm1Failrs_as[80].dtc_as[18].fmi_u8 "" UBYTE CnvRule_NumberOneToOne 1 0 0 255 ECU_ADDRESS 0x700182A8 /end MEASUREMENT
/begin MEASUREMENT dataJ1939Dm1Failrs_as[80].dtc_as[18].occ_u8 "" UBYTE CnvRule_NumberOneToOne 1 0 0 255 ECU_ADDRESS 0x700182A9 /end MEASUREMENT
/begin MEASUREMENT dataJ1939Dm1Failrs_as[80].dtc_as[19].spn_u32 "" ULONG CnvRule_NumberOneToOne 1 0 0 4294967295 ECU_ADDRESS 0x700182AC /end MEASUREMENT
/begin MEASUREMENT dataJ1939Dm1Failrs_as[80].dtc_as[19].fmi_u8 "" UBYTE CnvRule_NumberOneToOne 1 0 0 255 ECU_ADDRESS 0x700182B0 /end MEASUREMENT
/begin MEASUREMENT dataJ1939Dm1Failrs_as[80].dtc_as[19].occ_u8 "" UBYTE CnvRule_NumberOneToOne 1 0 0 255 ECU_ADDRESS 0x700182B1 /end MEASUREMENT
/begin MEASUREMENT dataJ1939Dm1Failrs_as[80].dtc_as[20].spn_u32 "" ULONG CnvRule_NumberOneToOne 1 0 0 4294967295 ECU_ADDRESS 0x700182B4 /end MEASUREMENT
/begin MEASUREMENT dataJ1939Dm1Failrs_as[80].dtc_as[20].fmi_u8 "" UBYTE CnvRule_NumberOneToOne 1 0 0 255 ECU_ADDRESS 0x700182B8 /end MEASUREMENT
/begin MEASUREMENT dataJ1939Dm1Failrs_as[80].dtc_as[20].occ_u8 "" UBYTE CnvRule_NumberOneToOne 1 0 0 255 ECU_ADDRESS 0x700182B9 /end MEASUREMENT
/begin MEASUREMENT dataJ1939Dm1Failrs_as[80].dtc_as "" UBYTE CnvRule_NumberOneToOne 1 0 0 255 ECU_ADDRESS 0x7001821C ARRAY_SIZE 160 /end MEASUREMENT
/begin MEASUREMENT dataJ1939Dm1Failrs_as[81].dtc_as[1].spn_u32 "" ULONG CnvRule_NumberOneToOne 1 0 0 4294967295 ECU_ADDRESS 0x700182C0 /end MEASUREMENT
/begin MEASUREMENT dataJ1939Dm1Failrs_as[81].dtc_as[1].fmi_u8 "" UBYTE CnvRule_NumberOneToOne 1 0 0 255 ECU_ADDRESS 0x700182C4 /end MEASUREMENT
/begin MEASUREMENT dataJ1939Dm1Failrs_as[81].dtc_as[1].occ_u8 "" UBYTE CnvRule_NumberOneToOne 1 0 0 255 ECU_ADDRESS 0x700182C5 /end MEASUREMENT
/begin MEASUREMENT dataJ1939Dm1Failrs_as[81].dtc_as[2].spn_u32 "" ULONG CnvRule_NumberOneToOne 1 0 0 4294967295 ECU_ADDRESS 0x700182C8 /end MEASUREMENT
/begin MEASUREMENT dataJ1939Dm1Failrs_as[81].dtc_as[2].fmi_u8 "" UBYTE CnvRule_NumberOneToOne 1 0 0 255 ECU_ADDRESS 0x700182CC /end MEASUREMENT
/begin MEASUREMENT dataJ1939Dm1Failrs_as[81].dtc_as[2].occ_u8 "" UBYTE CnvRule_NumberOneToOne 1 0 0 255 ECU_ADDRESS 0x700182CD /end MEASUREMENT
/begin MEASUREMENT dataJ1939Dm1Failrs_as[81].dtc_as[3].spn_u32 "" ULONG CnvRule_NumberOneToOne 1 0 0 4294967295 ECU_ADDRESS 0x700182D0 /end MEASUREMENT
/begin MEASUREMENT dataJ1939Dm1Failrs_as[81].dtc_as[3].fmi_u8 "" UBYTE CnvRule_NumberOneToOne 1 0 0 255 ECU_ADDRESS 0x700182D4 /end MEASUREMENT
/begin MEASUREMENT dataJ1939Dm1Failrs_as[81].dtc_as[3].occ_u8 "" UBYTE CnvRule_NumberOneToOne 1 0 0 255 ECU_ADDRESS 0x700182D5 /end MEASUREMENT
/begin MEASUREMENT dataJ1939Dm1Failrs_as[81].dtc_as[4].spn_u32 "" ULONG CnvRule_NumberOneToOne 1 0 0 4294967295 ECU_ADDRESS 0x700182D8 /end MEASUREMENT
/begin MEASUREMENT dataJ1939Dm1Failrs_as[81].dtc_as[4].fmi_u8 "" UBYTE CnvRule_NumberOneToOne 1 0 0 255 ECU_ADDRESS 0x700182DC /end MEASUREMENT
/begin MEASUREMENT dataJ1939Dm1Failrs_as[81].dtc_as[4].occ_u8 "" UBYTE CnvRule_NumberOneToOne 1 0 0 255 ECU_ADDRESS 0x700182DD /end MEASUREMENT
/begin MEASUREMENT dataJ1939Dm1Failrs_as[81].dtc_as[5].spn_u32 "" ULONG CnvRule_NumberOneToOne 1 0 0 4294967295 ECU_ADDRESS 0x700182E0 /end MEASUREMENT
/begin MEASUREMENT dataJ1939Dm1Failrs_as[81].dtc_as[5].fmi_u8 "" UBYTE CnvRule_NumberOneToOne 1 0 0 255 ECU_ADDRESS 0x700182E4 /end MEASUREMENT
/begin MEASUREMENT dataJ1939Dm1Failrs_as[81].dtc_as[5].occ_u8 "" UBYTE CnvRule_NumberOneToOne 1 0 0 255 ECU_ADDRESS 0x700182E5 /end MEASUREMENT
/begin MEASUREMENT dataJ1939Dm1Failrs_as[81].dtc_as[6].spn_u32 "" ULONG CnvRule_NumberOneToOne 1 0 0 4294967295 ECU_ADDRESS 0x700182E8 /end MEASUREMENT
/begin MEASUREMENT dataJ1939Dm1Failrs_as[81].dtc_as[6].fmi_u8 "" UBYTE CnvRule_NumberOneToOne 1 0 0 255 ECU_ADDRESS 0x700182EC /end MEASUREMENT
/begin MEASUREMENT dataJ1939Dm1Failrs_as[81].dtc_as[6].occ_u8 "" UBYTE CnvRule_NumberOneToOne 1 0 0 255 ECU_ADDRESS 0x700182ED /end MEASUREMENT
/begin MEASUREMENT dataJ1939Dm1Failrs_as[81].dtc_as[7].spn_u32 "" ULONG CnvRule_NumberOneToOne 1 0 0 4294967295 ECU_ADDRESS 0x700182F0 /end MEASUREMENT
/begin MEASUREMENT dataJ1939Dm1Failrs_as[81].dtc_as[7].fmi_u8 "" UBYTE CnvRule_NumberOneToOne 1 0 0 255 ECU_ADDRESS 0x700182F4 /end MEASUREMENT
/begin MEASUREMENT dataJ1939Dm1Failrs_as[81].dtc_as[7].occ_u8 "" UBYTE CnvRule_NumberOneToOne 1 0 0 255 ECU_ADDRESS 0x700182F5 /end MEASUREMENT
/begin MEASUREMENT dataJ1939Dm1Failrs_as[81].dtc_as[8].spn_u32 "" ULONG CnvRule_NumberOneToOne 1 0 0 4294967295 ECU_ADDRESS 0x700182F8 /end MEASUREMENT
/begin MEASUREMENT dataJ1939Dm1Failrs_as[81].dtc_as[8].fmi_u8 "" UBYTE CnvRule_NumberOneToOne 1 0 0 255 ECU_ADDRESS 0x700182FC /end MEASUREMENT
/begin MEASUREMENT dataJ1939Dm1Failrs_as[81].dtc_as[8].occ_u8 "" UBYTE CnvRule_NumberOneToOne 1 0 0 255 ECU_ADDRESS 0x700182FD /end MEASUREMENT
/begin MEASUREMENT dataJ1939Dm1Failrs_as[81].dtc_as[9].spn_u32 "" ULONG CnvRule_NumberOneToOne 1 0 0 4294967295 ECU_ADDRESS 0x70018300 /end MEASUREMENT
/begin MEASUREMENT dataJ1939Dm1Failrs_as[81].dtc_as[9].fmi_u8 "" UBYTE CnvRule_NumberOneToOne 1 0 0 255 ECU_ADDRESS 0x70018304 /end MEASUREMENT
/begin MEASUREMENT dataJ1939Dm1Failrs_as[81].dtc_as[9].occ_u8 "" UBYTE CnvRule_NumberOneToOne 1 0 0 255 ECU_ADDRESS 0x70018305 /end MEASUREMENT
/begin MEASUREMENT dataJ1939Dm1Failrs_as[81].dtc_as[10].spn_u32 "" ULONG CnvRule_NumberOneToOne 1 0 0 4294967295 ECU_ADDRESS 0x70018308 /end MEASUREMENT
/begin MEASUREMENT dataJ1939Dm1Failrs_as[81].dtc_as[10].fmi_u8 "" UBYTE CnvRule_NumberOneToOne 1 0 0 255 ECU_ADDRESS 0x7001830C /end MEASUREMENT
/begin MEASUREMENT dataJ1939Dm1Failrs_as[81].dtc_as[10].occ_u8 "" UBYTE CnvRule_NumberOneToOne 1 0 0 255 ECU_ADDRESS 0x7001830D /end MEASUREMENT
/begin MEASUREMENT dataJ1939Dm1Failrs_as[81].dtc_as[11].spn_u32 "" ULONG CnvRule_NumberOneToOne 1 0 0 4294967295 ECU_ADDRESS 0x70018310 /end MEASUREMENT
/begin MEASUREMENT dataJ1939Dm1Failrs_as[81].dtc_as[11].fmi_u8 "" UBYTE CnvRule_NumberOneToOne 1 0 0 255 ECU_ADDRESS 0x70018314 /end MEASUREMENT
/begin MEASUREMENT dataJ1939Dm1Failrs_as[81].dtc_as[11].occ_u8 "" UBYTE CnvRule_NumberOneToOne 1 0 0 255 ECU_ADDRESS 0x70018315 /end MEASUREMENT
/begin MEASUREMENT dataJ1939Dm1Failrs_as[81].dtc_as[12].spn_u32 "" ULONG CnvRule_NumberOneToOne 1 0 0 4294967295 ECU_ADDRESS 0x70018318 /end MEASUREMENT
/begin MEASUREMENT dataJ1939Dm1Failrs_as[81].dtc_as[12].fmi_u8 "" UBYTE CnvRule_NumberOneToOne 1 0 0 255 ECU_ADDRESS 0x7001831C /end MEASUREMENT
/begin MEASUREMENT dataJ1939Dm1Failrs_as[81].dtc_as[12].occ_u8 "" UBYTE CnvRule_NumberOneToOne 1 0 0 255 ECU_ADDRESS 0x7001831D /end MEASUREMENT
/begin MEASUREMENT dataJ1939Dm1Failrs_as[81].dtc_as[13].spn_u32 "" ULONG CnvRule_NumberOneToOne 1 0 0 4294967295 ECU_ADDRESS 0x70018320 /end MEASUREMENT
/begin MEASUREMENT dataJ1939Dm1Failrs_as[81].dtc_as[13].fmi_u8 "" UBYTE CnvRule_NumberOneToOne 1 0 0 255 ECU_ADDRESS 0x70018324 /end MEASUREMENT
/begin MEASUREMENT dataJ1939Dm1Failrs_as[81].dtc_as[13].occ_u8 "" UBYTE CnvRule_NumberOneToOne 1 0 0 255 ECU_ADDRESS 0x70018325 /end MEASUREMENT
/begin MEASUREMENT dataJ1939Dm1Failrs_as[81].dtc_as[14].spn_u32 "" ULONG CnvRule_NumberOneToOne 1 0 0 4294967295 ECU_ADDRESS 0x70018328 /end MEASUREMENT
/begin MEASUREMENT dataJ1939Dm1Failrs_as[81].dtc_as[14].fmi_u8 "" UBYTE CnvRule_NumberOneToOne 1 0 0 255 ECU_ADDRESS 0x7001832C /end MEASUREMENT
/begin MEASUREMENT dataJ1939Dm1Failrs_as[81].dtc_as[14].occ_u8 "" UBYTE CnvRule_NumberOneToOne 1 0 0 255 ECU_ADDRESS 0x7001832D /end MEASUREMENT
/begin MEASUREMENT dataJ1939Dm1Failrs_as[81].dtc_as[15].spn_u32 "" ULONG CnvRule_NumberOneToOne 1 0 0 4294967295 ECU_ADDRESS 0x70018330 /end MEASUREMENT
/begin MEASUREMENT dataJ1939Dm1Failrs_as[81].dtc_as[15].fmi_u8 "" UBYTE CnvRule_NumberOneToOne 1 0 0 255 ECU_ADDRESS 0x70018334 /end MEASUREMENT
/begin MEASUREMENT dataJ1939Dm1Failrs_as[81].dtc_as[15].occ_u8 "" UBYTE CnvRule_NumberOneToOne 1 0 0 255 ECU_ADDRESS 0x70018335 /end MEASUREMENT
/begin MEASUREMENT dataJ1939Dm1Failrs_as[81].dtc_as[16].spn_u32 "" ULONG CnvRule_NumberOneToOne 1 0 0 4294967295 ECU_ADDRESS 0x70018338 /end MEASUREMENT
/begin MEASUREMENT dataJ1939Dm1Failrs_as[81].dtc_as[16].fmi_u8 "" UBYTE CnvRule_NumberOneToOne 1 0 0 255 ECU_ADDRESS 0x7001833C /end MEASUREMENT
/begin MEASUREMENT dataJ1939Dm1Failrs_as[81].dtc_as[16].occ_u8 "" UBYTE CnvRule_NumberOneToOne 1 0 0 255 ECU_ADDRESS 0x7001833D /end MEASUREMENT
/begin MEASUREMENT dataJ1939Dm1Failrs_as[81].dtc_as[17].spn_u32 "" ULONG CnvRule_NumberOneToOne 1 0 0 4294967295 ECU_ADDRESS 0x70018340 /end MEASUREMENT
/begin MEASUREMENT dataJ1939Dm1Failrs_as[81].dtc_as[17].fmi_u8 "" UBYTE CnvRule_NumberOneToOne 1 0 0 255 ECU_ADDRESS 0x70018344 /end MEASUREMENT
/begin MEASUREMENT dataJ1939Dm1Failrs_as[81].dtc_as[17].occ_u8 "" UBYTE CnvRule_NumberOneToOne 1 0 0 255 ECU_ADDRESS 0x70018345 /end MEASUREMENT
/begin MEASUREMENT dataJ1939Dm1Failrs_as[81].dtc_as[18].spn_u32 "" ULONG CnvRule_NumberOneToOne 1 0 0 4294967295 ECU_ADDRESS 0x70018348 /end MEASUREMENT
/begin MEASUREMENT dataJ1939Dm1Failrs_as[81].dtc_as[18].fmi_u8 "" UBYTE CnvRule_NumberOneToOne 1 0 0 255 ECU_ADDRESS 0x7001834C /end MEASUREMENT
/begin MEASUREMENT dataJ1939Dm1Failrs_as[81].dtc_as[18].occ_u8 "" UBYTE CnvRule_NumberOneToOne 1 0 0 255 ECU_ADDRESS 0x7001834D /end MEASUREMENT
/begin MEASUREMENT dataJ1939Dm1Failrs_as[81].dtc_as[19].spn_u32 "" ULONG CnvRule_NumberOneToOne 1 0 0 4294967295 ECU_ADDRESS 0x70018350 /end MEASUREMENT
/begin MEASUREMENT dataJ1939Dm1Failrs_as[81].dtc_as[19].fmi_u8 "" UBYTE CnvRule_NumberOneToOne 1 0 0 255 ECU_ADDRESS 0x70018354 /end MEASUREMENT
/begin MEASUREMENT dataJ1939Dm1Failrs_as[81].dtc_as[19].occ_u8 "" UBYTE CnvRule_NumberOneToOne 1 0 0 255 ECU_ADDRESS 0x70018355 /end MEASUREMENT
/begin MEASUREMENT dataJ1939Dm1Failrs_as[81].dtc_as[20].spn_u32 "" ULONG CnvRule_NumberOneToOne 1 0 0 4294967295 ECU_ADDRESS 0x70018358 /end MEASUREMENT
/begin MEASUREMENT dataJ1939Dm1Failrs_as[81].dtc_as[20].fmi_u8 "" UBYTE CnvRule_NumberOneToOne 1 0 0 255 ECU_ADDRESS 0x7001835C /end MEASUREMENT
/begin MEASUREMENT dataJ1939Dm1Failrs_as[81].dtc_as[20].occ_u8 "" UBYTE CnvRule_NumberOneToOne 1 0 0 255 ECU_ADDRESS 0x7001835D /end MEASUREMENT
/begin MEASUREMENT dataJ1939Dm1Failrs_as[81].dtc_as "" UBYTE CnvRule_NumberOneToOne 1 0 0 255 ECU_ADDRESS 0x700182C0 ARRAY_SIZE 160 /end MEASUREMENT
/begin MEASUREMENT dataJ1939Dm1Failrs_as[82].dtc_as[1].spn_u32 "" ULONG CnvRule_NumberOneToOne 1 0 0 4294967295 ECU_ADDRESS 0x70018364 /end MEASUREMENT
/begin MEASUREMENT dataJ1939Dm1Failrs_as[82].dtc_as[1].fmi_u8 "" UBYTE CnvRule_NumberOneToOne 1 0 0 255 ECU_ADDRESS 0x70018368 /end MEASUREMENT
/begin MEASUREMENT dataJ1939Dm1Failrs_as[82].dtc_as[1].occ_u8 "" UBYTE CnvRule_NumberOneToOne 1 0 0 255 ECU_ADDRESS 0x70018369 /end MEASUREMENT
/begin MEASUREMENT dataJ1939Dm1Failrs_as[82].dtc_as[2].spn_u32 "" ULONG CnvRule_NumberOneToOne 1 0 0 4294967295 ECU_ADDRESS 0x7001836C /end MEASUREMENT
/begin MEASUREMENT dataJ1939Dm1Failrs_as[82].dtc_as[2].fmi_u8 "" UBYTE CnvRule_NumberOneToOne 1 0 0 255 ECU_ADDRESS 0x70018370 /end MEASUREMENT
/begin MEASUREMENT dataJ1939Dm1Failrs_as[82].dtc_as[2].occ_u8 "" UBYTE CnvRule_NumberOneToOne 1 0 0 255 ECU_ADDRESS 0x70018371 /end MEASUREMENT
/begin MEASUREMENT dataJ1939Dm1Failrs_as[82].dtc_as[3].spn_u32 "" ULONG CnvRule_NumberOneToOne 1 0 0 4294967295 ECU_ADDRESS 0x70018374 /end MEASUREMENT
/begin MEASUREMENT dataJ1939Dm1Failrs_as[82].dtc_as[3].fmi_u8 "" UBYTE CnvRule_NumberOneToOne 1 0 0 255 ECU_ADDRESS 0x70018378 /end MEASUREMENT
/begin MEASUREMENT dataJ1939Dm1Failrs_as[82].dtc_as[3].occ_u8 "" UBYTE CnvRule_NumberOneToOne 1 0 0 255 ECU_ADDRESS 0x70018379 /end MEASUREMENT
/begin MEASUREMENT dataJ1939Dm1Failrs_as[82].dtc_as[4].spn_u32 "" ULONG CnvRule_NumberOneToOne 1 0 0 4294967295 ECU_ADDRESS 0x7001837C /end MEASUREMENT
/begin MEASUREMENT dataJ1939Dm1Failrs_as[82].dtc_as[4].fmi_u8 "" UBYTE CnvRule_NumberOneToOne 1 0 0 255 ECU_ADDRESS 0x70018380 /end MEASUREMENT
/begin MEASUREMENT dataJ1939Dm1Failrs_as[82].dtc_as[4].occ_u8 "" UBYTE CnvRule_NumberOneToOne 1 0 0 255 ECU_ADDRESS 0x70018381 /end MEASUREMENT
/begin MEASUREMENT dataJ1939Dm1Failrs_as[82].dtc_as[5].spn_u32 "" ULONG CnvRule_NumberOneToOne 1 0 0 4294967295 ECU_ADDRESS 0x70018384 /end MEASUREMENT
/begin MEASUREMENT dataJ1939Dm1Failrs_as[82].dtc_as[5].fmi_u8 "" UBYTE CnvRule_NumberOneToOne 1 0 0 255 ECU_ADDRESS 0x70018388 /end MEASUREMENT
/begin MEASUREMENT dataJ1939Dm1Failrs_as[82].dtc_as[5].occ_u8 "" UBYTE CnvRule_NumberOneToOne 1 0 0 255 ECU_ADDRESS 0x70018389 /end MEASUREMENT
/begin MEASUREMENT dataJ1939Dm1Failrs_as[82].dtc_as[6].spn_u32 "" ULONG CnvRule_NumberOneToOne 1 0 0 4294967295 ECU_ADDRESS 0x7001838C /end MEASUREMENT
/begin MEASUREMENT dataJ1939Dm1Failrs_as[82].dtc_as[6].fmi_u8 "" UBYTE CnvRule_NumberOneToOne 1 0 0 255 ECU_ADDRESS 0x70018390 /end MEASUREMENT
/begin MEASUREMENT dataJ1939Dm1Failrs_as[82].dtc_as[6].occ_u8 "" UBYTE CnvRule_NumberOneToOne 1 0 0 255 ECU_ADDRESS 0x70018391 /end MEASUREMENT
/begin MEASUREMENT dataJ1939Dm1Failrs_as[82].dtc_as[7].spn_u32 "" ULONG CnvRule_NumberOneToOne 1 0 0 4294967295 ECU_ADDRESS 0x70018394 /end MEASUREMENT
/begin MEASUREMENT dataJ1939Dm1Failrs_as[82].dtc_as[7].fmi_u8 "" UBYTE CnvRule_NumberOneToOne 1 0 0 255 ECU_ADDRESS 0x70018398 /end MEASUREMENT
/begin MEASUREMENT dataJ1939Dm1Failrs_as[82].dtc_as[7].occ_u8 "" UBYTE CnvRule_NumberOneToOne 1 0 0 255 ECU_ADDRESS 0x70018399 /end MEASUREMENT
/begin MEASUREMENT dataJ1939Dm1Failrs_as[82].dtc_as[8].spn_u32 "" ULONG CnvRule_NumberOneToOne 1 0 0 4294967295 ECU_ADDRESS 0x7001839C /end MEASUREMENT
/begin MEASUREMENT dataJ1939Dm1Failrs_as[82].dtc_as[8].fmi_u8 "" UBYTE CnvRule_NumberOneToOne 1 0 0 255 ECU_ADDRESS 0x700183A0 /end MEASUREMENT
/begin MEASUREMENT dataJ1939Dm1Failrs_as[82].dtc_as[8].occ_u8 "" UBYTE CnvRule_NumberOneToOne 1 0 0 255 ECU_ADDRESS 0x700183A1 /end MEASUREMENT
/begin MEASUREMENT dataJ1939Dm1Failrs_as[82].dtc_as[9].spn_u32 "" ULONG CnvRule_NumberOneToOne 1 0 0 4294967295 ECU_ADDRESS 0x700183A4 /end MEASUREMENT
/begin MEASUREMENT dataJ1939Dm1Failrs_as[82].dtc_as[9].fmi_u8 "" UBYTE CnvRule_NumberOneToOne 1 0 0 255 ECU_ADDRESS 0x700183A8 /end MEASUREMENT
/begin MEASUREMENT dataJ1939Dm1Failrs_as[82].dtc_as[9].occ_u8 "" UBYTE CnvRule_NumberOneToOne 1 0 0 255 ECU_ADDRESS 0x700183A9 /end MEASUREMENT
/begin MEASUREMENT dataJ1939Dm1Failrs_as[82].dtc_as[10].spn_u32 "" ULONG CnvRule_NumberOneToOne 1 0 0 4294967295 ECU_ADDRESS 0x700183AC /end MEASUREMENT
/begin MEASUREMENT dataJ1939Dm1Failrs_as[82].dtc_as[10].fmi_u8 "" UBYTE CnvRule_NumberOneToOne 1 0 0 255 ECU_ADDRESS 0x700183B0 /end MEASUREMENT
/begin MEASUREMENT dataJ1939Dm1Failrs_as[82].dtc_as[10].occ_u8 "" UBYTE CnvRule_NumberOneToOne 1 0 0 255 ECU_ADDRESS 0x700183B1 /end MEASUREMENT
/begin MEASUREMENT dataJ1939Dm1Failrs_as[82].dtc_as[11].spn_u32 "" ULONG CnvRule_NumberOneToOne 1 0 0 4294967295 ECU_ADDRESS 0x700183B4 /end MEASUREMENT
/begin MEASUREMENT dataJ1939Dm1Failrs_as[82].dtc_as[11].fmi_u8 "" UBYTE CnvRule_NumberOneToOne 1 0 0 255 ECU_ADDRESS 0x700183B8 /end MEASUREMENT
/begin MEASUREMENT dataJ1939Dm1Failrs_as[82].dtc_as[11].occ_u8 "" UBYTE CnvRule_NumberOneToOne 1 0 0 255 ECU_ADDRESS 0x700183B9 /end MEASUREMENT
/begin MEASUREMENT dataJ1939Dm1Failrs_as[82].dtc_as[12].spn_u32 "" ULONG CnvRule_NumberOneToOne 1 0 0 4294967295 ECU_ADDRESS 0x700183BC /end MEASUREMENT
/begin MEASUREMENT dataJ1939Dm1Failrs_as[82].dtc_as[12].fmi_u8 "" UBYTE CnvRule_NumberOneToOne 1 0 0 255 ECU_ADDRESS 0x700183C0 /end MEASUREMENT
/begin MEASUREMENT dataJ1939Dm1Failrs_as[82].dtc_as[12].occ_u8 "" UBYTE CnvRule_NumberOneToOne 1 0 0 255 ECU_ADDRESS 0x700183C1 /end MEASUREMENT
/begin MEASUREMENT dataJ1939Dm1Failrs_as[82].dtc_as[13].spn_u32 "" ULONG CnvRule_NumberOneToOne 1 0 0 4294967295 ECU_ADDRESS 0x700183C4 /end MEASUREMENT
/begin MEASUREMENT dataJ1939Dm1Failrs_as[82].dtc_as[13].fmi_u8 "" UBYTE CnvRule_NumberOneToOne 1 0 0 255 ECU_ADDRESS 0x700183C8 /end MEASUREMENT
/begin MEASUREMENT dataJ1939Dm1Failrs_as[82].dtc_as[13].occ_u8 "" UBYTE CnvRule_NumberOneToOne 1 0 0 255 ECU_ADDRESS 0x700183C9 /end MEASUREMENT
/begin MEASUREMENT dataJ1939Dm1Failrs_as[82].dtc_as[14].spn_u32 "" ULONG CnvRule_NumberOneToOne 1 0 0 4294967295 ECU_ADDRESS 0x700183CC /end MEASUREMENT
/begin MEASUREMENT dataJ1939Dm1Failrs_as[82].dtc_as[14].fmi_u8 "" UBYTE CnvRule_NumberOneToOne 1 0 0 255 ECU_ADDRESS 0x700183D0 /end MEASUREMENT
/begin MEASUREMENT dataJ1939Dm1Failrs_as[82].dtc_as[14].occ_u8 "" UBYTE CnvRule_NumberOneToOne 1 0 0 255 ECU_ADDRESS 0x700183D1 /end MEASUREMENT
/begin MEASUREMENT dataJ1939Dm1Failrs_as[82].dtc_as[15].spn_u32 "" ULONG CnvRule_NumberOneToOne 1 0 0 4294967295 ECU_ADDRESS 0x700183D4 /end MEASUREMENT
/begin MEASUREMENT dataJ1939Dm1Failrs_as[82].dtc_as[15].fmi_u8 "" UBYTE CnvRule_NumberOneToOne 1 0 0 255 ECU_ADDRESS 0x700183D8 /end MEASUREMENT
/begin MEASUREMENT dataJ1939Dm1Failrs_as[82].dtc_as[15].occ_u8 "" UBYTE CnvRule_NumberOneToOne 1 0 0 255 ECU_ADDRESS 0x700183D9 /end MEASUREMENT
/begin MEASUREMENT dataJ1939Dm1Failrs_as[82].dtc_as[16].spn_u32 "" ULONG CnvRule_NumberOneToOne 1 0 0 4294967295 ECU_ADDRESS 0x700183DC /end MEASUREMENT
/begin MEASUREMENT dataJ1939Dm1Failrs_as[82].dtc_as[16].fmi_u8 "" UBYTE CnvRule_NumberOneToOne 1 0 0 255 ECU_ADDRESS 0x700183E0 /end MEASUREMENT
/begin MEASUREMENT dataJ1939Dm1Failrs_as[82].dtc_as[16].occ_u8 "" UBYTE CnvRule_NumberOneToOne 1 0 0 255 ECU_ADDRESS 0x700183E1 /end MEASUREMENT
/begin MEASUREMENT dataJ1939Dm1Failrs_as[82].dtc_as[17].spn_u32 "" ULONG CnvRule_NumberOneToOne 1 0 0 4294967295 ECU_ADDRESS 0x700183E4 /end MEASUREMENT
/begin MEASUREMENT dataJ1939Dm1Failrs_as[82].dtc_as[17].fmi_u8 "" UBYTE CnvRule_NumberOneToOne 1 0 0 255 ECU_ADDRESS 0x700183E8 /end MEASUREMENT
/begin MEASUREMENT dataJ1939Dm1Failrs_as[82].dtc_as[17].occ_u8 "" UBYTE CnvRule_NumberOneToOne 1 0 0 255 ECU_ADDRESS 0x700183E9 /end MEASUREMENT
/begin MEASUREMENT dataJ1939Dm1Failrs_as[82].dtc_as[18].spn_u32 "" ULONG CnvRule_NumberOneToOne 1 0 0 4294967295 ECU_ADDRESS 0x700183EC /end MEASUREMENT
/begin MEASUREMENT dataJ1939Dm1Failrs_as[82].dtc_as[18].fmi_u8 "" UBYTE CnvRule_NumberOneToOne 1 0 0 255 ECU_ADDRESS 0x700183F0 /end MEASUREMENT
/begin MEASUREMENT dataJ1939Dm1Failrs_as[82].dtc_as[18].occ_u8 "" UBYTE CnvRule_NumberOneToOne 1 0 0 255 ECU_ADDRESS 0x700183F1 /end MEASUREMENT
/begin MEASUREMENT dataJ1939Dm1Failrs_as[82].dtc_as[19].spn_u32 "" ULONG CnvRule_NumberOneToOne 1 0 0 4294967295 ECU_ADDRESS 0x700183F4 /end MEASUREMENT
/begin MEASUREMENT dataJ1939Dm1Failrs_as[82].dtc_as[19].fmi_u8 "" UBYTE CnvRule_NumberOneToOne 1 0 0 255 ECU_ADDRESS 0x700183F8 /end MEASUREMENT
/begin MEASUREMENT dataJ1939Dm1Failrs_as[82].dtc_as[19].occ_u8 "" UBYTE CnvRule_NumberOneToOne 1 0 0 255 ECU_ADDRESS 0x700183F9 /end MEASUREMENT
/begin MEASUREMENT dataJ1939Dm1Failrs_as[82].dtc_as[20].spn_u32 "" ULONG CnvRule_NumberOneToOne 1 0 0 4294967295 ECU_ADDRESS 0x700183FC /end MEASUREMENT
/begin MEASUREMENT dataJ1939Dm1Failrs_as[82].dtc_as[20].fmi_u8 "" UBYTE CnvRule_NumberOneToOne 1 0 0 255 ECU_ADDRESS 0x70018400 /end MEASUREMENT
/begin MEASUREMENT dataJ1939Dm1Failrs_as[82].dtc_as[20].occ_u8 "" UBYTE CnvRule_NumberOneToOne 1 0 0 255 ECU_ADDRESS 0x70018401 /end MEASUREMENT
/begin MEASUREMENT dataJ1939Dm1Failrs_as[82].dtc_as "" UBYTE CnvRule_NumberOneToOne 1 0 0 255 ECU_ADDRESS 0x70018364 ARRAY_SIZE 160 /end MEASUREMENT
/begin MEASUREMENT dataJ1939Dm1Failrs_as[83].dtc_as[1].spn_u32 "" ULONG CnvRule_NumberOneToOne 1 0 0 4294967295 ECU_ADDRESS 0x70018408 /end MEASUREMENT
/begin MEASUREMENT dataJ1939Dm1Failrs_as[83].dtc_as[1].fmi_u8 "" UBYTE CnvRule_NumberOneToOne 1 0 0 255 ECU_ADDRESS 0x7001840C /end MEASUREMENT
/begin MEASUREMENT dataJ1939Dm1Failrs_as[83].dtc_as[1].occ_u8 "" UBYTE CnvRule_NumberOneToOne 1 0 0 255 ECU_ADDRESS 0x7001840D /end MEASUREMENT
/begin MEASUREMENT dataJ1939Dm1Failrs_as[83].dtc_as[2].spn_u32 "" ULONG CnvRule_NumberOneToOne 1 0 0 4294967295 ECU_ADDRESS 0x70018410 /end MEASUREMENT
/begin MEASUREMENT dataJ1939Dm1Failrs_as[83].dtc_as[2].fmi_u8 "" UBYTE CnvRule_NumberOneToOne 1 0 0 255 ECU_ADDRESS 0x70018414 /end MEASUREMENT
/begin MEASUREMENT dataJ1939Dm1Failrs_as[83].dtc_as[2].occ_u8 "" UBYTE CnvRule_NumberOneToOne 1 0 0 255 ECU_ADDRESS 0x70018415 /end MEASUREMENT
/begin MEASUREMENT dataJ1939Dm1Failrs_as[83].dtc_as[3].spn_u32 "" ULONG CnvRule_NumberOneToOne 1 0 0 4294967295 ECU_ADDRESS 0x70018418 /end MEASUREMENT
/begin MEASUREMENT dataJ1939Dm1Failrs_as[83].dtc_as[3].fmi_u8 "" UBYTE CnvRule_NumberOneToOne 1 0 0 255 ECU_ADDRESS 0x7001841C /end MEASUREMENT
/begin MEASUREMENT dataJ1939Dm1Failrs_as[83].dtc_as[3].occ_u8 "" UBYTE CnvRule_NumberOneToOne 1 0 0 255 ECU_ADDRESS 0x7001841D /end MEASUREMENT
/begin MEASUREMENT dataJ1939Dm1Failrs_as[83].dtc_as[4].spn_u32 "" ULONG CnvRule_NumberOneToOne 1 0 0 4294967295 ECU_ADDRESS 0x70018420 /end MEASUREMENT
/begin MEASUREMENT dataJ1939Dm1Failrs_as[83].dtc_as[4].fmi_u8 "" UBYTE CnvRule_NumberOneToOne 1 0 0 255 ECU_ADDRESS 0x70018424 /end MEASUREMENT
/begin MEASUREMENT dataJ1939Dm1Failrs_as[83].dtc_as[4].occ_u8 "" UBYTE CnvRule_NumberOneToOne 1 0 0 255 ECU_ADDRESS 0x70018425 /end MEASUREMENT
/begin MEASUREMENT dataJ1939Dm1Failrs_as[83].dtc_as[5].spn_u32 "" ULONG CnvRule_NumberOneToOne 1 0 0 4294967295 ECU_ADDRESS 0x70018428 /end MEASUREMENT
/begin MEASUREMENT dataJ1939Dm1Failrs_as[83].dtc_as[5].fmi_u8 "" UBYTE CnvRule_NumberOneToOne 1 0 0 255 ECU_ADDRESS 0x7001842C /end MEASUREMENT
/begin MEASUREMENT dataJ1939Dm1Failrs_as[83].dtc_as[5].occ_u8 "" UBYTE CnvRule_NumberOneToOne 1 0 0 255 ECU_ADDRESS 0x7001842D /end MEASUREMENT
/begin MEASUREMENT dataJ1939Dm1Failrs_as[83].dtc_as[6].spn_u32 "" ULONG CnvRule_NumberOneToOne 1 0 0 4294967295 ECU_ADDRESS 0x70018430 /end MEASUREMENT
/begin MEASUREMENT dataJ1939Dm1Failrs_as[83].dtc_as[6].fmi_u8 "" UBYTE CnvRule_NumberOneToOne 1 0 0 255 ECU_ADDRESS 0x70018434 /end MEASUREMENT
/begin MEASUREMENT dataJ1939Dm1Failrs_as[83].dtc_as[6].occ_u8 "" UBYTE CnvRule_NumberOneToOne 1 0 0 255 ECU_ADDRESS 0x70018435 /end MEASUREMENT
/begin MEASUREMENT dataJ1939Dm1Failrs_as[83].dtc_as[7].spn_u32 "" ULONG CnvRule_NumberOneToOne 1 0 0 4294967295 ECU_ADDRESS 0x70018438 /end MEASUREMENT
/begin MEASUREMENT dataJ1939Dm1Failrs_as[83].dtc_as[7].fmi_u8 "" UBYTE CnvRule_NumberOneToOne 1 0 0 255 ECU_ADDRESS 0x7001843C /end MEASUREMENT
/begin MEASUREMENT dataJ1939Dm1Failrs_as[83].dtc_as[7].occ_u8 "" UBYTE CnvRule_NumberOneToOne 1 0 0 255 ECU_ADDRESS 0x7001843D /end MEASUREMENT
/begin MEASUREMENT dataJ1939Dm1Failrs_as[83].dtc_as[8].spn_u32 "" ULONG CnvRule_NumberOneToOne 1 0 0 4294967295 ECU_ADDRESS 0x70018440 /end MEASUREMENT
/begin MEASUREMENT dataJ1939Dm1Failrs_as[83].dtc_as[8].fmi_u8 "" UBYTE CnvRule_NumberOneToOne 1 0 0 255 ECU_ADDRESS 0x70018444 /end MEASUREMENT
/begin MEASUREMENT dataJ1939Dm1Failrs_as[83].dtc_as[8].occ_u8 "" UBYTE CnvRule_NumberOneToOne 1 0 0 255 ECU_ADDRESS 0x70018445 /end MEASUREMENT
/begin MEASUREMENT dataJ1939Dm1Failrs_as[83].dtc_as[9].spn_u32 "" ULONG CnvRule_NumberOneToOne 1 0 0 4294967295 ECU_ADDRESS 0x70018448 /end MEASUREMENT
/begin MEASUREMENT dataJ1939Dm1Failrs_as[83].dtc_as[9].fmi_u8 "" UBYTE CnvRule_NumberOneToOne 1 0 0 255 ECU_ADDRESS 0x7001844C /end MEASUREMENT
/begin MEASUREMENT dataJ1939Dm1Failrs_as[83].dtc_as[9].occ_u8 "" UBYTE CnvRule_NumberOneToOne 1 0 0 255 ECU_ADDRESS 0x7001844D /end MEASUREMENT
/begin MEASUREMENT dataJ1939Dm1Failrs_as[83].dtc_as[10].spn_u32 "" ULONG CnvRule_NumberOneToOne 1 0 0 4294967295 ECU_ADDRESS 0x70018450 /end MEASUREMENT
/begin MEASUREMENT dataJ1939Dm1Failrs_as[83].dtc_as[10].fmi_u8 "" UBYTE CnvRule_NumberOneToOne 1 0 0 255 ECU_ADDRESS 0x70018454 /end MEASUREMENT
/begin MEASUREMENT dataJ1939Dm1Failrs_as[83].dtc_as[10].occ_u8 "" UBYTE CnvRule_NumberOneToOne 1 0 0 255 ECU_ADDRESS 0x70018455 /end MEASUREMENT
/begin MEASUREMENT dataJ1939Dm1Failrs_as[83].dtc_as[11].spn_u32 "" ULONG CnvRule_NumberOneToOne 1 0 0 4294967295 ECU_ADDRESS 0x70018458 /end MEASUREMENT
/begin MEASUREMENT dataJ1939Dm1Failrs_as[83].dtc_as[11].fmi_u8 "" UBYTE CnvRule_NumberOneToOne 1 0 0 255 ECU_ADDRESS 0x7001845C /end MEASUREMENT
/begin MEASUREMENT dataJ1939Dm1Failrs_as[83].dtc_as[11].occ_u8 "" UBYTE CnvRule_NumberOneToOne 1 0 0 255 ECU_ADDRESS 0x7001845D /end MEASUREMENT
/begin MEASUREMENT dataJ1939Dm1Failrs_as[83].dtc_as[12].spn_u32 "" ULONG CnvRule_NumberOneToOne 1 0 0 4294967295 ECU_ADDRESS 0x70018460 /end MEASUREMENT
/begin MEASUREMENT dataJ1939Dm1Failrs_as[83].dtc_as[12].fmi_u8 "" UBYTE CnvRule_NumberOneToOne 1 0 0 255 ECU_ADDRESS 0x70018464 /end MEASUREMENT
/begin MEASUREMENT dataJ1939Dm1Failrs_as[83].dtc_as[12].occ_u8 "" UBYTE CnvRule_NumberOneToOne 1 0 0 255 ECU_ADDRESS 0x70018465 /end MEASUREMENT
/begin MEASUREMENT dataJ1939Dm1Failrs_as[83].dtc_as[13].spn_u32 "" ULONG CnvRule_NumberOneToOne 1 0 0 4294967295 ECU_ADDRESS 0x70018468 /end MEASUREMENT
/begin MEASUREMENT dataJ1939Dm1Failrs_as[83].dtc_as[13].fmi_u8 "" UBYTE CnvRule_NumberOneToOne 1 0 0 255 ECU_ADDRESS 0x7001846C /end MEASUREMENT
/begin MEASUREMENT dataJ1939Dm1Failrs_as[83].dtc_as[13].occ_u8 "" UBYTE CnvRule_NumberOneToOne 1 0 0 255 ECU_ADDRESS 0x7001846D /end MEASUREMENT
/begin MEASUREMENT dataJ1939Dm1Failrs_as[83].dtc_as[14].spn_u32 "" ULONG CnvRule_NumberOneToOne 1 0 0 4294967295 ECU_ADDRESS 0x70018470 /end MEASUREMENT
/begin MEASUREMENT dataJ1939Dm1Failrs_as[83].dtc_as[14].fmi_u8 "" UBYTE CnvRule_NumberOneToOne 1 0 0 255 ECU_ADDRESS 0x70018474 /end MEASUREMENT
/begin MEASUREMENT dataJ1939Dm1Failrs_as[83].dtc_as[14].occ_u8 "" UBYTE CnvRule_NumberOneToOne 1 0 0 255 ECU_ADDRESS 0x70018475 /end MEASUREMENT
/begin MEASUREMENT dataJ1939Dm1Failrs_as[83].dtc_as[15].spn_u32 "" ULONG CnvRule_NumberOneToOne 1 0 0 4294967295 ECU_ADDRESS 0x70018478 /end MEASUREMENT
/begin MEASUREMENT dataJ1939Dm1Failrs_as[83].dtc_as[15].fmi_u8 "" UBYTE CnvRule_NumberOneToOne 1 0 0 255 ECU_ADDRESS 0x7001847C /end MEASUREMENT
/begin MEASUREMENT dataJ1939Dm1Failrs_as[83].dtc_as[15].occ_u8 "" UBYTE CnvRule_NumberOneToOne 1 0 0 255 ECU_ADDRESS 0x7001847D /end MEASUREMENT
/begin MEASUREMENT dataJ1939Dm1Failrs_as[83].dtc_as[16].spn_u32 "" ULONG CnvRule_NumberOneToOne 1 0 0 4294967295 ECU_ADDRESS 0x70018480 /end MEASUREMENT
/begin MEASUREMENT dataJ1939Dm1Failrs_as[83].dtc_as[16].fmi_u8 "" UBYTE CnvRule_NumberOneToOne 1 0 0 255 ECU_ADDRESS 0x70018484 /end MEASUREMENT
/begin MEASUREMENT dataJ1939Dm1Failrs_as[83].dtc_as[16].occ_u8 "" UBYTE CnvRule_NumberOneToOne 1 0 0 255 ECU_ADDRESS 0x70018485 /end MEASUREMENT
/begin MEASUREMENT dataJ1939Dm1Failrs_as[83].dtc_as[17].spn_u32 "" ULONG CnvRule_NumberOneToOne 1 0 0 4294967295 ECU_ADDRESS 0x70018488 /end MEASUREMENT
/begin MEASUREMENT dataJ1939Dm1Failrs_as[83].dtc_as[17].fmi_u8 "" UBYTE CnvRule_NumberOneToOne 1 0 0 255 ECU_ADDRESS 0x7001848C /end MEASUREMENT
/begin MEASUREMENT dataJ1939Dm1Failrs_as[83].dtc_as[17].occ_u8 "" UBYTE CnvRule_NumberOneToOne 1 0 0 255 ECU_ADDRESS 0x7001848D /end MEASUREMENT
/begin MEASUREMENT dataJ1939Dm1Failrs_as[83].dtc_as[18].spn_u32 "" ULONG CnvRule_NumberOneToOne 1 0 0 4294967295 ECU_ADDRESS 0x70018490 /end MEASUREMENT
/begin MEASUREMENT dataJ1939Dm1Failrs_as[83].dtc_as[18].fmi_u8 "" UBYTE CnvRule_NumberOneToOne 1 0 0 255 ECU_ADDRESS 0x70018494 /end MEASUREMENT
/begin MEASUREMENT dataJ1939Dm1Failrs_as[83].dtc_as[18].occ_u8 "" UBYTE CnvRule_NumberOneToOne 1 0 0 255 ECU_ADDRESS 0x70018495 /end MEASUREMENT
/begin MEASUREMENT dataJ1939Dm1Failrs_as[83].dtc_as[19].spn_u32 "" ULONG CnvRule_NumberOneToOne 1 0 0 4294967295 ECU_ADDRESS 0x70018498 /end MEASUREMENT
/begin MEASUREMENT dataJ1939Dm1Failrs_as[83].dtc_as[19].fmi_u8 "" UBYTE CnvRule_NumberOneToOne 1 0 0 255 ECU_ADDRESS 0x7001849C /end MEASUREMENT
/begin MEASUREMENT dataJ1939Dm1Failrs_as[83].dtc_as[19].occ_u8 "" UBYTE CnvRule_NumberOneToOne 1 0 0 255 ECU_ADDRESS 0x7001849D /end MEASUREMENT
/begin MEASUREMENT dataJ1939Dm1Failrs_as[83].dtc_as[20].spn_u32 "" ULONG CnvRule_NumberOneToOne 1 0 0 4294967295 ECU_ADDRESS 0x700184A0 /end MEASUREMENT
/begin MEASUREMENT dataJ1939Dm1Failrs_as[83].dtc_as[20].fmi_u8 "" UBYTE CnvRule_NumberOneToOne 1 0 0 255 ECU_ADDRESS 0x700184A4 /end MEASUREMENT
/begin MEASUREMENT dataJ1939Dm1Failrs_as[83].dtc_as[20].occ_u8 "" UBYTE CnvRule_NumberOneToOne 1 0 0 255 ECU_ADDRESS 0x700184A5 /end MEASUREMENT
/begin MEASUREMENT dataJ1939Dm1Failrs_as[83].dtc_as "" UBYTE CnvRule_NumberOneToOne 1 0 0 255 ECU_ADDRESS 0x70018408 ARRAY_SIZE 160 /end MEASUREMENT
/begin MEASUREMENT dataJ1939Dm1Failrs_as[84].dtc_as[1].spn_u32 "" ULONG CnvRule_NumberOneToOne 1 0 0 4294967295 ECU_ADDRESS 0x700184AC /end MEASUREMENT
/begin MEASUREMENT dataJ1939Dm1Failrs_as[84].dtc_as[1].fmi_u8 "" UBYTE CnvRule_NumberOneToOne 1 0 0 255 ECU_ADDRESS 0x700184B0 /end MEASUREMENT
/begin MEASUREMENT dataJ1939Dm1Failrs_as[84].dtc_as[1].occ_u8 "" UBYTE CnvRule_NumberOneToOne 1 0 0 255 ECU_ADDRESS 0x700184B1 /end MEASUREMENT
/begin MEASUREMENT dataJ1939Dm1Failrs_as[84].dtc_as[2].spn_u32 "" ULONG CnvRule_NumberOneToOne 1 0 0 4294967295 ECU_ADDRESS 0x700184B4 /end MEASUREMENT
/begin MEASUREMENT dataJ1939Dm1Failrs_as[84].dtc_as[2].fmi_u8 "" UBYTE CnvRule_NumberOneToOne 1 0 0 255 ECU_ADDRESS 0x700184B8 /end MEASUREMENT
/begin MEASUREMENT dataJ1939Dm1Failrs_as[84].dtc_as[2].occ_u8 "" UBYTE CnvRule_NumberOneToOne 1 0 0 255 ECU_ADDRESS 0x700184B9 /end MEASUREMENT
/begin MEASUREMENT dataJ1939Dm1Failrs_as[84].dtc_as[3].spn_u32 "" ULONG CnvRule_NumberOneToOne 1 0 0 4294967295 ECU_ADDRESS 0x700184BC /end MEASUREMENT
/begin MEASUREMENT dataJ1939Dm1Failrs_as[84].dtc_as[3].fmi_u8 "" UBYTE CnvRule_NumberOneToOne 1 0 0 255 ECU_ADDRESS 0x700184C0 /end MEASUREMENT
/begin MEASUREMENT dataJ1939Dm1Failrs_as[84].dtc_as[3].occ_u8 "" UBYTE CnvRule_NumberOneToOne 1 0 0 255 ECU_ADDRESS 0x700184C1 /end MEASUREMENT
/begin MEASUREMENT dataJ1939Dm1Failrs_as[84].dtc_as[4].spn_u32 "" ULONG CnvRule_NumberOneToOne 1 0 0 4294967295 ECU_ADDRESS 0x700184C4 /end MEASUREMENT
/begin MEASUREMENT dataJ1939Dm1Failrs_as[84].dtc_as[4].fmi_u8 "" UBYTE CnvRule_NumberOneToOne 1 0 0 255 ECU_ADDRESS 0x700184C8 /end MEASUREMENT
/begin MEASUREMENT dataJ1939Dm1Failrs_as[84].dtc_as[4].occ_u8 "" UBYTE CnvRule_NumberOneToOne 1 0 0 255 ECU_ADDRESS 0x700184C9 /end MEASUREMENT
/begin MEASUREMENT dataJ1939Dm1Failrs_as[84].dtc_as[5].spn_u32 "" ULONG CnvRule_NumberOneToOne 1 0 0 4294967295 ECU_ADDRESS 0x700184CC /end MEASUREMENT
/begin MEASUREMENT dataJ1939Dm1Failrs_as[84].dtc_as[5].fmi_u8 "" UBYTE CnvRule_NumberOneToOne 1 0 0 255 ECU_ADDRESS 0x700184D0 /end MEASUREMENT
/begin MEASUREMENT dataJ1939Dm1Failrs_as[84].dtc_as[5].occ_u8 "" UBYTE CnvRule_NumberOneToOne 1 0 0 255 ECU_ADDRESS 0x700184D1 /end MEASUREMENT
/begin MEASUREMENT dataJ1939Dm1Failrs_as[84].dtc_as[6].spn_u32 "" ULONG CnvRule_NumberOneToOne 1 0 0 4294967295 ECU_ADDRESS 0x700184D4 /end MEASUREMENT
/begin MEASUREMENT dataJ1939Dm1Failrs_as[84].dtc_as[6].fmi_u8 "" UBYTE CnvRule_NumberOneToOne 1 0 0 255 ECU_ADDRESS 0x700184D8 /end MEASUREMENT
/begin MEASUREMENT dataJ1939Dm1Failrs_as[84].dtc_as[6].occ_u8 "" UBYTE CnvRule_NumberOneToOne 1 0 0 255 ECU_ADDRESS 0x700184D9 /end MEASUREMENT
/begin MEASUREMENT dataJ1939Dm1Failrs_as[84].dtc_as[7].spn_u32 "" ULONG CnvRule_NumberOneToOne 1 0 0 4294967295 ECU_ADDRESS 0x700184DC /end MEASUREMENT
/begin MEASUREMENT dataJ1939Dm1Failrs_as[84].dtc_as[7].fmi_u8 "" UBYTE CnvRule_NumberOneToOne 1 0 0 255 ECU_ADDRESS 0x700184E0 /end MEASUREMENT
/begin MEASUREMENT dataJ1939Dm1Failrs_as[84].dtc_as[7].occ_u8 "" UBYTE CnvRule_NumberOneToOne 1 0 0 255 ECU_ADDRESS 0x700184E1 /end MEASUREMENT
/begin MEASUREMENT dataJ1939Dm1Failrs_as[84].dtc_as[8].spn_u32 "" ULONG CnvRule_NumberOneToOne 1 0 0 4294967295 ECU_ADDRESS 0x700184E4 /end MEASUREMENT
/begin MEASUREMENT dataJ1939Dm1Failrs_as[84].dtc_as[8].fmi_u8 "" UBYTE CnvRule_NumberOneToOne 1 0 0 255 ECU_ADDRESS 0x700184E8 /end MEASUREMENT
/begin MEASUREMENT dataJ1939Dm1Failrs_as[84].dtc_as[8].occ_u8 "" UBYTE CnvRule_NumberOneToOne 1 0 0 255 ECU_ADDRESS 0x700184E9 /end MEASUREMENT
/begin MEASUREMENT dataJ1939Dm1Failrs_as[84].dtc_as[9].spn_u32 "" ULONG CnvRule_NumberOneToOne 1 0 0 4294967295 ECU_ADDRESS 0x700184EC /end MEASUREMENT
/begin MEASUREMENT dataJ1939Dm1Failrs_as[84].dtc_as[9].fmi_u8 "" UBYTE CnvRule_NumberOneToOne 1 0 0 255 ECU_ADDRESS 0x700184F0 /end MEASUREMENT
/begin MEASUREMENT dataJ1939Dm1Failrs_as[84].dtc_as[9].occ_u8 "" UBYTE CnvRule_NumberOneToOne 1 0 0 255 ECU_ADDRESS 0x700184F1 /end MEASUREMENT
/begin MEASUREMENT dataJ1939Dm1Failrs_as[84].dtc_as[10].spn_u32 "" ULONG CnvRule_NumberOneToOne 1 0 0 4294967295 ECU_ADDRESS 0x700184F4 /end MEASUREMENT
/begin MEASUREMENT dataJ1939Dm1Failrs_as[84].dtc_as[10].fmi_u8 "" UBYTE CnvRule_NumberOneToOne 1 0 0 255 ECU_ADDRESS 0x700184F8 /end MEASUREMENT
/begin MEASUREMENT dataJ1939Dm1Failrs_as[84].dtc_as[10].occ_u8 "" UBYTE CnvRule_NumberOneToOne 1 0 0 255 ECU_ADDRESS 0x700184F9 /end MEASUREMENT
/begin MEASUREMENT dataJ1939Dm1Failrs_as[84].dtc_as[11].spn_u32 "" ULONG CnvRule_NumberOneToOne 1 0 0 4294967295 ECU_ADDRESS 0x700184FC /end MEASUREMENT
/begin MEASUREMENT dataJ1939Dm1Failrs_as[84].dtc_as[11].fmi_u8 "" UBYTE CnvRule_NumberOneToOne 1 0 0 255 ECU_ADDRESS 0x70018500 /end MEASUREMENT
/begin MEASUREMENT dataJ1939Dm1Failrs_as[84].dtc_as[11].occ_u8 "" UBYTE CnvRule_NumberOneToOne 1 0 0 255 ECU_ADDRESS 0x70018501 /end MEASUREMENT
/begin MEASUREMENT dataJ1939Dm1Failrs_as[84].dtc_as[12].spn_u32 "" ULONG CnvRule_NumberOneToOne 1 0 0 4294967295 ECU_ADDRESS 0x70018504 /end MEASUREMENT
/begin MEASUREMENT dataJ1939Dm1Failrs_as[84].dtc_as[12].fmi_u8 "" UBYTE CnvRule_NumberOneToOne 1 0 0 255 ECU_ADDRESS 0x70018508 /end MEASUREMENT
/begin MEASUREMENT dataJ1939Dm1Failrs_as[84].dtc_as[12].occ_u8 "" UBYTE CnvRule_NumberOneToOne 1 0 0 255 ECU_ADDRESS 0x70018509 /end MEASUREMENT
/begin MEASUREMENT dataJ1939Dm1Failrs_as[84].dtc_as[13].spn_u32 "" ULONG CnvRule_NumberOneToOne 1 0 0 4294967295 ECU_ADDRESS 0x7001850C /end MEASUREMENT
/begin MEASUREMENT dataJ1939Dm1Failrs_as[84].dtc_as[13].fmi_u8 "" UBYTE CnvRule_NumberOneToOne 1 0 0 255 ECU_ADDRESS 0x70018510 /end MEASUREMENT
/begin MEASUREMENT dataJ1939Dm1Failrs_as[84].dtc_as[13].occ_u8 "" UBYTE CnvRule_NumberOneToOne 1 0 0 255 ECU_ADDRESS 0x70018511 /end MEASUREMENT
/begin MEASUREMENT dataJ1939Dm1Failrs_as[84].dtc_as[14].spn_u32 "" ULONG CnvRule_NumberOneToOne 1 0 0 4294967295 ECU_ADDRESS 0x70018514 /end MEASUREMENT
/begin MEASUREMENT dataJ1939Dm1Failrs_as[84].dtc_as[14].fmi_u8 "" UBYTE CnvRule_NumberOneToOne 1 0 0 255 ECU_ADDRESS 0x70018518 /end MEASUREMENT
/begin MEASUREMENT dataJ1939Dm1Failrs_as[84].dtc_as[14].occ_u8 "" UBYTE CnvRule_NumberOneToOne 1 0 0 255 ECU_ADDRESS 0x70018519 /end MEASUREMENT
/begin MEASUREMENT dataJ1939Dm1Failrs_as[84].dtc_as[15].spn_u32 "" ULONG CnvRule_NumberOneToOne 1 0 0 4294967295 ECU_ADDRESS 0x7001851C /end MEASUREMENT
/begin MEASUREMENT dataJ1939Dm1Failrs_as[84].dtc_as[15].fmi_u8 "" UBYTE CnvRule_NumberOneToOne 1 0 0 255 ECU_ADDRESS 0x70018520 /end MEASUREMENT
/begin MEASUREMENT dataJ1939Dm1Failrs_as[84].dtc_as[15].occ_u8 "" UBYTE CnvRule_NumberOneToOne 1 0 0 255 ECU_ADDRESS 0x70018521 /end MEASUREMENT
/begin MEASUREMENT dataJ1939Dm1Failrs_as[84].dtc_as[16].spn_u32 "" ULONG CnvRule_NumberOneToOne 1 0 0 4294967295 ECU_ADDRESS 0x70018524 /end MEASUREMENT
/begin MEASUREMENT dataJ1939Dm1Failrs_as[84].dtc_as[16].fmi_u8 "" UBYTE CnvRule_NumberOneToOne 1 0 0 255 ECU_ADDRESS 0x70018528 /end MEASUREMENT
/begin MEASUREMENT dataJ1939Dm1Failrs_as[84].dtc_as[16].occ_u8 "" UBYTE CnvRule_NumberOneToOne 1 0 0 255 ECU_ADDRESS 0x70018529 /end MEASUREMENT
/begin MEASUREMENT dataJ1939Dm1Failrs_as[84].dtc_as[17].spn_u32 "" ULONG CnvRule_NumberOneToOne 1 0 0 4294967295 ECU_ADDRESS 0x7001852C /end MEASUREMENT
/begin MEASUREMENT dataJ1939Dm1Failrs_as[84].dtc_as[17].fmi_u8 "" UBYTE CnvRule_NumberOneToOne 1 0 0 255 ECU_ADDRESS 0x70018530 /end MEASUREMENT
/begin MEASUREMENT dataJ1939Dm1Failrs_as[84].dtc_as[17].occ_u8 "" UBYTE CnvRule_NumberOneToOne 1 0 0 255 ECU_ADDRESS 0x70018531 /end MEASUREMENT
/begin MEASUREMENT dataJ1939Dm1Failrs_as[84].dtc_as[18].spn_u32 "" ULONG CnvRule_NumberOneToOne 1 0 0 4294967295 ECU_ADDRESS 0x70018534 /end MEASUREMENT
/begin MEASUREMENT dataJ1939Dm1Failrs_as[84].dtc_as[18].fmi_u8 "" UBYTE CnvRule_NumberOneToOne 1 0 0 255 ECU_ADDRESS 0x70018538 /end MEASUREMENT
/begin MEASUREMENT dataJ1939Dm1Failrs_as[84].dtc_as[18].occ_u8 "" UBYTE CnvRule_NumberOneToOne 1 0 0 255 ECU_ADDRESS 0x70018539 /end MEASUREMENT
/begin MEASUREMENT dataJ1939Dm1Failrs_as[84].dtc_as[19].spn_u32 "" ULONG CnvRule_NumberOneToOne 1 0 0 4294967295 ECU_ADDRESS 0x7001853C /end MEASUREMENT
/begin MEASUREMENT dataJ1939Dm1Failrs_as[84].dtc_as[19].fmi_u8 "" UBYTE CnvRule_NumberOneToOne 1 0 0 255 ECU_ADDRESS 0x70018540 /end MEASUREMENT
/begin MEASUREMENT dataJ1939Dm1Failrs_as[84].dtc_as[19].occ_u8 "" UBYTE CnvRule_NumberOneToOne 1 0 0 255 ECU_ADDRESS 0x70018541 /end MEASUREMENT
/begin MEASUREMENT dataJ1939Dm1Failrs_as[84].dtc_as[20].spn_u32 "" ULONG CnvRule_NumberOneToOne 1 0 0 4294967295 ECU_ADDRESS 0x70018544 /end MEASUREMENT
/begin MEASUREMENT dataJ1939Dm1Failrs_as[84].dtc_as[20].fmi_u8 "" UBYTE CnvRule_NumberOneToOne 1 0 0 255 ECU_ADDRESS 0x70018548 /end MEASUREMENT
/begin MEASUREMENT dataJ1939Dm1Failrs_as[84].dtc_as[20].occ_u8 "" UBYTE CnvRule_NumberOneToOne 1 0 0 255 ECU_ADDRESS 0x70018549 /end MEASUREMENT
/begin MEASUREMENT dataJ1939Dm1Failrs_as[84].dtc_as "" UBYTE CnvRule_NumberOneToOne 1 0 0 255 ECU_ADDRESS 0x700184AC ARRAY_SIZE 160 /end MEASUREMENT
/begin MEASUREMENT dataJ1939Dm1Failrs_as[85].dtc_as[1].spn_u32 "" ULONG CnvRule_NumberOneToOne 1 0 0 4294967295 ECU_ADDRESS 0x70018550 /end MEASUREMENT
/begin MEASUREMENT dataJ1939Dm1Failrs_as[85].dtc_as[1].fmi_u8 "" UBYTE CnvRule_NumberOneToOne 1 0 0 255 ECU_ADDRESS 0x70018554 /end MEASUREMENT
/begin MEASUREMENT dataJ1939Dm1Failrs_as[85].dtc_as[1].occ_u8 "" UBYTE CnvRule_NumberOneToOne 1 0 0 255 ECU_ADDRESS 0x70018555 /end MEASUREMENT
/begin MEASUREMENT dataJ1939Dm1Failrs_as[85].dtc_as[2].spn_u32 "" ULONG CnvRule_NumberOneToOne 1 0 0 4294967295 ECU_ADDRESS 0x70018558 /end MEASUREMENT
/begin MEASUREMENT dataJ1939Dm1Failrs_as[85].dtc_as[2].fmi_u8 "" UBYTE CnvRule_NumberOneToOne 1 0 0 255 ECU_ADDRESS 0x7001855C /end MEASUREMENT
/begin MEASUREMENT dataJ1939Dm1Failrs_as[85].dtc_as[2].occ_u8 "" UBYTE CnvRule_NumberOneToOne 1 0 0 255 ECU_ADDRESS 0x7001855D /end MEASUREMENT
/begin MEASUREMENT dataJ1939Dm1Failrs_as[85].dtc_as[3].spn_u32 "" ULONG CnvRule_NumberOneToOne 1 0 0 4294967295 ECU_ADDRESS 0x70018560 /end MEASUREMENT
/begin MEASUREMENT dataJ1939Dm1Failrs_as[85].dtc_as[3].fmi_u8 "" UBYTE CnvRule_NumberOneToOne 1 0 0 255 ECU_ADDRESS 0x70018564 /end MEASUREMENT
/begin MEASUREMENT dataJ1939Dm1Failrs_as[85].dtc_as[3].occ_u8 "" UBYTE CnvRule_NumberOneToOne 1 0 0 255 ECU_ADDRESS 0x70018565 /end MEASUREMENT
/begin MEASUREMENT dataJ1939Dm1Failrs_as[85].dtc_as[4].spn_u32 "" ULONG CnvRule_NumberOneToOne 1 0 0 4294967295 ECU_ADDRESS 0x70018568 /end MEASUREMENT
/begin MEASUREMENT dataJ1939Dm1Failrs_as[85].dtc_as[4].fmi_u8 "" UBYTE CnvRule_NumberOneToOne 1 0 0 255 ECU_ADDRESS 0x7001856C /end MEASUREMENT
/begin MEASUREMENT dataJ1939Dm1Failrs_as[85].dtc_as[4].occ_u8 "" UBYTE CnvRule_NumberOneToOne 1 0 0 255 ECU_ADDRESS 0x7001856D /end MEASUREMENT
/begin MEASUREMENT dataJ1939Dm1Failrs_as[85].dtc_as[5].spn_u32 "" ULONG CnvRule_NumberOneToOne 1 0 0 4294967295 ECU_ADDRESS 0x70018570 /end MEASUREMENT
/begin MEASUREMENT dataJ1939Dm1Failrs_as[85].dtc_as[5].fmi_u8 "" UBYTE CnvRule_NumberOneToOne 1 0 0 255 ECU_ADDRESS 0x70018574 /end MEASUREMENT
/begin MEASUREMENT dataJ1939Dm1Failrs_as[85].dtc_as[5].occ_u8 "" UBYTE CnvRule_NumberOneToOne 1 0 0 255 ECU_ADDRESS 0x70018575 /end MEASUREMENT
/begin MEASUREMENT dataJ1939Dm1Failrs_as[85].dtc_as[6].spn_u32 "" ULONG CnvRule_NumberOneToOne 1 0 0 4294967295 ECU_ADDRESS 0x70018578 /end MEASUREMENT
/begin MEASUREMENT dataJ1939Dm1Failrs_as[85].dtc_as[6].fmi_u8 "" UBYTE CnvRule_NumberOneToOne 1 0 0 255 ECU_ADDRESS 0x7001857C /end MEASUREMENT
/begin MEASUREMENT dataJ1939Dm1Failrs_as[85].dtc_as[6].occ_u8 "" UBYTE CnvRule_NumberOneToOne 1 0 0 255 ECU_ADDRESS 0x7001857D /end MEASUREMENT
/begin MEASUREMENT dataJ1939Dm1Failrs_as[85].dtc_as[7].spn_u32 "" ULONG CnvRule_NumberOneToOne 1 0 0 4294967295 ECU_ADDRESS 0x70018580 /end MEASUREMENT
/begin MEASUREMENT dataJ1939Dm1Failrs_as[85].dtc_as[7].fmi_u8 "" UBYTE CnvRule_NumberOneToOne 1 0 0 255 ECU_ADDRESS 0x70018584 /end MEASUREMENT
/begin MEASUREMENT dataJ1939Dm1Failrs_as[85].dtc_as[7].occ_u8 "" UBYTE CnvRule_NumberOneToOne 1 0 0 255 ECU_ADDRESS 0x70018585 /end MEASUREMENT
/begin MEASUREMENT dataJ1939Dm1Failrs_as[85].dtc_as[8].spn_u32 "" ULONG CnvRule_NumberOneToOne 1 0 0 4294967295 ECU_ADDRESS 0x70018588 /end MEASUREMENT
/begin MEASUREMENT dataJ1939Dm1Failrs_as[85].dtc_as[8].fmi_u8 "" UBYTE CnvRule_NumberOneToOne 1 0 0 255 ECU_ADDRESS 0x7001858C /end MEASUREMENT
/begin MEASUREMENT dataJ1939Dm1Failrs_as[85].dtc_as[8].occ_u8 "" UBYTE CnvRule_NumberOneToOne 1 0 0 255 ECU_ADDRESS 0x7001858D /end MEASUREMENT
/begin MEASUREMENT dataJ1939Dm1Failrs_as[85].dtc_as[9].spn_u32 "" ULONG CnvRule_NumberOneToOne 1 0 0 4294967295 ECU_ADDRESS 0x70018590 /end MEASUREMENT
/begin MEASUREMENT dataJ1939Dm1Failrs_as[85].dtc_as[9].fmi_u8 "" UBYTE CnvRule_NumberOneToOne 1 0 0 255 ECU_ADDRESS 0x70018594 /end MEASUREMENT
/begin MEASUREMENT dataJ1939Dm1Failrs_as[85].dtc_as[9].occ_u8 "" UBYTE CnvRule_NumberOneToOne 1 0 0 255 ECU_ADDRESS 0x70018595 /end MEASUREMENT
/begin MEASUREMENT dataJ1939Dm1Failrs_as[85].dtc_as[10].spn_u32 "" ULONG CnvRule_NumberOneToOne 1 0 0 4294967295 ECU_ADDRESS 0x70018598 /end MEASUREMENT
/begin MEASUREMENT dataJ1939Dm1Failrs_as[85].dtc_as[10].fmi_u8 "" UBYTE CnvRule_NumberOneToOne 1 0 0 255 ECU_ADDRESS 0x7001859C /end MEASUREMENT
/begin MEASUREMENT dataJ1939Dm1Failrs_as[85].dtc_as[10].occ_u8 "" UBYTE CnvRule_NumberOneToOne 1 0 0 255 ECU_ADDRESS 0x7001859D /end MEASUREMENT
/begin MEASUREMENT dataJ1939Dm1Failrs_as[85].dtc_as[11].spn_u32 "" ULONG CnvRule_NumberOneToOne 1 0 0 4294967295 ECU_ADDRESS 0x700185A0 /end MEASUREMENT
/begin MEASUREMENT dataJ1939Dm1Failrs_as[85].dtc_as[11].fmi_u8 "" UBYTE CnvRule_NumberOneToOne 1 0 0 255 ECU_ADDRESS 0x700185A4 /end MEASUREMENT
/begin MEASUREMENT dataJ1939Dm1Failrs_as[85].dtc_as[11].occ_u8 "" UBYTE CnvRule_NumberOneToOne 1 0 0 255 ECU_ADDRESS 0x700185A5 /end MEASUREMENT
/begin MEASUREMENT dataJ1939Dm1Failrs_as[85].dtc_as[12].spn_u32 "" ULONG CnvRule_NumberOneToOne 1 0 0 4294967295 ECU_ADDRESS 0x700185A8 /end MEASUREMENT
/begin MEASUREMENT dataJ1939Dm1Failrs_as[85].dtc_as[12].fmi_u8 "" UBYTE CnvRule_NumberOneToOne 1 0 0 255 ECU_ADDRESS 0x700185AC /end MEASUREMENT
/begin MEASUREMENT dataJ1939Dm1Failrs_as[85].dtc_as[12].occ_u8 "" UBYTE CnvRule_NumberOneToOne 1 0 0 255 ECU_ADDRESS 0x700185AD /end MEASUREMENT
/begin MEASUREMENT dataJ1939Dm1Failrs_as[85].dtc_as[13].spn_u32 "" ULONG CnvRule_NumberOneToOne 1 0 0 4294967295 ECU_ADDRESS 0x700185B0 /end MEASUREMENT
/begin MEASUREMENT dataJ1939Dm1Failrs_as[85].dtc_as[13].fmi_u8 "" UBYTE CnvRule_NumberOneToOne 1 0 0 255 ECU_ADDRESS 0x700185B4 /end MEASUREMENT
/begin MEASUREMENT dataJ1939Dm1Failrs_as[85].dtc_as[13].occ_u8 "" UBYTE CnvRule_NumberOneToOne 1 0 0 255 ECU_ADDRESS 0x700185B5 /end MEASUREMENT
/begin MEASUREMENT dataJ1939Dm1Failrs_as[85].dtc_as[14].spn_u32 "" ULONG CnvRule_NumberOneToOne 1 0 0 4294967295 ECU_ADDRESS 0x700185B8 /end MEASUREMENT
/begin MEASUREMENT dataJ1939Dm1Failrs_as[85].dtc_as[14].fmi_u8 "" UBYTE CnvRule_NumberOneToOne 1 0 0 255 ECU_ADDRESS 0x700185BC /end MEASUREMENT
/begin MEASUREMENT dataJ1939Dm1Failrs_as[85].dtc_as[14].occ_u8 "" UBYTE CnvRule_NumberOneToOne 1 0 0 255 ECU_ADDRESS 0x700185BD /end MEASUREMENT
/begin MEASUREMENT dataJ1939Dm1Failrs_as[85].dtc_as[15].spn_u32 "" ULONG CnvRule_NumberOneToOne 1 0 0 4294967295 ECU_ADDRESS 0x700185C0 /end MEASUREMENT
/begin MEASUREMENT dataJ1939Dm1Failrs_as[85].dtc_as[15].fmi_u8 "" UBYTE CnvRule_NumberOneToOne 1 0 0 255 ECU_ADDRESS 0x700185C4 /end MEASUREMENT
/begin MEASUREMENT dataJ1939Dm1Failrs_as[85].dtc_as[15].occ_u8 "" UBYTE CnvRule_NumberOneToOne 1 0 0 255 ECU_ADDRESS 0x700185C5 /end MEASUREMENT
/begin MEASUREMENT dataJ1939Dm1Failrs_as[85].dtc_as[16].spn_u32 "" ULONG CnvRule_NumberOneToOne 1 0 0 4294967295 ECU_ADDRESS 0x700185C8 /end MEASUREMENT
/begin MEASUREMENT dataJ1939Dm1Failrs_as[85].dtc_as[16].fmi_u8 "" UBYTE CnvRule_NumberOneToOne 1 0 0 255 ECU_ADDRESS 0x700185CC /end MEASUREMENT
/begin MEASUREMENT dataJ1939Dm1Failrs_as[85].dtc_as[16].occ_u8 "" UBYTE CnvRule_NumberOneToOne 1 0 0 255 ECU_ADDRESS 0x700185CD /end MEASUREMENT
/begin MEASUREMENT dataJ1939Dm1Failrs_as[85].dtc_as[17].spn_u32 "" ULONG CnvRule_NumberOneToOne 1 0 0 4294967295 ECU_ADDRESS 0x700185D0 /end MEASUREMENT
/begin MEASUREMENT dataJ1939Dm1Failrs_as[85].dtc_as[17].fmi_u8 "" UBYTE CnvRule_NumberOneToOne 1 0 0 255 ECU_ADDRESS 0x700185D4 /end MEASUREMENT
/begin MEASUREMENT dataJ1939Dm1Failrs_as[85].dtc_as[17].occ_u8 "" UBYTE CnvRule_NumberOneToOne 1 0 0 255 ECU_ADDRESS 0x700185D5 /end MEASUREMENT
/begin MEASUREMENT dataJ1939Dm1Failrs_as[85].dtc_as[18].spn_u32 "" ULONG CnvRule_NumberOneToOne 1 0 0 4294967295 ECU_ADDRESS 0x700185D8 /end MEASUREMENT
/begin MEASUREMENT dataJ1939Dm1Failrs_as[85].dtc_as[18].fmi_u8 "" UBYTE CnvRule_NumberOneToOne 1 0 0 255 ECU_ADDRESS 0x700185DC /end MEASUREMENT
/begin MEASUREMENT dataJ1939Dm1Failrs_as[85].dtc_as[18].occ_u8 "" UBYTE CnvRule_NumberOneToOne 1 0 0 255 ECU_ADDRESS 0x700185DD /end MEASUREMENT
/begin MEASUREMENT dataJ1939Dm1Failrs_as[85].dtc_as[19].spn_u32 "" ULONG CnvRule_NumberOneToOne 1 0 0 4294967295 ECU_ADDRESS 0x700185E0 /end MEASUREMENT
/begin MEASUREMENT dataJ1939Dm1Failrs_as[85].dtc_as[19].fmi_u8 "" UBYTE CnvRule_NumberOneToOne 1 0 0 255 ECU_ADDRESS 0x700185E4 /end MEASUREMENT
/begin MEASUREMENT dataJ1939Dm1Failrs_as[85].dtc_as[19].occ_u8 "" UBYTE CnvRule_NumberOneToOne 1 0 0 255 ECU_ADDRESS 0x700185E5 /end MEASUREMENT
/begin MEASUREMENT dataJ1939Dm1Failrs_as[85].dtc_as[20].spn_u32 "" ULONG CnvRule_NumberOneToOne 1 0 0 4294967295 ECU_ADDRESS 0x700185E8 /end MEASUREMENT
/begin MEASUREMENT dataJ1939Dm1Failrs_as[85].dtc_as[20].fmi_u8 "" UBYTE CnvRule_NumberOneToOne 1 0 0 255 ECU_ADDRESS 0x700185EC /end MEASUREMENT
/begin MEASUREMENT dataJ1939Dm1Failrs_as[85].dtc_as[20].occ_u8 "" UBYTE CnvRule_NumberOneToOne 1 0 0 255 ECU_ADDRESS 0x700185ED /end MEASUREMENT
/begin MEASUREMENT dataJ1939Dm1Failrs_as[85].dtc_as "" UBYTE CnvRule_NumberOneToOne 1 0 0 255 ECU_ADDRESS 0x70018550 ARRAY_SIZE 160 /end MEASUREMENT
/begin MEASUREMENT dataJ1939Dm1Failrs_as[86].dtc_as[1].spn_u32 "" ULONG CnvRule_NumberOneToOne 1 0 0 4294967295 ECU_ADDRESS 0x700185F4 /end MEASUREMENT
/begin MEASUREMENT dataJ1939Dm1Failrs_as[86].dtc_as[1].fmi_u8 "" UBYTE CnvRule_NumberOneToOne 1 0 0 255 ECU_ADDRESS 0x700185F8 /end MEASUREMENT
/begin MEASUREMENT dataJ1939Dm1Failrs_as[86].dtc_as[1].occ_u8 "" UBYTE CnvRule_NumberOneToOne 1 0 0 255 ECU_ADDRESS 0x700185F9 /end MEASUREMENT
/begin MEASUREMENT dataJ1939Dm1Failrs_as[86].dtc_as[2].spn_u32 "" ULONG CnvRule_NumberOneToOne 1 0 0 4294967295 ECU_ADDRESS 0x700185FC /end MEASUREMENT
/begin MEASUREMENT dataJ1939Dm1Failrs_as[86].dtc_as[2].fmi_u8 "" UBYTE CnvRule_NumberOneToOne 1 0 0 255 ECU_ADDRESS 0x70018600 /end MEASUREMENT
/begin MEASUREMENT dataJ1939Dm1Failrs_as[86].dtc_as[2].occ_u8 "" UBYTE CnvRule_NumberOneToOne 1 0 0 255 ECU_ADDRESS 0x70018601 /end MEASUREMENT
/begin MEASUREMENT dataJ1939Dm1Failrs_as[86].dtc_as[3].spn_u32 "" ULONG CnvRule_NumberOneToOne 1 0 0 4294967295 ECU_ADDRESS 0x70018604 /end MEASUREMENT
/begin MEASUREMENT dataJ1939Dm1Failrs_as[86].dtc_as[3].fmi_u8 "" UBYTE CnvRule_NumberOneToOne 1 0 0 255 ECU_ADDRESS 0x70018608 /end MEASUREMENT
/begin MEASUREMENT dataJ1939Dm1Failrs_as[86].dtc_as[3].occ_u8 "" UBYTE CnvRule_NumberOneToOne 1 0 0 255 ECU_ADDRESS 0x70018609 /end MEASUREMENT
/begin MEASUREMENT dataJ1939Dm1Failrs_as[86].dtc_as[4].spn_u32 "" ULONG CnvRule_NumberOneToOne 1 0 0 4294967295 ECU_ADDRESS 0x7001860C /end MEASUREMENT
/begin MEASUREMENT dataJ1939Dm1Failrs_as[86].dtc_as[4].fmi_u8 "" UBYTE CnvRule_NumberOneToOne 1 0 0 255 ECU_ADDRESS 0x70018610 /end MEASUREMENT
/begin MEASUREMENT dataJ1939Dm1Failrs_as[86].dtc_as[4].occ_u8 "" UBYTE CnvRule_NumberOneToOne 1 0 0 255 ECU_ADDRESS 0x70018611 /end MEASUREMENT
/begin MEASUREMENT dataJ1939Dm1Failrs_as[86].dtc_as[5].spn_u32 "" ULONG CnvRule_NumberOneToOne 1 0 0 4294967295 ECU_ADDRESS 0x70018614 /end MEASUREMENT
/begin MEASUREMENT dataJ1939Dm1Failrs_as[86].dtc_as[5].fmi_u8 "" UBYTE CnvRule_NumberOneToOne 1 0 0 255 ECU_ADDRESS 0x70018618 /end MEASUREMENT
/begin MEASUREMENT dataJ1939Dm1Failrs_as[86].dtc_as[5].occ_u8 "" UBYTE CnvRule_NumberOneToOne 1 0 0 255 ECU_ADDRESS 0x70018619 /end MEASUREMENT
/begin MEASUREMENT dataJ1939Dm1Failrs_as[86].dtc_as[6].spn_u32 "" ULONG CnvRule_NumberOneToOne 1 0 0 4294967295 ECU_ADDRESS 0x7001861C /end MEASUREMENT
/begin MEASUREMENT dataJ1939Dm1Failrs_as[86].dtc_as[6].fmi_u8 "" UBYTE CnvRule_NumberOneToOne 1 0 0 255 ECU_ADDRESS 0x70018620 /end MEASUREMENT
/begin MEASUREMENT dataJ1939Dm1Failrs_as[86].dtc_as[6].occ_u8 "" UBYTE CnvRule_NumberOneToOne 1 0 0 255 ECU_ADDRESS 0x70018621 /end MEASUREMENT
/begin MEASUREMENT dataJ1939Dm1Failrs_as[86].dtc_as[7].spn_u32 "" ULONG CnvRule_NumberOneToOne 1 0 0 4294967295 ECU_ADDRESS 0x70018624 /end MEASUREMENT
/begin MEASUREMENT dataJ1939Dm1Failrs_as[86].dtc_as[7].fmi_u8 "" UBYTE CnvRule_NumberOneToOne 1 0 0 255 ECU_ADDRESS 0x70018628 /end MEASUREMENT
/begin MEASUREMENT dataJ1939Dm1Failrs_as[86].dtc_as[7].occ_u8 "" UBYTE CnvRule_NumberOneToOne 1 0 0 255 ECU_ADDRESS 0x70018629 /end MEASUREMENT
/begin MEASUREMENT dataJ1939Dm1Failrs_as[86].dtc_as[8].spn_u32 "" ULONG CnvRule_NumberOneToOne 1 0 0 4294967295 ECU_ADDRESS 0x7001862C /end MEASUREMENT
/begin MEASUREMENT dataJ1939Dm1Failrs_as[86].dtc_as[8].fmi_u8 "" UBYTE CnvRule_NumberOneToOne 1 0 0 255 ECU_ADDRESS 0x70018630 /end MEASUREMENT
/begin MEASUREMENT dataJ1939Dm1Failrs_as[86].dtc_as[8].occ_u8 "" UBYTE CnvRule_NumberOneToOne 1 0 0 255 ECU_ADDRESS 0x70018631 /end MEASUREMENT
/begin MEASUREMENT dataJ1939Dm1Failrs_as[86].dtc_as[9].spn_u32 "" ULONG CnvRule_NumberOneToOne 1 0 0 4294967295 ECU_ADDRESS 0x70018634 /end MEASUREMENT
/begin MEASUREMENT dataJ1939Dm1Failrs_as[86].dtc_as[9].fmi_u8 "" UBYTE CnvRule_NumberOneToOne 1 0 0 255 ECU_ADDRESS 0x70018638 /end MEASUREMENT
/begin MEASUREMENT dataJ1939Dm1Failrs_as[86].dtc_as[9].occ_u8 "" UBYTE CnvRule_NumberOneToOne 1 0 0 255 ECU_ADDRESS 0x70018639 /end MEASUREMENT
/begin MEASUREMENT dataJ1939Dm1Failrs_as[86].dtc_as[10].spn_u32 "" ULONG CnvRule_NumberOneToOne 1 0 0 4294967295 ECU_ADDRESS 0x7001863C /end MEASUREMENT
/begin MEASUREMENT dataJ1939Dm1Failrs_as[86].dtc_as[10].fmi_u8 "" UBYTE CnvRule_NumberOneToOne 1 0 0 255 ECU_ADDRESS 0x70018640 /end MEASUREMENT
/begin MEASUREMENT dataJ1939Dm1Failrs_as[86].dtc_as[10].occ_u8 "" UBYTE CnvRule_NumberOneToOne 1 0 0 255 ECU_ADDRESS 0x70018641 /end MEASUREMENT
/begin MEASUREMENT dataJ1939Dm1Failrs_as[86].dtc_as[11].spn_u32 "" ULONG CnvRule_NumberOneToOne 1 0 0 4294967295 ECU_ADDRESS 0x70018644 /end MEASUREMENT
/begin MEASUREMENT dataJ1939Dm1Failrs_as[86].dtc_as[11].fmi_u8 "" UBYTE CnvRule_NumberOneToOne 1 0 0 255 ECU_ADDRESS 0x70018648 /end MEASUREMENT
/begin MEASUREMENT dataJ1939Dm1Failrs_as[86].dtc_as[11].occ_u8 "" UBYTE CnvRule_NumberOneToOne 1 0 0 255 ECU_ADDRESS 0x70018649 /end MEASUREMENT
/begin MEASUREMENT dataJ1939Dm1Failrs_as[86].dtc_as[12].spn_u32 "" ULONG CnvRule_NumberOneToOne 1 0 0 4294967295 ECU_ADDRESS 0x7001864C /end MEASUREMENT
/begin MEASUREMENT dataJ1939Dm1Failrs_as[86].dtc_as[12].fmi_u8 "" UBYTE CnvRule_NumberOneToOne 1 0 0 255 ECU_ADDRESS 0x70018650 /end MEASUREMENT
/begin MEASUREMENT dataJ1939Dm1Failrs_as[86].dtc_as[12].occ_u8 "" UBYTE CnvRule_NumberOneToOne 1 0 0 255 ECU_ADDRESS 0x70018651 /end MEASUREMENT
/begin MEASUREMENT dataJ1939Dm1Failrs_as[86].dtc_as[13].spn_u32 "" ULONG CnvRule_NumberOneToOne 1 0 0 4294967295 ECU_ADDRESS 0x70018654 /end MEASUREMENT
/begin MEASUREMENT dataJ1939Dm1Failrs_as[86].dtc_as[13].fmi_u8 "" UBYTE CnvRule_NumberOneToOne 1 0 0 255 ECU_ADDRESS 0x70018658 /end MEASUREMENT
/begin MEASUREMENT dataJ1939Dm1Failrs_as[86].dtc_as[13].occ_u8 "" UBYTE CnvRule_NumberOneToOne 1 0 0 255 ECU_ADDRESS 0x70018659 /end MEASUREMENT
/begin MEASUREMENT dataJ1939Dm1Failrs_as[86].dtc_as[14].spn_u32 "" ULONG CnvRule_NumberOneToOne 1 0 0 4294967295 ECU_ADDRESS 0x7001865C /end MEASUREMENT
/begin MEASUREMENT dataJ1939Dm1Failrs_as[86].dtc_as[14].fmi_u8 "" UBYTE CnvRule_NumberOneToOne 1 0 0 255 ECU_ADDRESS 0x70018660 /end MEASUREMENT
/begin MEASUREMENT dataJ1939Dm1Failrs_as[86].dtc_as[14].occ_u8 "" UBYTE CnvRule_NumberOneToOne 1 0 0 255 ECU_ADDRESS 0x70018661 /end MEASUREMENT
/begin MEASUREMENT dataJ1939Dm1Failrs_as[86].dtc_as[15].spn_u32 "" ULONG CnvRule_NumberOneToOne 1 0 0 4294967295 ECU_ADDRESS 0x70018664 /end MEASUREMENT
/begin MEASUREMENT dataJ1939Dm1Failrs_as[86].dtc_as[15].fmi_u8 "" UBYTE CnvRule_NumberOneToOne 1 0 0 255 ECU_ADDRESS 0x70018668 /end MEASUREMENT
/begin MEASUREMENT dataJ1939Dm1Failrs_as[86].dtc_as[15].occ_u8 "" UBYTE CnvRule_NumberOneToOne 1 0 0 255 ECU_ADDRESS 0x70018669 /end MEASUREMENT
/begin MEASUREMENT dataJ1939Dm1Failrs_as[86].dtc_as[16].spn_u32 "" ULONG CnvRule_NumberOneToOne 1 0 0 4294967295 ECU_ADDRESS 0x7001866C /end MEASUREMENT
/begin MEASUREMENT dataJ1939Dm1Failrs_as[86].dtc_as[16].fmi_u8 "" UBYTE CnvRule_NumberOneToOne 1 0 0 255 ECU_ADDRESS 0x70018670 /end MEASUREMENT
/begin MEASUREMENT dataJ1939Dm1Failrs_as[86].dtc_as[16].occ_u8 "" UBYTE CnvRule_NumberOneToOne 1 0 0 255 ECU_ADDRESS 0x70018671 /end MEASUREMENT
/begin MEASUREMENT dataJ1939Dm1Failrs_as[86].dtc_as[17].spn_u32 "" ULONG CnvRule_NumberOneToOne 1 0 0 4294967295 ECU_ADDRESS 0x70018674 /end MEASUREMENT
/begin MEASUREMENT dataJ1939Dm1Failrs_as[86].dtc_as[17].fmi_u8 "" UBYTE CnvRule_NumberOneToOne 1 0 0 255 ECU_ADDRESS 0x70018678 /end MEASUREMENT
/begin MEASUREMENT dataJ1939Dm1Failrs_as[86].dtc_as[17].occ_u8 "" UBYTE CnvRule_NumberOneToOne 1 0 0 255 ECU_ADDRESS 0x70018679 /end MEASUREMENT
/begin MEASUREMENT dataJ1939Dm1Failrs_as[86].dtc_as[18].spn_u32 "" ULONG CnvRule_NumberOneToOne 1 0 0 4294967295 ECU_ADDRESS 0x7001867C /end MEASUREMENT
/begin MEASUREMENT dataJ1939Dm1Failrs_as[86].dtc_as[18].fmi_u8 "" UBYTE CnvRule_NumberOneToOne 1 0 0 255 ECU_ADDRESS 0x70018680 /end MEASUREMENT
/begin MEASUREMENT dataJ1939Dm1Failrs_as[86].dtc_as[18].occ_u8 "" UBYTE CnvRule_NumberOneToOne 1 0 0 255 ECU_ADDRESS 0x70018681 /end MEASUREMENT
/begin MEASUREMENT dataJ1939Dm1Failrs_as[86].dtc_as[19].spn_u32 "" ULONG CnvRule_NumberOneToOne 1 0 0 4294967295 ECU_ADDRESS 0x70018684 /end MEASUREMENT
/begin MEASUREMENT dataJ1939Dm1Failrs_as[86].dtc_as[19].fmi_u8 "" UBYTE CnvRule_NumberOneToOne 1 0 0 255 ECU_ADDRESS 0x70018688 /end MEASUREMENT
/begin MEASUREMENT dataJ1939Dm1Failrs_as[86].dtc_as[19].occ_u8 "" UBYTE CnvRule_NumberOneToOne 1 0 0 255 ECU_ADDRESS 0x70018689 /end MEASUREMENT
/begin MEASUREMENT dataJ1939Dm1Failrs_as[86].dtc_as[20].spn_u32 "" ULONG CnvRule_NumberOneToOne 1 0 0 4294967295 ECU_ADDRESS 0x7001868C /end MEASUREMENT
/begin MEASUREMENT dataJ1939Dm1Failrs_as[86].dtc_as[20].fmi_u8 "" UBYTE CnvRule_NumberOneToOne 1 0 0 255 ECU_ADDRESS 0x70018690 /end MEASUREMENT
/begin MEASUREMENT dataJ1939Dm1Failrs_as[86].dtc_as[20].occ_u8 "" UBYTE CnvRule_NumberOneToOne 1 0 0 255 ECU_ADDRESS 0x70018691 /end MEASUREMENT
/begin MEASUREMENT dataJ1939Dm1Failrs_as[86].dtc_as "" UBYTE CnvRule_NumberOneToOne 1 0 0 255 ECU_ADDRESS 0x700185F4 ARRAY_SIZE 160 /end MEASUREMENT
/begin MEASUREMENT status_u16 "" UWORD CnvRule_NumberOneToOne 1 0 0 65535 ECU_ADDRESS 0x700135FE /end MEASUREMENT
/begin MEASUREMENT i_stPmpSnsrSigInvldErr_e "" UBYTE CnvRule_NumberOneToOne 1 0 0 255 ECU_ADDRESS 0x70013704 /end MEASUREMENT
/begin MEASUREMENT i_stBrkSwtSigInvldErr_e "" UBYTE CnvRule_NumberOneToOne 1 0 0 255 ECU_ADDRESS 0x70013705 /end MEASUREMENT
/begin MEASUREMENT i_uPmpSnsr_mV_u16 "" UWORD CnvRule_NumberOneToOne 1 0 0 65535 ECU_ADDRESS 0x70013706 /end MEASUREMENT
/begin MEASUREMENT i_frqVehSnsr_Hz_u32 "" UWORD CnvRule_NumberOneToOne 1 0 0 65535 ECU_ADDRESS 0x70013708 /end MEASUREMENT
/begin MEASUREMENT i_iPmpFwdAct_mA_u16 "" UWORD CnvRule_NumberOneToOne 1 0 0 65535 ECU_ADDRESS 0x7001370A /end MEASUREMENT
/begin MEASUREMENT i_vWhlSpd_kmh_u16 "" UWORD CnvRule_NumberOneToOne 1 0 0 65535 ECU_ADDRESS 0x7001370C /end MEASUREMENT
/begin MEASUREMENT chkResult_e "" UBYTE CnvRule_NumberOneToOne 1 0 0 255 ECU_ADDRESS 0x7001370E /end MEASUREMENT
/begin MEASUREMENT DFC_bds_TiUpDwn0x8A03_ts.DTC "" ULONG CnvRule_NumberOneToOne 1 0 0 4294967295 ECU_ADDRESS 0x70013710 /end MEASUREMENT
/begin MEASUREMENT DFC_bds_TiUpDwn0x8A03_ts.DFCid "" UWORD CnvRule_NumberOneToOne 1 0 0 65535 ECU_ADDRESS 0x70013714 /end MEASUREMENT
/begin MEASUREMENT DFC_bds_TiUpDwn0x8A03_ts.debounceMethod "" UBYTE CnvRule_NumberOneToOne 1 0 0 255 ECU_ADDRESS 0x70013716 /end MEASUREMENT
/begin MEASUREMENT DFC_bds_TiUpDwn0x8A02_ts.DTC "" ULONG CnvRule_NumberOneToOne 1 0 0 4294967295 ECU_ADDRESS 0x70013718 /end MEASUREMENT
/begin MEASUREMENT DFC_bds_TiUpDwn0x8A02_ts.DFCid "" UWORD CnvRule_NumberOneToOne 1 0 0 65535 ECU_ADDRESS 0x7001371C /end MEASUREMENT
/begin MEASUREMENT DFC_bds_TiUpDwn0x8A02_ts.debounceMethod "" UBYTE CnvRule_NumberOneToOne 1 0 0 255 ECU_ADDRESS 0x7001371E /end MEASUREMENT
/begin MEASUREMENT DFC_bds_TiInRow0x8B02_ts.DTC "" ULONG CnvRule_NumberOneToOne 1 0 0 4294967295 ECU_ADDRESS 0x70013720 /end MEASUREMENT
/begin MEASUREMENT DFC_bds_TiInRow0x8B02_ts.DFCid "" UWORD CnvRule_NumberOneToOne 1 0 0 65535 ECU_ADDRESS 0x70013724 /end MEASUREMENT
/begin MEASUREMENT DFC_bds_TiInRow0x8B02_ts.debounceMethod "" UBYTE CnvRule_NumberOneToOne 1 0 0 255 ECU_ADDRESS 0x70013726 /end MEASUREMENT
/begin MEASUREMENT DFC_bds_TiUpDwn0x8A01_ts.DTC "" ULONG CnvRule_NumberOneToOne 1 0 0 4294967295 ECU_ADDRESS 0x70013728 /end MEASUREMENT
/begin MEASUREMENT DFC_bds_TiUpDwn0x8A01_ts.DFCid "" UWORD CnvRule_NumberOneToOne 1 0 0 65535 ECU_ADDRESS 0x7001372C /end MEASUREMENT
/begin MEASUREMENT DFC_bds_TiUpDwn0x8A01_ts.debounceMethod "" UBYTE CnvRule_NumberOneToOne 1 0 0 255 ECU_ADDRESS 0x7001372E /end MEASUREMENT
/begin MEASUREMENT DFC_bds_TiInRow0x8B01_ts.DTC "" ULONG CnvRule_NumberOneToOne 1 0 0 4294967295 ECU_ADDRESS 0x70013730 /end MEASUREMENT
/begin MEASUREMENT DFC_bds_TiInRow0x8B01_ts.DFCid "" UWORD CnvRule_NumberOneToOne 1 0 0 65535 ECU_ADDRESS 0x70013734 /end MEASUREMENT
/begin MEASUREMENT DFC_bds_TiInRow0x8B01_ts.debounceMethod "" UBYTE CnvRule_NumberOneToOne 1 0 0 255 ECU_ADDRESS 0x70013736 /end MEASUREMENT
/begin MEASUREMENT DFC_bds_TiInRow0x8B03_ts.DTC "" ULONG CnvRule_NumberOneToOne 1 0 0 4294967295 ECU_ADDRESS 0x70013738 /end MEASUREMENT
/begin MEASUREMENT DFC_bds_TiInRow0x8B03_ts.DFCid "" UWORD CnvRule_NumberOneToOne 1 0 0 65535 ECU_ADDRESS 0x7001373C /end MEASUREMENT
/begin MEASUREMENT DFC_bds_TiInRow0x8B03_ts.debounceMethod "" UBYTE CnvRule_NumberOneToOne 1 0 0 255 ECU_ADDRESS 0x7001373E /end MEASUREMENT
/begin MEASUREMENT DFC_bds_NoDeb0x8C01_ts.DTC "" ULONG CnvRule_NumberOneToOne 1 0 0 4294967295 ECU_ADDRESS 0x70013740 /end MEASUREMENT
/begin MEASUREMENT DFC_bds_NoDeb0x8C01_ts.DFCid "" UWORD CnvRule_NumberOneToOne 1 0 0 65535 ECU_ADDRESS 0x70013744 /end MEASUREMENT
/begin MEASUREMENT DFC_bds_NoDeb0x8C01_ts.debounceMethod "" UBYTE CnvRule_NumberOneToOne 1 0 0 255 ECU_ADDRESS 0x70013746 /end MEASUREMENT
/begin MEASUREMENT DFC_bds_NoDeb0x8C03_ts.DTC "" ULONG CnvRule_NumberOneToOne 1 0 0 4294967295 ECU_ADDRESS 0x70013748 /end MEASUREMENT
/begin MEASUREMENT DFC_bds_NoDeb0x8C03_ts.DFCid "" UWORD CnvRule_NumberOneToOne 1 0 0 65535 ECU_ADDRESS 0x7001374C /end MEASUREMENT
/begin MEASUREMENT DFC_bds_NoDeb0x8C03_ts.debounceMethod "" UBYTE CnvRule_NumberOneToOne 1 0 0 255 ECU_ADDRESS 0x7001374E /end MEASUREMENT
/begin MEASUREMENT NvmWriteRet_u16 "" UWORD CnvRule_NumberOneToOne 1 0 0 65535 ECU_ADDRESS 0x70013B0A /end MEASUREMENT
/begin MEASUREMENT DiagChkLvlRet_u8 "" UBYTE CnvRule_NumberOneToOne 1 0 0 255 ECU_ADDRESS 0x70013AF5 /end MEASUREMENT
/begin MEASUREMENT Level_pu8 "" UBYTE CnvRule_NumberOneToOne 1 0 0 255 ECU_ADDRESS 0x70018694 /end MEASUREMENT
/begin MEASUREMENT ErrMemMgr_s.dtc_error_au32 "" ULONG CnvRule_NumberOneToOne 1 0 0 4294967295 ECU_ADDRESS 0x70013850 ARRAY_SIZE 128 /end MEASUREMENT
/begin MEASUREMENT ErrMemMgr_s.stDfes_au8 "" UBYTE CnvRule_NumberOneToOne 1 0 0 255 ECU_ADDRESS 0x700138D0 ARRAY_SIZE 32 /end MEASUREMENT
/begin MEASUREMENT ErrMemMgr_s.status_au16 "" UWORD CnvRule_NumberOneToOne 1 0 0 65535 ECU_ADDRESS 0x700138F4 ARRAY_SIZE 64 /end MEASUREMENT
/begin MEASUREMENT ErrMemMgr_s.nrDfesEntr_u8 "" UBYTE CnvRule_NumberOneToOne 1 0 0 255 ECU_ADDRESS 0x70013934 /end MEASUREMENT
/begin MEASUREMENT ErrMemMgr_s.clrCntr_au8 "" UBYTE CnvRule_NumberOneToOne 1 0 0 255 ECU_ADDRESS 0x70013935 ARRAY_SIZE 32 /end MEASUREMENT
/begin MEASUREMENT ErrMemMgr_s.tiOldStamp_u32 "" ULONG CnvRule_NumberOneToOne 1 0 0 4294967295 ECU_ADDRESS 0x70013958 /end MEASUREMENT
/begin MEASUREMENT ErrMemMgr_s.stDtcAvl_au8 "" UBYTE CnvRule_NumberOneToOne 1 0 0 255 ECU_ADDRESS 0x7001395C ARRAY_SIZE 32 /end MEASUREMENT
/begin MEASUREMENT DFES_numEntryAvl "" UWORD CnvRule_NumberOneToOne 1 0 0 65535 ECU_ADDRESS 0x7001397C /end MEASUREMENT
/begin MEASUREMENT errList_s.nrErr_u8 "" UBYTE CnvRule_NumberOneToOne 1 0 0 255 ECU_ADDRESS 0x70013980 /end MEASUREMENT
/begin MEASUREMENT errList_s.dtcList_au32 "" ULONG CnvRule_NumberOneToOne 1 0 0 4294967295 ECU_ADDRESS 0x70013984 ARRAY_SIZE 128 /end MEASUREMENT
/begin MEASUREMENT errList_s.apiSt_e "" UBYTE CnvRule_NumberOneToOne 1 0 0 255 ECU_ADDRESS 0x70013A04 /end MEASUREMENT
/begin MEASUREMENT dsmDTC_getStatus_s.errState_e "" ULONG CnvRule_NumberOneToOne 1 0 0 4294967295 ECU_ADDRESS 0x70013A08 /end MEASUREMENT
/begin MEASUREMENT dsmDTC_getStatus_s.apiSt_e "" UBYTE CnvRule_NumberOneToOne 1 0 0 255 ECU_ADDRESS 0x70013A0E /end MEASUREMENT
/begin MEASUREMENT dfc_as[0].id "" UWORD CnvRule_NumberOneToOne 1 0 0 65535 ECU_ADDRESS 0x70013A10 /end MEASUREMENT
/begin MEASUREMENT dfc_as[0].debmode "" UWORD CnvRule_NumberOneToOne 1 0 0 65535 ECU_ADDRESS 0x70013A12 /end MEASUREMENT
/begin MEASUREMENT dfc_as[1].id "" UWORD CnvRule_NumberOneToOne 1 0 0 65535 ECU_ADDRESS 0x70013A14 /end MEASUREMENT
/begin MEASUREMENT dfc_as[1].debmode "" UWORD CnvRule_NumberOneToOne 1 0 0 65535 ECU_ADDRESS 0x70013A16 /end MEASUREMENT
/begin MEASUREMENT dfc_as[2].id "" UWORD CnvRule_NumberOneToOne 1 0 0 65535 ECU_ADDRESS 0x70013A18 /end MEASUREMENT
/begin MEASUREMENT dfc_as[2].debmode "" UWORD CnvRule_NumberOneToOne 1 0 0 65535 ECU_ADDRESS 0x70013A1A /end MEASUREMENT
/begin MEASUREMENT dfc_as[3].id "" UWORD CnvRule_NumberOneToOne 1 0 0 65535 ECU_ADDRESS 0x70013A1C /end MEASUREMENT
/begin MEASUREMENT dfc_as[3].debmode "" UWORD CnvRule_NumberOneToOne 1 0 0 65535 ECU_ADDRESS 0x70013A1E /end MEASUREMENT
/begin MEASUREMENT dfc_as[4].id "" UWORD CnvRule_NumberOneToOne 1 0 0 65535 ECU_ADDRESS 0x70013A20 /end MEASUREMENT
/begin MEASUREMENT dfc_as[4].debmode "" UWORD CnvRule_NumberOneToOne 1 0 0 65535 ECU_ADDRESS 0x70013A22 /end MEASUREMENT
/begin MEASUREMENT dfc_as[5].id "" UWORD CnvRule_NumberOneToOne 1 0 0 65535 ECU_ADDRESS 0x70013A24 /end MEASUREMENT
/begin MEASUREMENT dfc_as[5].debmode "" UWORD CnvRule_NumberOneToOne 1 0 0 65535 ECU_ADDRESS 0x70013A26 /end MEASUREMENT
/begin MEASUREMENT dfc_as[6].id "" UWORD CnvRule_NumberOneToOne 1 0 0 65535 ECU_ADDRESS 0x70013A28 /end MEASUREMENT
/begin MEASUREMENT dfc_as[6].debmode "" UWORD CnvRule_NumberOneToOne 1 0 0 65535 ECU_ADDRESS 0x70013A2A /end MEASUREMENT
/begin MEASUREMENT dfc_as[7].id "" UWORD CnvRule_NumberOneToOne 1 0 0 65535 ECU_ADDRESS 0x70013A2C /end MEASUREMENT
/begin MEASUREMENT dfc_as[7].debmode "" UWORD CnvRule_NumberOneToOne 1 0 0 65535 ECU_ADDRESS 0x70013A2E /end MEASUREMENT
/begin MEASUREMENT dfc_as[8].id "" UWORD CnvRule_NumberOneToOne 1 0 0 65535 ECU_ADDRESS 0x70013A30 /end MEASUREMENT
/begin MEASUREMENT dfc_as[8].debmode "" UWORD CnvRule_NumberOneToOne 1 0 0 65535 ECU_ADDRESS 0x70013A32 /end MEASUREMENT
/begin MEASUREMENT dfc_as[9].id "" UWORD CnvRule_NumberOneToOne 1 0 0 65535 ECU_ADDRESS 0x70013A34 /end MEASUREMENT
/begin MEASUREMENT dfc_as[9].debmode "" UWORD CnvRule_NumberOneToOne 1 0 0 65535 ECU_ADDRESS 0x70013A36 /end MEASUREMENT
/begin MEASUREMENT dfc_as[10].id "" UWORD CnvRule_NumberOneToOne 1 0 0 65535 ECU_ADDRESS 0x70013A38 /end MEASUREMENT
/begin MEASUREMENT dfc_as[10].debmode "" UWORD CnvRule_NumberOneToOne 1 0 0 65535 ECU_ADDRESS 0x70013A3A /end MEASUREMENT
/begin MEASUREMENT dfc_as[11].id "" UWORD CnvRule_NumberOneToOne 1 0 0 65535 ECU_ADDRESS 0x70013A3C /end MEASUREMENT
/begin MEASUREMENT dfc_as[11].debmode "" UWORD CnvRule_NumberOneToOne 1 0 0 65535 ECU_ADDRESS 0x70013A3E /end MEASUREMENT
/begin MEASUREMENT dfc_as[12].id "" UWORD CnvRule_NumberOneToOne 1 0 0 65535 ECU_ADDRESS 0x70013A40 /end MEASUREMENT
/begin MEASUREMENT dfc_as[12].debmode "" UWORD CnvRule_NumberOneToOne 1 0 0 65535 ECU_ADDRESS 0x70013A42 /end MEASUREMENT
/begin MEASUREMENT dfc_as[13].id "" UWORD CnvRule_NumberOneToOne 1 0 0 65535 ECU_ADDRESS 0x70013A44 /end MEASUREMENT
/begin MEASUREMENT dfc_as[13].debmode "" UWORD CnvRule_NumberOneToOne 1 0 0 65535 ECU_ADDRESS 0x70013A46 /end MEASUREMENT
/begin MEASUREMENT dfc_as[14].id "" UWORD CnvRule_NumberOneToOne 1 0 0 65535 ECU_ADDRESS 0x70013A48 /end MEASUREMENT
/begin MEASUREMENT dfc_as[14].debmode "" UWORD CnvRule_NumberOneToOne 1 0 0 65535 ECU_ADDRESS 0x70013A4A /end MEASUREMENT
/begin MEASUREMENT dfc_as[15].id "" UWORD CnvRule_NumberOneToOne 1 0 0 65535 ECU_ADDRESS 0x70013A4C /end MEASUREMENT
/begin MEASUREMENT dfc_as[15].debmode "" UWORD CnvRule_NumberOneToOne 1 0 0 65535 ECU_ADDRESS 0x70013A4E /end MEASUREMENT
/begin MEASUREMENT dfc_as[16].id "" UWORD CnvRule_NumberOneToOne 1 0 0 65535 ECU_ADDRESS 0x70013A50 /end MEASUREMENT
/begin MEASUREMENT dfc_as[16].debmode "" UWORD CnvRule_NumberOneToOne 1 0 0 65535 ECU_ADDRESS 0x70013A52 /end MEASUREMENT
/begin MEASUREMENT dfc_as[17].id "" UWORD CnvRule_NumberOneToOne 1 0 0 65535 ECU_ADDRESS 0x70013A54 /end MEASUREMENT
/begin MEASUREMENT dfc_as[17].debmode "" UWORD CnvRule_NumberOneToOne 1 0 0 65535 ECU_ADDRESS 0x70013A56 /end MEASUREMENT
/begin MEASUREMENT dfc_as[18].id "" UWORD CnvRule_NumberOneToOne 1 0 0 65535 ECU_ADDRESS 0x70013A58 /end MEASUREMENT
/begin MEASUREMENT dfc_as[18].debmode "" UWORD CnvRule_NumberOneToOne 1 0 0 65535 ECU_ADDRESS 0x70013A5A /end MEASUREMENT
/begin MEASUREMENT dfc_as[19].id "" UWORD CnvRule_NumberOneToOne 1 0 0 65535 ECU_ADDRESS 0x70013A5C /end MEASUREMENT
/begin MEASUREMENT dfc_as[19].debmode "" UWORD CnvRule_NumberOneToOne 1 0 0 65535 ECU_ADDRESS 0x70013A5E /end MEASUREMENT
/begin MEASUREMENT dfc_as[20].id "" UWORD CnvRule_NumberOneToOne 1 0 0 65535 ECU_ADDRESS 0x70013A60 /end MEASUREMENT
/begin MEASUREMENT dfc_as[20].debmode "" UWORD CnvRule_NumberOneToOne 1 0 0 65535 ECU_ADDRESS 0x70013A62 /end MEASUREMENT
/begin MEASUREMENT dfc_as[21].id "" UWORD CnvRule_NumberOneToOne 1 0 0 65535 ECU_ADDRESS 0x70013A64 /end MEASUREMENT
/begin MEASUREMENT dfc_as[21].debmode "" UWORD CnvRule_NumberOneToOne 1 0 0 65535 ECU_ADDRESS 0x70013A66 /end MEASUREMENT
/begin MEASUREMENT dfc_as[22].id "" UWORD CnvRule_NumberOneToOne 1 0 0 65535 ECU_ADDRESS 0x70013A68 /end MEASUREMENT
/begin MEASUREMENT dfc_as[22].debmode "" UWORD CnvRule_NumberOneToOne 1 0 0 65535 ECU_ADDRESS 0x70013A6A /end MEASUREMENT
/begin MEASUREMENT dfc_as[23].id "" UWORD CnvRule_NumberOneToOne 1 0 0 65535 ECU_ADDRESS 0x70013A6C /end MEASUREMENT
/begin MEASUREMENT dfc_as[23].debmode "" UWORD CnvRule_NumberOneToOne 1 0 0 65535 ECU_ADDRESS 0x70013A6E /end MEASUREMENT
/begin MEASUREMENT dfc_as[24].id "" UWORD CnvRule_NumberOneToOne 1 0 0 65535 ECU_ADDRESS 0x70013A70 /end MEASUREMENT
/begin MEASUREMENT dfc_as[24].debmode "" UWORD CnvRule_NumberOneToOne 1 0 0 65535 ECU_ADDRESS 0x70013A72 /end MEASUREMENT
/begin MEASUREMENT dfc_as[25].id "" UWORD CnvRule_NumberOneToOne 1 0 0 65535 ECU_ADDRESS 0x70013A74 /end MEASUREMENT
/begin MEASUREMENT dfc_as[25].debmode "" UWORD CnvRule_NumberOneToOne 1 0 0 65535 ECU_ADDRESS 0x70013A76 /end MEASUREMENT
/begin MEASUREMENT dfc_as[26].id "" UWORD CnvRule_NumberOneToOne 1 0 0 65535 ECU_ADDRESS 0x70013A78 /end MEASUREMENT
/begin MEASUREMENT dfc_as[26].debmode "" UWORD CnvRule_NumberOneToOne 1 0 0 65535 ECU_ADDRESS 0x70013A7A /end MEASUREMENT
/begin MEASUREMENT dfc_as[27].id "" UWORD CnvRule_NumberOneToOne 1 0 0 65535 ECU_ADDRESS 0x70013A7C /end MEASUREMENT
/begin MEASUREMENT dfc_as[27].debmode "" UWORD CnvRule_NumberOneToOne 1 0 0 65535 ECU_ADDRESS 0x70013A7E /end MEASUREMENT
/begin MEASUREMENT dfc_as[28].id "" UWORD CnvRule_NumberOneToOne 1 0 0 65535 ECU_ADDRESS 0x70013A80 /end MEASUREMENT
/begin MEASUREMENT dfc_as[28].debmode "" UWORD CnvRule_NumberOneToOne 1 0 0 65535 ECU_ADDRESS 0x70013A82 /end MEASUREMENT
/begin MEASUREMENT dfc_as[29].id "" UWORD CnvRule_NumberOneToOne 1 0 0 65535 ECU_ADDRESS 0x70013A84 /end MEASUREMENT
/begin MEASUREMENT dfc_as[29].debmode "" UWORD CnvRule_NumberOneToOne 1 0 0 65535 ECU_ADDRESS 0x70013A86 /end MEASUREMENT
/begin MEASUREMENT dfc_as[30].id "" UWORD CnvRule_NumberOneToOne 1 0 0 65535 ECU_ADDRESS 0x70013A88 /end MEASUREMENT
/begin MEASUREMENT dfc_as[30].debmode "" UWORD CnvRule_NumberOneToOne 1 0 0 65535 ECU_ADDRESS 0x70013A8A /end MEASUREMENT
/begin MEASUREMENT dfc_as[31].id "" UWORD CnvRule_NumberOneToOne 1 0 0 65535 ECU_ADDRESS 0x70013A8C /end MEASUREMENT
/begin MEASUREMENT dfc_as[31].debmode "" UWORD CnvRule_NumberOneToOne 1 0 0 65535 ECU_ADDRESS 0x70013A8E /end MEASUREMENT
/begin MEASUREMENT dfc_as[32].id "" UWORD CnvRule_NumberOneToOne 1 0 0 65535 ECU_ADDRESS 0x70013A90 /end MEASUREMENT
/begin MEASUREMENT dfc_as[32].debmode "" UWORD CnvRule_NumberOneToOne 1 0 0 65535 ECU_ADDRESS 0x70013A92 /end MEASUREMENT
/begin MEASUREMENT status_u16 "" UWORD CnvRule_NumberOneToOne 1 0 0 65535 ECU_ADDRESS 0x7001397E /end MEASUREMENT
/begin MEASUREMENT cntrDfes_u8 "" UBYTE CnvRule_NumberOneToOne 1 0 0 255 ECU_ADDRESS 0x7001370F /end MEASUREMENT
/begin MEASUREMENT cntrApplBuf_u8 "" UBYTE CnvRule_NumberOneToOne 1 0 0 255 ECU_ADDRESS 0x70013A94 /end MEASUREMENT
/begin MEASUREMENT idxActEntry_u8 "" UBYTE CnvRule_NumberOneToOne 1 0 0 255 ECU_ADDRESS 0x70013A95 /end MEASUREMENT
/begin MEASUREMENT idxFirstEmptyEntry_u8 "" UBYTE CnvRule_NumberOneToOne 1 0 0 255 ECU_ADDRESS 0x70013A96 /end MEASUREMENT
/begin MEASUREMENT TIME_IN_ROW "" UBYTE CnvRule_NumberOneToOne 1 0 0 255 ECU_ADDRESS 0x70018861 /end MEASUREMENT
/begin MEASUREMENT EVENT_IN_ROW "" UBYTE CnvRule_NumberOneToOne 1 0 0 255 ECU_ADDRESS 0x70018862 /end MEASUREMENT
/begin MEASUREMENT TIME_UP_DOWN "" UBYTE CnvRule_NumberOneToOne 1 0 0 255 ECU_ADDRESS 0x70018863 /end MEASUREMENT
/begin MEASUREMENT EVENT_UP_DOWN "" UBYTE CnvRule_NumberOneToOne 1 0 0 255 ECU_ADDRESS 0x70018864 /end MEASUREMENT
/begin MEASUREMENT TIME_UP_DOWN_SMALL "" UBYTE CnvRule_NumberOneToOne 1 0 0 255 ECU_ADDRESS 0x70018865 /end MEASUREMENT
/begin MEASUREMENT EVENT_UP_DOWN_SMALL "" UBYTE CnvRule_NumberOneToOne 1 0 0 255 ECU_ADDRESS 0x70018866 /end MEASUREMENT
/begin MEASUREMENT TIME_IN_ROW_SMALL "" UBYTE CnvRule_NumberOneToOne 1 0 0 255 ECU_ADDRESS 0x70018867 /end MEASUREMENT
/begin MEASUREMENT EVENT_IN_ROW_SMALL "" UBYTE CnvRule_NumberOneToOne 1 0 0 255 ECU_ADDRESS 0x70018868 /end MEASUREMENT
/begin MEASUREMENT NO_DEBOUNCE "" UBYTE CnvRule_NumberOneToOne 1 0 0 255 ECU_ADDRESS 0x70018869 /end MEASUREMENT
/begin MEASUREMENT NATIVE "" UBYTE CnvRule_NumberOneToOne 1 0 0 255 ECU_ADDRESS 0x7001886A /end MEASUREMENT
/begin MEASUREMENT PDUR_VARIANT_PRE_COMPILE "" UBYTE CnvRule_NumberOneToOne 1 0 0 255 ECU_ADDRESS 0x7001881A /end MEASUREMENT
/begin MEASUREMENT PDUR_VARIANT_POSTBUILD_LOADABLE "" UBYTE CnvRule_NumberOneToOne 1 0 0 255 ECU_ADDRESS 0x7001881B /end MEASUREMENT
/begin MEASUREMENT PDUR_CONFIGURATION_VARIANT "" UBYTE CnvRule_NumberOneToOne 1 0 0 255 ECU_ADDRESS 0x70018820 /end MEASUREMENT
/begin MEASUREMENT PduRConf_PduRSrcPdu_CddToPduR_HWVrsNumIBS2105_Src "" UBYTE CnvRule_NumberOneToOne 1 0 0 255 ECU_ADDRESS 0x70018821 /end MEASUREMENT
/begin MEASUREMENT PduRConf_PduRDestPdu_PduRToLinTp_HWVrsNumIBS2105_Dest "" UBYTE CnvRule_NumberOneToOne 1 0 0 255 ECU_ADDRESS 0x70018822 /end MEASUREMENT
/begin MEASUREMENT PduRConf_PduRSrcPdu_DoIP_Rx_DoIP2PduR_Src_Java "" UBYTE CnvRule_NumberOneToOne 1 0 0 255 ECU_ADDRESS 0x70018823 /end MEASUREMENT
/begin MEASUREMENT PduRConf_PduRDestPdu_DoIP_Rx_PduR2Dcm_Dest_Java "" UBYTE CnvRule_NumberOneToOne 1 0 0 255 ECU_ADDRESS 0x70018824 /end MEASUREMENT
/begin MEASUREMENT PduRConf_PduRSrcPdu_DoIP_Tx_Dcm2PduR_Src_JavaTool "" UBYTE CnvRule_NumberOneToOne 1 0 0 255 ECU_ADDRESS 0x70018825 /end MEASUREMENT
/begin MEASUREMENT PduRConf_PduRDestPdu_DoIP_Tx_PduR2DoIP_Dest_Java "" UBYTE CnvRule_NumberOneToOne 1 0 0 255 ECU_ADDRESS 0x70018826 /end MEASUREMENT
/begin MEASUREMENT PduRConf_PduRSrcPdu_LinTPToPduR_HWVrsNumIBS2105_Src "" UBYTE CnvRule_NumberOneToOne 1 0 0 255 ECU_ADDRESS 0x70018827 /end MEASUREMENT
/begin MEASUREMENT PduRConf_PduRDestPdu_PduRToCdd_HWVrsNumIBS2105_Dest "" UBYTE CnvRule_NumberOneToOne 1 0 0 255 ECU_ADDRESS 0x70018828 /end MEASUREMENT
/begin MEASUREMENT PduRConf_PduRSrcPdu_NM_TX_FA_Com2PduR_Src "" UBYTE CnvRule_NumberOneToOne 1 0 0 255 ECU_ADDRESS 0x70018829 /end MEASUREMENT
/begin MEASUREMENT PduRConf_PduRDestPdu_NM_TX_FA_PduR2CanNm_Dest "" UBYTE CnvRule_NumberOneToOne 1 0 0 255 ECU_ADDRESS 0x7001882A /end MEASUREMENT
/begin MEASUREMENT PduRConf_PduRSrcPdu_rbr_Pdu_Com2PduR_CCVS_xTx_Src "" UBYTE CnvRule_NumberOneToOne 1 0 0 255 ECU_ADDRESS 0x7001882B /end MEASUREMENT
/begin MEASUREMENT PduRConf_PduRDestPdu_rbr_Pdu_CanIf_CCVS_xTx_Dest "" UBYTE CnvRule_NumberOneToOne 1 0 0 255 ECU_ADDRESS 0x7001882C /end MEASUREMENT
/begin MEASUREMENT PduRConf_PduRSrcPdu_rbr_Pdu_CanIf_sig_C_xRx_Src "" UBYTE CnvRule_NumberOneToOne 1 0 0 255 ECU_ADDRESS 0x7001882D /end MEASUREMENT
/begin MEASUREMENT PduRConf_PduRSrcPdu_rbr_Pdu_Com2PduR_C_xTx_Src "" UBYTE CnvRule_NumberOneToOne 1 0 0 255 ECU_ADDRESS 0x7001882E /end MEASUREMENT
/begin MEASUREMENT PduRConf_PduRDestPdu_rbr_Pdu_CanIf_sig_C_xTx_Dest "" UBYTE CnvRule_NumberOneToOne 1 0 0 255 ECU_ADDRESS 0x7001882F /end MEASUREMENT
/begin MEASUREMENT PduRConf_PduRSrcPdu_rbr_Pdu_CanIf_EngCtrl1_xRx_Dest "" UBYTE CnvRule_NumberOneToOne 1 0 0 255 ECU_ADDRESS 0x70018830 /end MEASUREMENT
/begin MEASUREMENT PduRConf_PduRSrcPdu_UdsOnCan_FctExtdidRx_CanTp2PduR_Src "" UBYTE CnvRule_NumberOneToOne 1 0 0 255 ECU_ADDRESS 0x70018831 /end MEASUREMENT
/begin MEASUREMENT PduRConf_PduRDestPdu_UdsOnCan_FctExtdidRx_PduR2Dcm_Dest "" UBYTE CnvRule_NumberOneToOne 1 0 0 255 ECU_ADDRESS 0x70018832 /end MEASUREMENT
/begin MEASUREMENT PduRConf_PduRSrcPdu_UdsOnCan_PhyRxExtdId_CanTp2PduR_Src "" UBYTE CnvRule_NumberOneToOne 1 0 0 255 ECU_ADDRESS 0x70018833 /end MEASUREMENT
/begin MEASUREMENT PduRConf_PduRDestPdu_UdsOnCan_PhyRxExtdId_PduR2Dcm_Dest "" UBYTE CnvRule_NumberOneToOne 1 0 0 255 ECU_ADDRESS 0x70018834 /end MEASUREMENT
/begin MEASUREMENT PduRConf_PduRSrcPdu_UdsOnCan_PhyTxExtdId_Dcm2PduR_Src "" UBYTE CnvRule_NumberOneToOne 1 0 0 255 ECU_ADDRESS 0x70018835 /end MEASUREMENT
/begin MEASUREMENT PduRConf_PduRDestPdu_UdsOnCan_PhyTxExtdId_PduR2CanTp_Dest "" UBYTE CnvRule_NumberOneToOne 1 0 0 255 ECU_ADDRESS 0x70018836 /end MEASUREMENT
/begin MEASUREMENT LinIfConf_LinIfChannel_LinIfChannel_0 "" UBYTE CnvRule_NumberOneToOne 1 0 0 255 ECU_ADDRESS 0x70018837 /end MEASUREMENT
/begin MEASUREMENT LinIfConf_LinIfFrame_LinIf_MRF "" UBYTE CnvRule_NumberOneToOne 1 0 0 255 ECU_ADDRESS 0x70018838 /end MEASUREMENT
/begin MEASUREMENT LinIfConf_LinIfFrame_LinIf_SRF "" UBYTE CnvRule_NumberOneToOne 1 0 0 255 ECU_ADDRESS 0x70018839 /end MEASUREMENT
/begin MEASUREMENT NULL_SCHEDULE "" UBYTE CnvRule_NumberOneToOne 1 0 0 255 ECU_ADDRESS 0x7001883A /end MEASUREMENT
/begin MEASUREMENT LinIf_Scht_MasterReq_LinIfChannel_0_bds_Pb_preDefRef_vrnt01 "" UBYTE CnvRule_NumberOneToOne 1 0 0 255 ECU_ADDRESS 0x7001883B /end MEASUREMENT
/begin MEASUREMENT LinIf_Scht_SlaveResp_LinIfChannel_0_bds_Pb_preDefRef_vrnt01 "" UBYTE CnvRule_NumberOneToOne 1 0 0 255 ECU_ADDRESS 0x7001883C /end MEASUREMENT
/begin MEASUREMENT LinIf_Scht_RUN_MAIN_LinIfChannel_0_bds_Pb_preDefRef_vrnt01 "" UBYTE CnvRule_NumberOneToOne 1 0 0 255 ECU_ADDRESS 0x7001883D /end MEASUREMENT
/begin MEASUREMENT COM_VARIANT_PRE_COMPILE "" UBYTE CnvRule_NumberOneToOne 1 0 0 255 ECU_ADDRESS 0x7001883E /end MEASUREMENT
/begin MEASUREMENT COM_VARIANT_LINK_TIME "" UBYTE CnvRule_NumberOneToOne 1 0 0 255 ECU_ADDRESS 0x7001883F /end MEASUREMENT
/begin MEASUREMENT COM_VARIANT_POSTBUILD_LOADABLE "" UBYTE CnvRule_NumberOneToOne 1 0 0 255 ECU_ADDRESS 0x70018840 /end MEASUREMENT
/begin MEASUREMENT COM_VARIANT_POSTBUILD_SELECTABLE "" UBYTE CnvRule_NumberOneToOne 1 0 0 255 ECU_ADDRESS 0x70018841 /end MEASUREMENT
/begin MEASUREMENT COM_CONFIGURATION_VARIANT "" UBYTE CnvRule_NumberOneToOne 1 0 0 255 ECU_ADDRESS 0x70018842 /end MEASUREMENT
/begin MEASUREMENT ComConf_ComIPdu_ComIPdu_CCVS_xTx "" UBYTE CnvRule_NumberOneToOne 1 0 0 255 ECU_ADDRESS 0x70018843 /end MEASUREMENT
/begin MEASUREMENT ComConf_ComIPdu_ComIPdu_C_xTx "" UBYTE CnvRule_NumberOneToOne 1 0 0 255 ECU_ADDRESS 0x70018844 /end MEASUREMENT
/begin MEASUREMENT ComConf_ComIPdu_NM_TX_FA "" UBYTE CnvRule_NumberOneToOne 1 0 0 255 ECU_ADDRESS 0x70018845 /end MEASUREMENT
/begin MEASUREMENT ComConf_ComIPdu_ComIPdu_C_xRx "" UBYTE CnvRule_NumberOneToOne 1 0 0 255 ECU_ADDRESS 0x70018846 /end MEASUREMENT
/begin MEASUREMENT ComConf_ComIPdu_ComIPdu_EngCtrl1_xRx "" UBYTE CnvRule_NumberOneToOne 1 0 0 255 ECU_ADDRESS 0x70018847 /end MEASUREMENT
/begin MEASUREMENT ComConf_ComSignal_ComSignal_WheelBasedVehicleSpeed_xTx "" UBYTE CnvRule_NumberOneToOne 1 0 0 255 ECU_ADDRESS 0x70018848 /end MEASUREMENT
/begin MEASUREMENT ComConf_ComSignal_ComSignal_ParkingBrakeSwitch_xTx "" UBYTE CnvRule_NumberOneToOne 1 0 0 255 ECU_ADDRESS 0x70018849 /end MEASUREMENT
/begin MEASUREMENT ComConf_ComSignal_ComSignal_C_xTx "" UBYTE CnvRule_NumberOneToOne 1 0 0 255 ECU_ADDRESS 0x7001884A /end MEASUREMENT
/begin MEASUREMENT ComConf_ComSignal_ComSignal_C_xRx "" UBYTE CnvRule_NumberOneToOne 1 0 0 255 ECU_ADDRESS 0x7001884B /end MEASUREMENT
/begin MEASUREMENT ComConf_ComSignal_ComSignal_EngSpeed_xRx "" UBYTE CnvRule_NumberOneToOne 1 0 0 255 ECU_ADDRESS 0x7001884C /end MEASUREMENT
/begin MEASUREMENT ComConf_ComSignal_ComSignal_ActualEngPercentTorque_xRx "" UBYTE CnvRule_NumberOneToOne 1 0 0 255 ECU_ADDRESS 0x7001884D /end MEASUREMENT
/begin MEASUREMENT ComConf_ComSignalGroup_ComSignalGroup_Tx_1 "" UBYTE CnvRule_NumberOneToOne 1 0 0 255 ECU_ADDRESS 0x7001884E /end MEASUREMENT
/begin MEASUREMENT ComConf_ComSignalGroup_ComSignalGroup_Rx_1 "" UBYTE CnvRule_NumberOneToOne 1 0 0 255 ECU_ADDRESS 0x7001884F /end MEASUREMENT
/begin MEASUREMENT ComConf_ComGroupSignal_ComGroupSignal_Tx "" UBYTE CnvRule_NumberOneToOne 1 0 0 255 ECU_ADDRESS 0x70018850 /end MEASUREMENT
/begin MEASUREMENT ComConf_ComGroupSignal_ComGroupSignal_Rx "" UBYTE CnvRule_NumberOneToOne 1 0 0 255 ECU_ADDRESS 0x70018851 /end MEASUREMENT
/begin MEASUREMENT ComConf_ComIPduGroup_ComIPduGroup_CAN_2_Rx "" UBYTE CnvRule_NumberOneToOne 1 0 0 255 ECU_ADDRESS 0x70018852 /end MEASUREMENT
/begin MEASUREMENT ComConf_ComIPduGroup_ComIPduGroup_CAN_2_Tx "" UBYTE CnvRule_NumberOneToOne 1 0 0 255 ECU_ADDRESS 0x70018853 /end MEASUREMENT
/begin MEASUREMENT ComConf_ComIPduGroup_ComIPduGroup_C_Rx "" UBYTE CnvRule_NumberOneToOne 1 0 0 255 ECU_ADDRESS 0x70018854 /end MEASUREMENT
/begin MEASUREMENT ComConf_ComIPduGroup_ComIPduGroup_C_Tx "" UBYTE CnvRule_NumberOneToOne 1 0 0 255 ECU_ADDRESS 0x70018855 /end MEASUREMENT
/begin MEASUREMENT ComConf_ComIPduGroup_LE_CAN_NM_TX "" UBYTE CnvRule_NumberOneToOne 1 0 0 255 ECU_ADDRESS 0x70018856 /end MEASUREMENT
/begin MEASUREMENT ComConf_ComIPduGroup_LP_CAN_NM_TX "" UBYTE CnvRule_NumberOneToOne 1 0 0 255 ECU_ADDRESS 0x70018857 /end MEASUREMENT
/begin MEASUREMENT ComConf_ComIPduGroup_LinChannel_0_RX "" UBYTE CnvRule_NumberOneToOne 1 0 0 255 ECU_ADDRESS 0x70018858 /end MEASUREMENT
/begin MEASUREMENT ComConf_ComIPduGroup_LinChannel_0_TX "" UBYTE CnvRule_NumberOneToOne 1 0 0 255 ECU_ADDRESS 0x70018859 /end MEASUREMENT
/begin MEASUREMENT ComConf_ComIPduGroup_LinRx "" UBYTE CnvRule_NumberOneToOne 1 0 0 255 ECU_ADDRESS 0x7001885A /end MEASUREMENT
/begin MEASUREMENT ComConf_ComIPduGroup_LinTx "" UBYTE CnvRule_NumberOneToOne 1 0 0 255 ECU_ADDRESS 0x7001885B /end MEASUREMENT
/begin MEASUREMENT ComConf_ComIPduGroup_MLIN_RX "" UBYTE CnvRule_NumberOneToOne 1 0 0 255 ECU_ADDRESS 0x7001885C /end MEASUREMENT
/begin MEASUREMENT ComConf_ComIPduGroup_MLIN_TX "" UBYTE CnvRule_NumberOneToOne 1 0 0 255 ECU_ADDRESS 0x7001885D /end MEASUREMENT
/begin MEASUREMENT ComConf_ComIPduGroup_PT_CAN_RX "" UBYTE CnvRule_NumberOneToOne 1 0 0 255 ECU_ADDRESS 0x7001885E /end MEASUREMENT
/begin MEASUREMENT ComConf_ComIPduGroup_PT_CAN_TX "" UBYTE CnvRule_NumberOneToOne 1 0 0 255 ECU_ADDRESS 0x7001885F /end MEASUREMENT
/begin MEASUREMENT BDS_LIN_CHNL_1_DU8 "" UBYTE CnvRule_NumberOneToOne 1 0 0 255 ECU_ADDRESS 0x70018860 /end MEASUREMENT
/begin COMPU_METHOD CnvRule_NumberOneToOne "This is a predefined standard conversion rule for signals representing a number with a 1:1 conversion (*nr*_*)." IDENTICAL "%.0" "-" /end COMPU_METHOD
