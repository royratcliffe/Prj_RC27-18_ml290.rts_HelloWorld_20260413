/begin MEASUREMENT dataJ1939Dm1Failrs_as[49].dtc_as[13].occ_u8 "" UBYTE CnvRule_NumberOneToOne 1 0 0 255 ECU_ADDRESS 0x70016EA5 /end MEASUREMENT
/begin MEASUREMENT dataJ1939Dm1Failrs_as[49].dtc_as[14].spn_u32 "" ULONG CnvRule_NumberOneToOne 1 0 0 4294967295 ECU_ADDRESS 0x70016EA8 /end MEASUREMENT
/begin MEASUREMENT dataJ1939Dm1Failrs_as[49].dtc_as[14].fmi_u8 "" UBYTE CnvRule_NumberOneToOne 1 0 0 255 ECU_ADDRESS 0x70016EAC /end MEASUREMENT
/begin MEASUREMENT dataJ1939Dm1Failrs_as[49].dtc_as[14].occ_u8 "" UBYTE CnvRule_NumberOneToOne 1 0 0 255 ECU_ADDRESS 0x70016EAD /end MEASUREMENT
/begin MEASUREMENT dataJ1939Dm1Failrs_as[49].dtc_as[15].spn_u32 "" ULONG CnvRule_NumberOneToOne 1 0 0 4294967295 ECU_ADDRESS 0x70016EB0 /end MEASUREMENT
/begin MEASUREMENT dataJ1939Dm1Failrs_as[49].dtc_as[15].fmi_u8 "" UBYTE CnvRule_NumberOneToOne 1 0 0 255 ECU_ADDRESS 0x70016EB4 /end MEASUREMENT
/begin MEASUREMENT dataJ1939Dm1Failrs_as[49].dtc_as[15].occ_u8 "" UBYTE CnvRule_NumberOneToOne 1 0 0 255 ECU_ADDRESS 0x70016EB5 /end MEASUREMENT
/begin MEASUREMENT dataJ1939Dm1Failrs_as[49].dtc_as[16].spn_u32 "" ULONG CnvRule_NumberOneToOne 1 0 0 4294967295 ECU_ADDRESS 0x70016EB8 /end MEASUREMENT
/begin MEASUREMENT dataJ1939Dm1Failrs_as[49].dtc_as[16].fmi_u8 "" UBYTE CnvRule_NumberOneToOne 1 0 0 255 ECU_ADDRESS 0x70016EBC /end MEASUREMENT
/begin MEASUREMENT dataJ1939Dm1Failrs_as[49].dtc_as[16].occ_u8 "" UBYTE CnvRule_NumberOneToOne 1 0 0 255 ECU_ADDRESS 0x70016EBD /end MEASUREMENT
/begin MEASUREMENT dataJ1939Dm1Failrs_as[49].dtc_as[17].spn_u32 "" ULONG CnvRule_NumberOneToOne 1 0 0 4294967295 ECU_ADDRESS 0x70016EC0 /end MEASUREMENT
/begin MEASUREMENT dataJ1939Dm1Failrs_as[49].dtc_as[17].fmi_u8 "" UBYTE CnvRule_NumberOneToOne 1 0 0 255 ECU_ADDRESS 0x70016EC4 /end MEASUREMENT
/begin MEASUREMENT dataJ1939Dm1Failrs_as[49].dtc_as[17].occ_u8 "" UBYTE CnvRule_NumberOneToOne 1 0 0 255 ECU_ADDRESS 0x70016EC5 /end MEASUREMENT
/begin MEASUREMENT dataJ1939Dm1Failrs_as[49].dtc_as[18].spn_u32 "" ULONG CnvRule_NumberOneToOne 1 0 0 4294967295 ECU_ADDRESS 0x70016EC8 /end MEASUREMENT
/begin MEASUREMENT dataJ1939Dm1Failrs_as[49].dtc_as[18].fmi_u8 "" UBYTE CnvRule_NumberOneToOne 1 0 0 255 ECU_ADDRESS 0x70016ECC /end MEASUREMENT
/begin MEASUREMENT dataJ1939Dm1Failrs_as[49].dtc_as[18].occ_u8 "" UBYTE CnvRule_NumberOneToOne 1 0 0 255 ECU_ADDRESS 0x70016ECD /end MEASUREMENT
/begin MEASUREMENT dataJ1939Dm1Failrs_as[49].dtc_as[19].spn_u32 "" ULONG CnvRule_NumberOneToOne 1 0 0 4294967295 ECU_ADDRESS 0x70016ED0 /end MEASUREMENT
/begin MEASUREMENT dataJ1939Dm1Failrs_as[49].dtc_as[19].fmi_u8 "" UBYTE CnvRule_NumberOneToOne 1 0 0 255 ECU_ADDRESS 0x70016ED4 /end MEASUREMENT
/begin MEASUREMENT dataJ1939Dm1Failrs_as[49].dtc_as[19].occ_u8 "" UBYTE CnvRule_NumberOneToOne 1 0 0 255 ECU_ADDRESS 0x70016ED5 /end MEASUREMENT
/begin MEASUREMENT dataJ1939Dm1Failrs_as[49].dtc_as[20].spn_u32 "" ULONG CnvRule_NumberOneToOne 1 0 0 4294967295 ECU_ADDRESS 0x70016ED8 /end MEASUREMENT
/begin MEASUREMENT dataJ1939Dm1Failrs_as[49].dtc_as[20].fmi_u8 "" UBYTE CnvRule_NumberOneToOne 1 0 0 255 ECU_ADDRESS 0x70016EDC /end MEASUREMENT
/begin MEASUREMENT dataJ1939Dm1Failrs_as[49].dtc_as[20].occ_u8 "" UBYTE CnvRule_NumberOneToOne 1 0 0 255 ECU_ADDRESS 0x70016EDD /end MEASUREMENT
/begin MEASUREMENT dataJ1939Dm1Failrs_as[49].dtc_as "" UBYTE CnvRule_NumberOneToOne 1 0 0 255 ECU_ADDRESS 0x70016E40 ARRAY_SIZE 160 /end MEASUREMENT
/begin MEASUREMENT dataJ1939Dm1Failrs_as[50].dtc_as[1].spn_u32 "" ULONG CnvRule_NumberOneToOne 1 0 0 4294967295 ECU_ADDRESS 0x70016EE4 /end MEASUREMENT
/begin MEASUREMENT dataJ1939Dm1Failrs_as[50].dtc_as[1].fmi_u8 "" UBYTE CnvRule_NumberOneToOne 1 0 0 255 ECU_ADDRESS 0x70016EE8 /end MEASUREMENT
/begin MEASUREMENT dataJ1939Dm1Failrs_as[50].dtc_as[1].occ_u8 "" UBYTE CnvRule_NumberOneToOne 1 0 0 255 ECU_ADDRESS 0x70016EE9 /end MEASUREMENT
/begin MEASUREMENT dataJ1939Dm1Failrs_as[50].dtc_as[2].spn_u32 "" ULONG CnvRule_NumberOneToOne 1 0 0 4294967295 ECU_ADDRESS 0x70016EEC /end MEASUREMENT
/begin MEASUREMENT dataJ1939Dm1Failrs_as[50].dtc_as[2].fmi_u8 "" UBYTE CnvRule_NumberOneToOne 1 0 0 255 ECU_ADDRESS 0x70016EF0 /end MEASUREMENT
/begin MEASUREMENT dataJ1939Dm1Failrs_as[50].dtc_as[2].occ_u8 "" UBYTE CnvRule_NumberOneToOne 1 0 0 255 ECU_ADDRESS 0x70016EF1 /end MEASUREMENT
/begin MEASUREMENT dataJ1939Dm1Failrs_as[50].dtc_as[3].spn_u32 "" ULONG CnvRule_NumberOneToOne 1 0 0 4294967295 ECU_ADDRESS 0x70016EF4 /end MEASUREMENT
/begin MEASUREMENT dataJ1939Dm1Failrs_as[50].dtc_as[3].fmi_u8 "" UBYTE CnvRule_NumberOneToOne 1 0 0 255 ECU_ADDRESS 0x70016EF8 /end MEASUREMENT
/begin MEASUREMENT dataJ1939Dm1Failrs_as[50].dtc_as[3].occ_u8 "" UBYTE CnvRule_NumberOneToOne 1 0 0 255 ECU_ADDRESS 0x70016EF9 /end MEASUREMENT
/begin MEASUREMENT dataJ1939Dm1Failrs_as[50].dtc_as[4].spn_u32 "" ULONG CnvRule_NumberOneToOne 1 0 0 4294967295 ECU_ADDRESS 0x70016EFC /end MEASUREMENT
/begin MEASUREMENT dataJ1939Dm1Failrs_as[50].dtc_as[4].fmi_u8 "" UBYTE CnvRule_NumberOneToOne 1 0 0 255 ECU_ADDRESS 0x70016F00 /end MEASUREMENT
/begin MEASUREMENT dataJ1939Dm1Failrs_as[50].dtc_as[4].occ_u8 "" UBYTE CnvRule_NumberOneToOne 1 0 0 255 ECU_ADDRESS 0x70016F01 /end MEASUREMENT
/begin MEASUREMENT dataJ1939Dm1Failrs_as[50].dtc_as[5].spn_u32 "" ULONG CnvRule_NumberOneToOne 1 0 0 4294967295 ECU_ADDRESS 0x70016F04 /end MEASUREMENT
/begin MEASUREMENT dataJ1939Dm1Failrs_as[50].dtc_as[5].fmi_u8 "" UBYTE CnvRule_NumberOneToOne 1 0 0 255 ECU_ADDRESS 0x70016F08 /end MEASUREMENT
/begin MEASUREMENT dataJ1939Dm1Failrs_as[50].dtc_as[5].occ_u8 "" UBYTE CnvRule_NumberOneToOne 1 0 0 255 ECU_ADDRESS 0x70016F09 /end MEASUREMENT
/begin MEASUREMENT dataJ1939Dm1Failrs_as[50].dtc_as[6].spn_u32 "" ULONG CnvRule_NumberOneToOne 1 0 0 4294967295 ECU_ADDRESS 0x70016F0C /end MEASUREMENT
/begin MEASUREMENT dataJ1939Dm1Failrs_as[50].dtc_as[6].fmi_u8 "" UBYTE CnvRule_NumberOneToOne 1 0 0 255 ECU_ADDRESS 0x70016F10 /end MEASUREMENT
/begin MEASUREMENT dataJ1939Dm1Failrs_as[50].dtc_as[6].occ_u8 "" UBYTE CnvRule_NumberOneToOne 1 0 0 255 ECU_ADDRESS 0x70016F11 /end MEASUREMENT
/begin MEASUREMENT dataJ1939Dm1Failrs_as[50].dtc_as[7].spn_u32 "" ULONG CnvRule_NumberOneToOne 1 0 0 4294967295 ECU_ADDRESS 0x70016F14 /end MEASUREMENT
/begin MEASUREMENT dataJ1939Dm1Failrs_as[50].dtc_as[7].fmi_u8 "" UBYTE CnvRule_NumberOneToOne 1 0 0 255 ECU_ADDRESS 0x70016F18 /end MEASUREMENT
/begin MEASUREMENT dataJ1939Dm1Failrs_as[50].dtc_as[7].occ_u8 "" UBYTE CnvRule_NumberOneToOne 1 0 0 255 ECU_ADDRESS 0x70016F19 /end MEASUREMENT
/begin MEASUREMENT dataJ1939Dm1Failrs_as[50].dtc_as[8].spn_u32 "" ULONG CnvRule_NumberOneToOne 1 0 0 4294967295 ECU_ADDRESS 0x70016F1C /end MEASUREMENT
/begin MEASUREMENT dataJ1939Dm1Failrs_as[50].dtc_as[8].fmi_u8 "" UBYTE CnvRule_NumberOneToOne 1 0 0 255 ECU_ADDRESS 0x70016F20 /end MEASUREMENT
/begin MEASUREMENT dataJ1939Dm1Failrs_as[50].dtc_as[8].occ_u8 "" UBYTE CnvRule_NumberOneToOne 1 0 0 255 ECU_ADDRESS 0x70016F21 /end MEASUREMENT
/begin MEASUREMENT dataJ1939Dm1Failrs_as[50].dtc_as[9].spn_u32 "" ULONG CnvRule_NumberOneToOne 1 0 0 4294967295 ECU_ADDRESS 0x70016F24 /end MEASUREMENT
/begin MEASUREMENT dataJ1939Dm1Failrs_as[50].dtc_as[9].fmi_u8 "" UBYTE CnvRule_NumberOneToOne 1 0 0 255 ECU_ADDRESS 0x70016F28 /end MEASUREMENT
/begin MEASUREMENT dataJ1939Dm1Failrs_as[50].dtc_as[9].occ_u8 "" UBYTE CnvRule_NumberOneToOne 1 0 0 255 ECU_ADDRESS 0x70016F29 /end MEASUREMENT
/begin MEASUREMENT dataJ1939Dm1Failrs_as[50].dtc_as[10].spn_u32 "" ULONG CnvRule_NumberOneToOne 1 0 0 4294967295 ECU_ADDRESS 0x70016F2C /end MEASUREMENT
/begin MEASUREMENT dataJ1939Dm1Failrs_as[50].dtc_as[10].fmi_u8 "" UBYTE CnvRule_NumberOneToOne 1 0 0 255 ECU_ADDRESS 0x70016F30 /end MEASUREMENT
/begin MEASUREMENT dataJ1939Dm1Failrs_as[50].dtc_as[10].occ_u8 "" UBYTE CnvRule_NumberOneToOne 1 0 0 255 ECU_ADDRESS 0x70016F31 /end MEASUREMENT
/begin MEASUREMENT dataJ1939Dm1Failrs_as[50].dtc_as[11].spn_u32 "" ULONG CnvRule_NumberOneToOne 1 0 0 4294967295 ECU_ADDRESS 0x70016F34 /end MEASUREMENT
/begin MEASUREMENT dataJ1939Dm1Failrs_as[50].dtc_as[11].fmi_u8 "" UBYTE CnvRule_NumberOneToOne 1 0 0 255 ECU_ADDRESS 0x70016F38 /end MEASUREMENT
/begin MEASUREMENT dataJ1939Dm1Failrs_as[50].dtc_as[11].occ_u8 "" UBYTE CnvRule_NumberOneToOne 1 0 0 255 ECU_ADDRESS 0x70016F39 /end MEASUREMENT
/begin MEASUREMENT dataJ1939Dm1Failrs_as[50].dtc_as[12].spn_u32 "" ULONG CnvRule_NumberOneToOne 1 0 0 4294967295 ECU_ADDRESS 0x70016F3C /end MEASUREMENT
/begin MEASUREMENT dataJ1939Dm1Failrs_as[50].dtc_as[12].fmi_u8 "" UBYTE CnvRule_NumberOneToOne 1 0 0 255 ECU_ADDRESS 0x70016F40 /end MEASUREMENT
/begin MEASUREMENT dataJ1939Dm1Failrs_as[50].dtc_as[12].occ_u8 "" UBYTE CnvRule_NumberOneToOne 1 0 0 255 ECU_ADDRESS 0x70016F41 /end MEASUREMENT
/begin MEASUREMENT dataJ1939Dm1Failrs_as[50].dtc_as[13].spn_u32 "" ULONG CnvRule_NumberOneToOne 1 0 0 4294967295 ECU_ADDRESS 0x70016F44 /end MEASUREMENT
/begin MEASUREMENT dataJ1939Dm1Failrs_as[50].dtc_as[13].fmi_u8 "" UBYTE CnvRule_NumberOneToOne 1 0 0 255 ECU_ADDRESS 0x70016F48 /end MEASUREMENT
/begin MEASUREMENT dataJ1939Dm1Failrs_as[50].dtc_as[13].occ_u8 "" UBYTE CnvRule_NumberOneToOne 1 0 0 255 ECU_ADDRESS 0x70016F49 /end MEASUREMENT
/begin MEASUREMENT dataJ1939Dm1Failrs_as[50].dtc_as[14].spn_u32 "" ULONG CnvRule_NumberOneToOne 1 0 0 4294967295 ECU_ADDRESS 0x70016F4C /end MEASUREMENT
/begin MEASUREMENT dataJ1939Dm1Failrs_as[50].dtc_as[14].fmi_u8 "" UBYTE CnvRule_NumberOneToOne 1 0 0 255 ECU_ADDRESS 0x70016F50 /end MEASUREMENT
/begin MEASUREMENT dataJ1939Dm1Failrs_as[50].dtc_as[14].occ_u8 "" UBYTE CnvRule_NumberOneToOne 1 0 0 255 ECU_ADDRESS 0x70016F51 /end MEASUREMENT
/begin MEASUREMENT dataJ1939Dm1Failrs_as[50].dtc_as[15].spn_u32 "" ULONG CnvRule_NumberOneToOne 1 0 0 4294967295 ECU_ADDRESS 0x70016F54 /end MEASUREMENT
/begin MEASUREMENT dataJ1939Dm1Failrs_as[50].dtc_as[15].fmi_u8 "" UBYTE CnvRule_NumberOneToOne 1 0 0 255 ECU_ADDRESS 0x70016F58 /end MEASUREMENT
/begin MEASUREMENT dataJ1939Dm1Failrs_as[50].dtc_as[15].occ_u8 "" UBYTE CnvRule_NumberOneToOne 1 0 0 255 ECU_ADDRESS 0x70016F59 /end MEASUREMENT
/begin MEASUREMENT dataJ1939Dm1Failrs_as[50].dtc_as[16].spn_u32 "" ULONG CnvRule_NumberOneToOne 1 0 0 4294967295 ECU_ADDRESS 0x70016F5C /end MEASUREMENT
/begin MEASUREMENT dataJ1939Dm1Failrs_as[50].dtc_as[16].fmi_u8 "" UBYTE CnvRule_NumberOneToOne 1 0 0 255 ECU_ADDRESS 0x70016F60 /end MEASUREMENT
/begin MEASUREMENT dataJ1939Dm1Failrs_as[50].dtc_as[16].occ_u8 "" UBYTE CnvRule_NumberOneToOne 1 0 0 255 ECU_ADDRESS 0x70016F61 /end MEASUREMENT
/begin MEASUREMENT dataJ1939Dm1Failrs_as[50].dtc_as[17].spn_u32 "" ULONG CnvRule_NumberOneToOne 1 0 0 4294967295 ECU_ADDRESS 0x70016F64 /end MEASUREMENT
/begin MEASUREMENT dataJ1939Dm1Failrs_as[50].dtc_as[17].fmi_u8 "" UBYTE CnvRule_NumberOneToOne 1 0 0 255 ECU_ADDRESS 0x70016F68 /end MEASUREMENT
/begin MEASUREMENT dataJ1939Dm1Failrs_as[50].dtc_as[17].occ_u8 "" UBYTE CnvRule_NumberOneToOne 1 0 0 255 ECU_ADDRESS 0x70016F69 /end MEASUREMENT
/begin MEASUREMENT dataJ1939Dm1Failrs_as[50].dtc_as[18].spn_u32 "" ULONG CnvRule_NumberOneToOne 1 0 0 4294967295 ECU_ADDRESS 0x70016F6C /end MEASUREMENT
/begin MEASUREMENT dataJ1939Dm1Failrs_as[50].dtc_as[18].fmi_u8 "" UBYTE CnvRule_NumberOneToOne 1 0 0 255 ECU_ADDRESS 0x70016F70 /end MEASUREMENT
/begin MEASUREMENT dataJ1939Dm1Failrs_as[50].dtc_as[18].occ_u8 "" UBYTE CnvRule_NumberOneToOne 1 0 0 255 ECU_ADDRESS 0x70016F71 /end MEASUREMENT
/begin MEASUREMENT dataJ1939Dm1Failrs_as[50].dtc_as[19].spn_u32 "" ULONG CnvRule_NumberOneToOne 1 0 0 4294967295 ECU_ADDRESS 0x70016F74 /end MEASUREMENT
/begin MEASUREMENT dataJ1939Dm1Failrs_as[50].dtc_as[19].fmi_u8 "" UBYTE CnvRule_NumberOneToOne 1 0 0 255 ECU_ADDRESS 0x70016F78 /end MEASUREMENT
/begin MEASUREMENT dataJ1939Dm1Failrs_as[50].dtc_as[19].occ_u8 "" UBYTE CnvRule_NumberOneToOne 1 0 0 255 ECU_ADDRESS 0x70016F79 /end MEASUREMENT
/begin MEASUREMENT dataJ1939Dm1Failrs_as[50].dtc_as[20].spn_u32 "" ULONG CnvRule_NumberOneToOne 1 0 0 4294967295 ECU_ADDRESS 0x70016F7C /end MEASUREMENT
/begin MEASUREMENT dataJ1939Dm1Failrs_as[50].dtc_as[20].fmi_u8 "" UBYTE CnvRule_NumberOneToOne 1 0 0 255 ECU_ADDRESS 0x70016F80 /end MEASUREMENT
/begin MEASUREMENT dataJ1939Dm1Failrs_as[50].dtc_as[20].occ_u8 "" UBYTE CnvRule_NumberOneToOne 1 0 0 255 ECU_ADDRESS 0x70016F81 /end MEASUREMENT
/begin MEASUREMENT dataJ1939Dm1Failrs_as[50].dtc_as "" UBYTE CnvRule_NumberOneToOne 1 0 0 255 ECU_ADDRESS 0x70016EE4 ARRAY_SIZE 160 /end MEASUREMENT
/begin MEASUREMENT dataJ1939Dm1Failrs_as[51].dtc_as[1].spn_u32 "" ULONG CnvRule_NumberOneToOne 1 0 0 4294967295 ECU_ADDRESS 0x70016F88 /end MEASUREMENT
/begin MEASUREMENT dataJ1939Dm1Failrs_as[51].dtc_as[1].fmi_u8 "" UBYTE CnvRule_NumberOneToOne 1 0 0 255 ECU_ADDRESS 0x70016F8C /end MEASUREMENT
/begin MEASUREMENT dataJ1939Dm1Failrs_as[51].dtc_as[1].occ_u8 "" UBYTE CnvRule_NumberOneToOne 1 0 0 255 ECU_ADDRESS 0x70016F8D /end MEASUREMENT
/begin MEASUREMENT dataJ1939Dm1Failrs_as[51].dtc_as[2].spn_u32 "" ULONG CnvRule_NumberOneToOne 1 0 0 4294967295 ECU_ADDRESS 0x70016F90 /end MEASUREMENT
/begin MEASUREMENT dataJ1939Dm1Failrs_as[51].dtc_as[2].fmi_u8 "" UBYTE CnvRule_NumberOneToOne 1 0 0 255 ECU_ADDRESS 0x70016F94 /end MEASUREMENT
/begin MEASUREMENT dataJ1939Dm1Failrs_as[51].dtc_as[2].occ_u8 "" UBYTE CnvRule_NumberOneToOne 1 0 0 255 ECU_ADDRESS 0x70016F95 /end MEASUREMENT
/begin MEASUREMENT dataJ1939Dm1Failrs_as[51].dtc_as[3].spn_u32 "" ULONG CnvRule_NumberOneToOne 1 0 0 4294967295 ECU_ADDRESS 0x70016F98 /end MEASUREMENT
/begin MEASUREMENT dataJ1939Dm1Failrs_as[51].dtc_as[3].fmi_u8 "" UBYTE CnvRule_NumberOneToOne 1 0 0 255 ECU_ADDRESS 0x70016F9C /end MEASUREMENT
/begin MEASUREMENT dataJ1939Dm1Failrs_as[51].dtc_as[3].occ_u8 "" UBYTE CnvRule_NumberOneToOne 1 0 0 255 ECU_ADDRESS 0x70016F9D /end MEASUREMENT
/begin MEASUREMENT dataJ1939Dm1Failrs_as[51].dtc_as[4].spn_u32 "" ULONG CnvRule_NumberOneToOne 1 0 0 4294967295 ECU_ADDRESS 0x70016FA0 /end MEASUREMENT
/begin MEASUREMENT dataJ1939Dm1Failrs_as[51].dtc_as[4].fmi_u8 "" UBYTE CnvRule_NumberOneToOne 1 0 0 255 ECU_ADDRESS 0x70016FA4 /end MEASUREMENT
/begin MEASUREMENT dataJ1939Dm1Failrs_as[51].dtc_as[4].occ_u8 "" UBYTE CnvRule_NumberOneToOne 1 0 0 255 ECU_ADDRESS 0x70016FA5 /end MEASUREMENT
/begin MEASUREMENT dataJ1939Dm1Failrs_as[51].dtc_as[5].spn_u32 "" ULONG CnvRule_NumberOneToOne 1 0 0 4294967295 ECU_ADDRESS 0x70016FA8 /end MEASUREMENT
/begin MEASUREMENT dataJ1939Dm1Failrs_as[51].dtc_as[5].fmi_u8 "" UBYTE CnvRule_NumberOneToOne 1 0 0 255 ECU_ADDRESS 0x70016FAC /end MEASUREMENT
/begin MEASUREMENT dataJ1939Dm1Failrs_as[51].dtc_as[5].occ_u8 "" UBYTE CnvRule_NumberOneToOne 1 0 0 255 ECU_ADDRESS 0x70016FAD /end MEASUREMENT
/begin MEASUREMENT dataJ1939Dm1Failrs_as[51].dtc_as[6].spn_u32 "" ULONG CnvRule_NumberOneToOne 1 0 0 4294967295 ECU_ADDRESS 0x70016FB0 /end MEASUREMENT
/begin MEASUREMENT dataJ1939Dm1Failrs_as[51].dtc_as[6].fmi_u8 "" UBYTE CnvRule_NumberOneToOne 1 0 0 255 ECU_ADDRESS 0x70016FB4 /end MEASUREMENT
/begin MEASUREMENT dataJ1939Dm1Failrs_as[51].dtc_as[6].occ_u8 "" UBYTE CnvRule_NumberOneToOne 1 0 0 255 ECU_ADDRESS 0x70016FB5 /end MEASUREMENT
/begin MEASUREMENT dataJ1939Dm1Failrs_as[51].dtc_as[7].spn_u32 "" ULONG CnvRule_NumberOneToOne 1 0 0 4294967295 ECU_ADDRESS 0x70016FB8 /end MEASUREMENT
/begin MEASUREMENT dataJ1939Dm1Failrs_as[51].dtc_as[7].fmi_u8 "" UBYTE CnvRule_NumberOneToOne 1 0 0 255 ECU_ADDRESS 0x70016FBC /end MEASUREMENT
/begin MEASUREMENT dataJ1939Dm1Failrs_as[51].dtc_as[7].occ_u8 "" UBYTE CnvRule_NumberOneToOne 1 0 0 255 ECU_ADDRESS 0x70016FBD /end MEASUREMENT
/begin MEASUREMENT dataJ1939Dm1Failrs_as[51].dtc_as[8].spn_u32 "" ULONG CnvRule_NumberOneToOne 1 0 0 4294967295 ECU_ADDRESS 0x70016FC0 /end MEASUREMENT
/begin MEASUREMENT dataJ1939Dm1Failrs_as[51].dtc_as[8].fmi_u8 "" UBYTE CnvRule_NumberOneToOne 1 0 0 255 ECU_ADDRESS 0x70016FC4 /end MEASUREMENT
/begin MEASUREMENT dataJ1939Dm1Failrs_as[51].dtc_as[8].occ_u8 "" UBYTE CnvRule_NumberOneToOne 1 0 0 255 ECU_ADDRESS 0x70016FC5 /end MEASUREMENT
/begin MEASUREMENT dataJ1939Dm1Failrs_as[51].dtc_as[9].spn_u32 "" ULONG CnvRule_NumberOneToOne 1 0 0 4294967295 ECU_ADDRESS 0x70016FC8 /end MEASUREMENT
/begin MEASUREMENT dataJ1939Dm1Failrs_as[51].dtc_as[9].fmi_u8 "" UBYTE CnvRule_NumberOneToOne 1 0 0 255 ECU_ADDRESS 0x70016FCC /end MEASUREMENT
/begin MEASUREMENT dataJ1939Dm1Failrs_as[51].dtc_as[9].occ_u8 "" UBYTE CnvRule_NumberOneToOne 1 0 0 255 ECU_ADDRESS 0x70016FCD /end MEASUREMENT
/begin MEASUREMENT dataJ1939Dm1Failrs_as[51].dtc_as[10].spn_u32 "" ULONG CnvRule_NumberOneToOne 1 0 0 4294967295 ECU_ADDRESS 0x70016FD0 /end MEASUREMENT
/begin MEASUREMENT dataJ1939Dm1Failrs_as[51].dtc_as[10].fmi_u8 "" UBYTE CnvRule_NumberOneToOne 1 0 0 255 ECU_ADDRESS 0x70016FD4 /end MEASUREMENT
/begin MEASUREMENT dataJ1939Dm1Failrs_as[51].dtc_as[10].occ_u8 "" UBYTE CnvRule_NumberOneToOne 1 0 0 255 ECU_ADDRESS 0x70016FD5 /end MEASUREMENT
/begin MEASUREMENT dataJ1939Dm1Failrs_as[51].dtc_as[11].spn_u32 "" ULONG CnvRule_NumberOneToOne 1 0 0 4294967295 ECU_ADDRESS 0x70016FD8 /end MEASUREMENT
/begin MEASUREMENT dataJ1939Dm1Failrs_as[51].dtc_as[11].fmi_u8 "" UBYTE CnvRule_NumberOneToOne 1 0 0 255 ECU_ADDRESS 0x70016FDC /end MEASUREMENT
/begin MEASUREMENT dataJ1939Dm1Failrs_as[51].dtc_as[11].occ_u8 "" UBYTE CnvRule_NumberOneToOne 1 0 0 255 ECU_ADDRESS 0x70016FDD /end MEASUREMENT
/begin MEASUREMENT dataJ1939Dm1Failrs_as[51].dtc_as[12].spn_u32 "" ULONG CnvRule_NumberOneToOne 1 0 0 4294967295 ECU_ADDRESS 0x70016FE0 /end MEASUREMENT
/begin MEASUREMENT dataJ1939Dm1Failrs_as[51].dtc_as[12].fmi_u8 "" UBYTE CnvRule_NumberOneToOne 1 0 0 255 ECU_ADDRESS 0x70016FE4 /end MEASUREMENT
/begin MEASUREMENT dataJ1939Dm1Failrs_as[51].dtc_as[12].occ_u8 "" UBYTE CnvRule_NumberOneToOne 1 0 0 255 ECU_ADDRESS 0x70016FE5 /end MEASUREMENT
/begin MEASUREMENT dataJ1939Dm1Failrs_as[51].dtc_as[13].spn_u32 "" ULONG CnvRule_NumberOneToOne 1 0 0 4294967295 ECU_ADDRESS 0x70016FE8 /end MEASUREMENT
/begin MEASUREMENT dataJ1939Dm1Failrs_as[51].dtc_as[13].fmi_u8 "" UBYTE CnvRule_NumberOneToOne 1 0 0 255 ECU_ADDRESS 0x70016FEC /end MEASUREMENT
/begin MEASUREMENT dataJ1939Dm1Failrs_as[51].dtc_as[13].occ_u8 "" UBYTE CnvRule_NumberOneToOne 1 0 0 255 ECU_ADDRESS 0x70016FED /end MEASUREMENT
/begin MEASUREMENT dataJ1939Dm1Failrs_as[51].dtc_as[14].spn_u32 "" ULONG CnvRule_NumberOneToOne 1 0 0 4294967295 ECU_ADDRESS 0x70016FF0 /end MEASUREMENT
/begin MEASUREMENT dataJ1939Dm1Failrs_as[51].dtc_as[14].fmi_u8 "" UBYTE CnvRule_NumberOneToOne 1 0 0 255 ECU_ADDRESS 0x70016FF4 /end MEASUREMENT
/begin MEASUREMENT dataJ1939Dm1Failrs_as[51].dtc_as[14].occ_u8 "" UBYTE CnvRule_NumberOneToOne 1 0 0 255 ECU_ADDRESS 0x70016FF5 /end MEASUREMENT
/begin MEASUREMENT dataJ1939Dm1Failrs_as[51].dtc_as[15].spn_u32 "" ULONG CnvRule_NumberOneToOne 1 0 0 4294967295 ECU_ADDRESS 0x70016FF8 /end MEASUREMENT
/begin MEASUREMENT dataJ1939Dm1Failrs_as[51].dtc_as[15].fmi_u8 "" UBYTE CnvRule_NumberOneToOne 1 0 0 255 ECU_ADDRESS 0x70016FFC /end MEASUREMENT
/begin MEASUREMENT dataJ1939Dm1Failrs_as[51].dtc_as[15].occ_u8 "" UBYTE CnvRule_NumberOneToOne 1 0 0 255 ECU_ADDRESS 0x70016FFD /end MEASUREMENT
/begin MEASUREMENT dataJ1939Dm1Failrs_as[51].dtc_as[16].spn_u32 "" ULONG CnvRule_NumberOneToOne 1 0 0 4294967295 ECU_ADDRESS 0x70017000 /end MEASUREMENT
/begin MEASUREMENT dataJ1939Dm1Failrs_as[51].dtc_as[16].fmi_u8 "" UBYTE CnvRule_NumberOneToOne 1 0 0 255 ECU_ADDRESS 0x70017004 /end MEASUREMENT
/begin MEASUREMENT dataJ1939Dm1Failrs_as[51].dtc_as[16].occ_u8 "" UBYTE CnvRule_NumberOneToOne 1 0 0 255 ECU_ADDRESS 0x70017005 /end MEASUREMENT
/begin MEASUREMENT dataJ1939Dm1Failrs_as[51].dtc_as[17].spn_u32 "" ULONG CnvRule_NumberOneToOne 1 0 0 4294967295 ECU_ADDRESS 0x70017008 /end MEASUREMENT
/begin MEASUREMENT dataJ1939Dm1Failrs_as[51].dtc_as[17].fmi_u8 "" UBYTE CnvRule_NumberOneToOne 1 0 0 255 ECU_ADDRESS 0x7001700C /end MEASUREMENT
/begin MEASUREMENT dataJ1939Dm1Failrs_as[51].dtc_as[17].occ_u8 "" UBYTE CnvRule_NumberOneToOne 1 0 0 255 ECU_ADDRESS 0x7001700D /end MEASUREMENT
/begin MEASUREMENT dataJ1939Dm1Failrs_as[51].dtc_as[18].spn_u32 "" ULONG CnvRule_NumberOneToOne 1 0 0 4294967295 ECU_ADDRESS 0x70017010 /end MEASUREMENT
/begin MEASUREMENT dataJ1939Dm1Failrs_as[51].dtc_as[18].fmi_u8 "" UBYTE CnvRule_NumberOneToOne 1 0 0 255 ECU_ADDRESS 0x70017014 /end MEASUREMENT
/begin MEASUREMENT dataJ1939Dm1Failrs_as[51].dtc_as[18].occ_u8 "" UBYTE CnvRule_NumberOneToOne 1 0 0 255 ECU_ADDRESS 0x70017015 /end MEASUREMENT
/begin MEASUREMENT dataJ1939Dm1Failrs_as[51].dtc_as[19].spn_u32 "" ULONG CnvRule_NumberOneToOne 1 0 0 4294967295 ECU_ADDRESS 0x70017018 /end MEASUREMENT
/begin MEASUREMENT dataJ1939Dm1Failrs_as[51].dtc_as[19].fmi_u8 "" UBYTE CnvRule_NumberOneToOne 1 0 0 255 ECU_ADDRESS 0x7001701C /end MEASUREMENT
/begin MEASUREMENT dataJ1939Dm1Failrs_as[51].dtc_as[19].occ_u8 "" UBYTE CnvRule_NumberOneToOne 1 0 0 255 ECU_ADDRESS 0x7001701D /end MEASUREMENT
/begin MEASUREMENT dataJ1939Dm1Failrs_as[51].dtc_as[20].spn_u32 "" ULONG CnvRule_NumberOneToOne 1 0 0 4294967295 ECU_ADDRESS 0x70017020 /end MEASUREMENT
/begin MEASUREMENT dataJ1939Dm1Failrs_as[51].dtc_as[20].fmi_u8 "" UBYTE CnvRule_NumberOneToOne 1 0 0 255 ECU_ADDRESS 0x70017024 /end MEASUREMENT
/begin MEASUREMENT dataJ1939Dm1Failrs_as[51].dtc_as[20].occ_u8 "" UBYTE CnvRule_NumberOneToOne 1 0 0 255 ECU_ADDRESS 0x70017025 /end MEASUREMENT
/begin MEASUREMENT dataJ1939Dm1Failrs_as[51].dtc_as "" UBYTE CnvRule_NumberOneToOne 1 0 0 255 ECU_ADDRESS 0x70016F88 ARRAY_SIZE 160 /end MEASUREMENT
/begin MEASUREMENT dataJ1939Dm1Failrs_as[52].dtc_as[1].spn_u32 "" ULONG CnvRule_NumberOneToOne 1 0 0 4294967295 ECU_ADDRESS 0x7001702C /end MEASUREMENT
/begin MEASUREMENT dataJ1939Dm1Failrs_as[52].dtc_as[1].fmi_u8 "" UBYTE CnvRule_NumberOneToOne 1 0 0 255 ECU_ADDRESS 0x70017030 /end MEASUREMENT
/begin MEASUREMENT dataJ1939Dm1Failrs_as[52].dtc_as[1].occ_u8 "" UBYTE CnvRule_NumberOneToOne 1 0 0 255 ECU_ADDRESS 0x70017031 /end MEASUREMENT
/begin MEASUREMENT dataJ1939Dm1Failrs_as[52].dtc_as[2].spn_u32 "" ULONG CnvRule_NumberOneToOne 1 0 0 4294967295 ECU_ADDRESS 0x70017034 /end MEASUREMENT
/begin MEASUREMENT dataJ1939Dm1Failrs_as[52].dtc_as[2].fmi_u8 "" UBYTE CnvRule_NumberOneToOne 1 0 0 255 ECU_ADDRESS 0x70017038 /end MEASUREMENT
/begin MEASUREMENT dataJ1939Dm1Failrs_as[52].dtc_as[2].occ_u8 "" UBYTE CnvRule_NumberOneToOne 1 0 0 255 ECU_ADDRESS 0x70017039 /end MEASUREMENT
/begin MEASUREMENT dataJ1939Dm1Failrs_as[52].dtc_as[3].spn_u32 "" ULONG CnvRule_NumberOneToOne 1 0 0 4294967295 ECU_ADDRESS 0x7001703C /end MEASUREMENT
/begin MEASUREMENT dataJ1939Dm1Failrs_as[52].dtc_as[3].fmi_u8 "" UBYTE CnvRule_NumberOneToOne 1 0 0 255 ECU_ADDRESS 0x70017040 /end MEASUREMENT
/begin MEASUREMENT dataJ1939Dm1Failrs_as[52].dtc_as[3].occ_u8 "" UBYTE CnvRule_NumberOneToOne 1 0 0 255 ECU_ADDRESS 0x70017041 /end MEASUREMENT
/begin MEASUREMENT dataJ1939Dm1Failrs_as[52].dtc_as[4].spn_u32 "" ULONG CnvRule_NumberOneToOne 1 0 0 4294967295 ECU_ADDRESS 0x70017044 /end MEASUREMENT
/begin MEASUREMENT dataJ1939Dm1Failrs_as[52].dtc_as[4].fmi_u8 "" UBYTE CnvRule_NumberOneToOne 1 0 0 255 ECU_ADDRESS 0x70017048 /end MEASUREMENT
/begin MEASUREMENT dataJ1939Dm1Failrs_as[52].dtc_as[4].occ_u8 "" UBYTE CnvRule_NumberOneToOne 1 0 0 255 ECU_ADDRESS 0x70017049 /end MEASUREMENT
/begin MEASUREMENT dataJ1939Dm1Failrs_as[52].dtc_as[5].spn_u32 "" ULONG CnvRule_NumberOneToOne 1 0 0 4294967295 ECU_ADDRESS 0x7001704C /end MEASUREMENT
/begin MEASUREMENT dataJ1939Dm1Failrs_as[52].dtc_as[5].fmi_u8 "" UBYTE CnvRule_NumberOneToOne 1 0 0 255 ECU_ADDRESS 0x70017050 /end MEASUREMENT
/begin MEASUREMENT dataJ1939Dm1Failrs_as[52].dtc_as[5].occ_u8 "" UBYTE CnvRule_NumberOneToOne 1 0 0 255 ECU_ADDRESS 0x70017051 /end MEASUREMENT
/begin MEASUREMENT dataJ1939Dm1Failrs_as[52].dtc_as[6].spn_u32 "" ULONG CnvRule_NumberOneToOne 1 0 0 4294967295 ECU_ADDRESS 0x70017054 /end MEASUREMENT
/begin MEASUREMENT dataJ1939Dm1Failrs_as[52].dtc_as[6].fmi_u8 "" UBYTE CnvRule_NumberOneToOne 1 0 0 255 ECU_ADDRESS 0x70017058 /end MEASUREMENT
/begin MEASUREMENT dataJ1939Dm1Failrs_as[52].dtc_as[6].occ_u8 "" UBYTE CnvRule_NumberOneToOne 1 0 0 255 ECU_ADDRESS 0x70017059 /end MEASUREMENT
/begin MEASUREMENT dataJ1939Dm1Failrs_as[52].dtc_as[7].spn_u32 "" ULONG CnvRule_NumberOneToOne 1 0 0 4294967295 ECU_ADDRESS 0x7001705C /end MEASUREMENT
/begin MEASUREMENT dataJ1939Dm1Failrs_as[52].dtc_as[7].fmi_u8 "" UBYTE CnvRule_NumberOneToOne 1 0 0 255 ECU_ADDRESS 0x70017060 /end MEASUREMENT
/begin MEASUREMENT dataJ1939Dm1Failrs_as[52].dtc_as[7].occ_u8 "" UBYTE CnvRule_NumberOneToOne 1 0 0 255 ECU_ADDRESS 0x70017061 /end MEASUREMENT
/begin MEASUREMENT dataJ1939Dm1Failrs_as[52].dtc_as[8].spn_u32 "" ULONG CnvRule_NumberOneToOne 1 0 0 4294967295 ECU_ADDRESS 0x70017064 /end MEASUREMENT
/begin MEASUREMENT dataJ1939Dm1Failrs_as[52].dtc_as[8].fmi_u8 "" UBYTE CnvRule_NumberOneToOne 1 0 0 255 ECU_ADDRESS 0x70017068 /end MEASUREMENT
/begin MEASUREMENT dataJ1939Dm1Failrs_as[52].dtc_as[8].occ_u8 "" UBYTE CnvRule_NumberOneToOne 1 0 0 255 ECU_ADDRESS 0x70017069 /end MEASUREMENT
/begin MEASUREMENT dataJ1939Dm1Failrs_as[52].dtc_as[9].spn_u32 "" ULONG CnvRule_NumberOneToOne 1 0 0 4294967295 ECU_ADDRESS 0x7001706C /end MEASUREMENT
/begin MEASUREMENT dataJ1939Dm1Failrs_as[52].dtc_as[9].fmi_u8 "" UBYTE CnvRule_NumberOneToOne 1 0 0 255 ECU_ADDRESS 0x70017070 /end MEASUREMENT
/begin MEASUREMENT dataJ1939Dm1Failrs_as[52].dtc_as[9].occ_u8 "" UBYTE CnvRule_NumberOneToOne 1 0 0 255 ECU_ADDRESS 0x70017071 /end MEASUREMENT
/begin MEASUREMENT dataJ1939Dm1Failrs_as[52].dtc_as[10].spn_u32 "" ULONG CnvRule_NumberOneToOne 1 0 0 4294967295 ECU_ADDRESS 0x70017074 /end MEASUREMENT
/begin MEASUREMENT dataJ1939Dm1Failrs_as[52].dtc_as[10].fmi_u8 "" UBYTE CnvRule_NumberOneToOne 1 0 0 255 ECU_ADDRESS 0x70017078 /end MEASUREMENT
/begin MEASUREMENT dataJ1939Dm1Failrs_as[52].dtc_as[10].occ_u8 "" UBYTE CnvRule_NumberOneToOne 1 0 0 255 ECU_ADDRESS 0x70017079 /end MEASUREMENT
/begin MEASUREMENT dataJ1939Dm1Failrs_as[52].dtc_as[11].spn_u32 "" ULONG CnvRule_NumberOneToOne 1 0 0 4294967295 ECU_ADDRESS 0x7001707C /end MEASUREMENT
/begin MEASUREMENT dataJ1939Dm1Failrs_as[52].dtc_as[11].fmi_u8 "" UBYTE CnvRule_NumberOneToOne 1 0 0 255 ECU_ADDRESS 0x70017080 /end MEASUREMENT
/begin MEASUREMENT dataJ1939Dm1Failrs_as[52].dtc_as[11].occ_u8 "" UBYTE CnvRule_NumberOneToOne 1 0 0 255 ECU_ADDRESS 0x70017081 /end MEASUREMENT
/begin MEASUREMENT dataJ1939Dm1Failrs_as[52].dtc_as[12].spn_u32 "" ULONG CnvRule_NumberOneToOne 1 0 0 4294967295 ECU_ADDRESS 0x70017084 /end MEASUREMENT
/begin MEASUREMENT dataJ1939Dm1Failrs_as[52].dtc_as[12].fmi_u8 "" UBYTE CnvRule_NumberOneToOne 1 0 0 255 ECU_ADDRESS 0x70017088 /end MEASUREMENT
/begin MEASUREMENT dataJ1939Dm1Failrs_as[52].dtc_as[12].occ_u8 "" UBYTE CnvRule_NumberOneToOne 1 0 0 255 ECU_ADDRESS 0x70017089 /end MEASUREMENT
/begin MEASUREMENT dataJ1939Dm1Failrs_as[52].dtc_as[13].spn_u32 "" ULONG CnvRule_NumberOneToOne 1 0 0 4294967295 ECU_ADDRESS 0x7001708C /end MEASUREMENT
/begin MEASUREMENT dataJ1939Dm1Failrs_as[52].dtc_as[13].fmi_u8 "" UBYTE CnvRule_NumberOneToOne 1 0 0 255 ECU_ADDRESS 0x70017090 /end MEASUREMENT
/begin MEASUREMENT dataJ1939Dm1Failrs_as[52].dtc_as[13].occ_u8 "" UBYTE CnvRule_NumberOneToOne 1 0 0 255 ECU_ADDRESS 0x70017091 /end MEASUREMENT
/begin MEASUREMENT dataJ1939Dm1Failrs_as[52].dtc_as[14].spn_u32 "" ULONG CnvRule_NumberOneToOne 1 0 0 4294967295 ECU_ADDRESS 0x70017094 /end MEASUREMENT
/begin MEASUREMENT dataJ1939Dm1Failrs_as[52].dtc_as[14].fmi_u8 "" UBYTE CnvRule_NumberOneToOne 1 0 0 255 ECU_ADDRESS 0x70017098 /end MEASUREMENT
/begin MEASUREMENT dataJ1939Dm1Failrs_as[52].dtc_as[14].occ_u8 "" UBYTE CnvRule_NumberOneToOne 1 0 0 255 ECU_ADDRESS 0x70017099 /end MEASUREMENT
/begin MEASUREMENT dataJ1939Dm1Failrs_as[52].dtc_as[15].spn_u32 "" ULONG CnvRule_NumberOneToOne 1 0 0 4294967295 ECU_ADDRESS 0x7001709C /end MEASUREMENT
/begin MEASUREMENT dataJ1939Dm1Failrs_as[52].dtc_as[15].fmi_u8 "" UBYTE CnvRule_NumberOneToOne 1 0 0 255 ECU_ADDRESS 0x700170A0 /end MEASUREMENT
/begin MEASUREMENT dataJ1939Dm1Failrs_as[52].dtc_as[15].occ_u8 "" UBYTE CnvRule_NumberOneToOne 1 0 0 255 ECU_ADDRESS 0x700170A1 /end MEASUREMENT
/begin MEASUREMENT dataJ1939Dm1Failrs_as[52].dtc_as[16].spn_u32 "" ULONG CnvRule_NumberOneToOne 1 0 0 4294967295 ECU_ADDRESS 0x700170A4 /end MEASUREMENT
/begin MEASUREMENT dataJ1939Dm1Failrs_as[52].dtc_as[16].fmi_u8 "" UBYTE CnvRule_NumberOneToOne 1 0 0 255 ECU_ADDRESS 0x700170A8 /end MEASUREMENT
/begin MEASUREMENT dataJ1939Dm1Failrs_as[52].dtc_as[16].occ_u8 "" UBYTE CnvRule_NumberOneToOne 1 0 0 255 ECU_ADDRESS 0x700170A9 /end MEASUREMENT
/begin MEASUREMENT dataJ1939Dm1Failrs_as[52].dtc_as[17].spn_u32 "" ULONG CnvRule_NumberOneToOne 1 0 0 4294967295 ECU_ADDRESS 0x700170AC /end MEASUREMENT
/begin MEASUREMENT dataJ1939Dm1Failrs_as[52].dtc_as[17].fmi_u8 "" UBYTE CnvRule_NumberOneToOne 1 0 0 255 ECU_ADDRESS 0x700170B0 /end MEASUREMENT
/begin MEASUREMENT dataJ1939Dm1Failrs_as[52].dtc_as[17].occ_u8 "" UBYTE CnvRule_NumberOneToOne 1 0 0 255 ECU_ADDRESS 0x700170B1 /end MEASUREMENT
/begin MEASUREMENT dataJ1939Dm1Failrs_as[52].dtc_as[18].spn_u32 "" ULONG CnvRule_NumberOneToOne 1 0 0 4294967295 ECU_ADDRESS 0x700170B4 /end MEASUREMENT
/begin MEASUREMENT dataJ1939Dm1Failrs_as[52].dtc_as[18].fmi_u8 "" UBYTE CnvRule_NumberOneToOne 1 0 0 255 ECU_ADDRESS 0x700170B8 /end MEASUREMENT
/begin MEASUREMENT dataJ1939Dm1Failrs_as[52].dtc_as[18].occ_u8 "" UBYTE CnvRule_NumberOneToOne 1 0 0 255 ECU_ADDRESS 0x700170B9 /end MEASUREMENT
/begin MEASUREMENT dataJ1939Dm1Failrs_as[52].dtc_as[19].spn_u32 "" ULONG CnvRule_NumberOneToOne 1 0 0 4294967295 ECU_ADDRESS 0x700170BC /end MEASUREMENT
/begin MEASUREMENT dataJ1939Dm1Failrs_as[52].dtc_as[19].fmi_u8 "" UBYTE CnvRule_NumberOneToOne 1 0 0 255 ECU_ADDRESS 0x700170C0 /end MEASUREMENT
/begin MEASUREMENT dataJ1939Dm1Failrs_as[52].dtc_as[19].occ_u8 "" UBYTE CnvRule_NumberOneToOne 1 0 0 255 ECU_ADDRESS 0x700170C1 /end MEASUREMENT
/begin MEASUREMENT dataJ1939Dm1Failrs_as[52].dtc_as[20].spn_u32 "" ULONG CnvRule_NumberOneToOne 1 0 0 4294967295 ECU_ADDRESS 0x700170C4 /end MEASUREMENT
/begin MEASUREMENT dataJ1939Dm1Failrs_as[52].dtc_as[20].fmi_u8 "" UBYTE CnvRule_NumberOneToOne 1 0 0 255 ECU_ADDRESS 0x700170C8 /end MEASUREMENT
/begin MEASUREMENT dataJ1939Dm1Failrs_as[52].dtc_as[20].occ_u8 "" UBYTE CnvRule_NumberOneToOne 1 0 0 255 ECU_ADDRESS 0x700170C9 /end MEASUREMENT
/begin MEASUREMENT dataJ1939Dm1Failrs_as[52].dtc_as "" UBYTE CnvRule_NumberOneToOne 1 0 0 255 ECU_ADDRESS 0x7001702C ARRAY_SIZE 160 /end MEASUREMENT
/begin MEASUREMENT dataJ1939Dm1Failrs_as[53].dtc_as[1].spn_u32 "" ULONG CnvRule_NumberOneToOne 1 0 0 4294967295 ECU_ADDRESS 0x700170D0 /end MEASUREMENT
/begin MEASUREMENT dataJ1939Dm1Failrs_as[53].dtc_as[1].fmi_u8 "" UBYTE CnvRule_NumberOneToOne 1 0 0 255 ECU_ADDRESS 0x700170D4 /end MEASUREMENT
/begin MEASUREMENT dataJ1939Dm1Failrs_as[53].dtc_as[1].occ_u8 "" UBYTE CnvRule_NumberOneToOne 1 0 0 255 ECU_ADDRESS 0x700170D5 /end MEASUREMENT
/begin MEASUREMENT dataJ1939Dm1Failrs_as[53].dtc_as[2].spn_u32 "" ULONG CnvRule_NumberOneToOne 1 0 0 4294967295 ECU_ADDRESS 0x700170D8 /end MEASUREMENT
/begin MEASUREMENT dataJ1939Dm1Failrs_as[53].dtc_as[2].fmi_u8 "" UBYTE CnvRule_NumberOneToOne 1 0 0 255 ECU_ADDRESS 0x700170DC /end MEASUREMENT
/begin MEASUREMENT dataJ1939Dm1Failrs_as[53].dtc_as[2].occ_u8 "" UBYTE CnvRule_NumberOneToOne 1 0 0 255 ECU_ADDRESS 0x700170DD /end MEASUREMENT
/begin MEASUREMENT dataJ1939Dm1Failrs_as[53].dtc_as[3].spn_u32 "" ULONG CnvRule_NumberOneToOne 1 0 0 4294967295 ECU_ADDRESS 0x700170E0 /end MEASUREMENT
/begin MEASUREMENT dataJ1939Dm1Failrs_as[53].dtc_as[3].fmi_u8 "" UBYTE CnvRule_NumberOneToOne 1 0 0 255 ECU_ADDRESS 0x700170E4 /end MEASUREMENT
/begin MEASUREMENT dataJ1939Dm1Failrs_as[53].dtc_as[3].occ_u8 "" UBYTE CnvRule_NumberOneToOne 1 0 0 255 ECU_ADDRESS 0x700170E5 /end MEASUREMENT
/begin MEASUREMENT dataJ1939Dm1Failrs_as[53].dtc_as[4].spn_u32 "" ULONG CnvRule_NumberOneToOne 1 0 0 4294967295 ECU_ADDRESS 0x700170E8 /end MEASUREMENT
/begin MEASUREMENT dataJ1939Dm1Failrs_as[53].dtc_as[4].fmi_u8 "" UBYTE CnvRule_NumberOneToOne 1 0 0 255 ECU_ADDRESS 0x700170EC /end MEASUREMENT
/begin MEASUREMENT dataJ1939Dm1Failrs_as[53].dtc_as[4].occ_u8 "" UBYTE CnvRule_NumberOneToOne 1 0 0 255 ECU_ADDRESS 0x700170ED /end MEASUREMENT
/begin MEASUREMENT dataJ1939Dm1Failrs_as[53].dtc_as[5].spn_u32 "" ULONG CnvRule_NumberOneToOne 1 0 0 4294967295 ECU_ADDRESS 0x700170F0 /end MEASUREMENT
/begin MEASUREMENT dataJ1939Dm1Failrs_as[53].dtc_as[5].fmi_u8 "" UBYTE CnvRule_NumberOneToOne 1 0 0 255 ECU_ADDRESS 0x700170F4 /end MEASUREMENT
/begin MEASUREMENT dataJ1939Dm1Failrs_as[53].dtc_as[5].occ_u8 "" UBYTE CnvRule_NumberOneToOne 1 0 0 255 ECU_ADDRESS 0x700170F5 /end MEASUREMENT
/begin MEASUREMENT dataJ1939Dm1Failrs_as[53].dtc_as[6].spn_u32 "" ULONG CnvRule_NumberOneToOne 1 0 0 4294967295 ECU_ADDRESS 0x700170F8 /end MEASUREMENT
/begin MEASUREMENT dataJ1939Dm1Failrs_as[53].dtc_as[6].fmi_u8 "" UBYTE CnvRule_NumberOneToOne 1 0 0 255 ECU_ADDRESS 0x700170FC /end MEASUREMENT
/begin MEASUREMENT dataJ1939Dm1Failrs_as[53].dtc_as[6].occ_u8 "" UBYTE CnvRule_NumberOneToOne 1 0 0 255 ECU_ADDRESS 0x700170FD /end MEASUREMENT
/begin MEASUREMENT dataJ1939Dm1Failrs_as[53].dtc_as[7].spn_u32 "" ULONG CnvRule_NumberOneToOne 1 0 0 4294967295 ECU_ADDRESS 0x70017100 /end MEASUREMENT
/begin MEASUREMENT dataJ1939Dm1Failrs_as[53].dtc_as[7].fmi_u8 "" UBYTE CnvRule_NumberOneToOne 1 0 0 255 ECU_ADDRESS 0x70017104 /end MEASUREMENT
/begin MEASUREMENT dataJ1939Dm1Failrs_as[53].dtc_as[7].occ_u8 "" UBYTE CnvRule_NumberOneToOne 1 0 0 255 ECU_ADDRESS 0x70017105 /end MEASUREMENT
/begin MEASUREMENT dataJ1939Dm1Failrs_as[53].dtc_as[8].spn_u32 "" ULONG CnvRule_NumberOneToOne 1 0 0 4294967295 ECU_ADDRESS 0x70017108 /end MEASUREMENT
/begin MEASUREMENT dataJ1939Dm1Failrs_as[53].dtc_as[8].fmi_u8 "" UBYTE CnvRule_NumberOneToOne 1 0 0 255 ECU_ADDRESS 0x7001710C /end MEASUREMENT
/begin MEASUREMENT dataJ1939Dm1Failrs_as[53].dtc_as[8].occ_u8 "" UBYTE CnvRule_NumberOneToOne 1 0 0 255 ECU_ADDRESS 0x7001710D /end MEASUREMENT
/begin MEASUREMENT dataJ1939Dm1Failrs_as[53].dtc_as[9].spn_u32 "" ULONG CnvRule_NumberOneToOne 1 0 0 4294967295 ECU_ADDRESS 0x70017110 /end MEASUREMENT
/begin MEASUREMENT dataJ1939Dm1Failrs_as[53].dtc_as[9].fmi_u8 "" UBYTE CnvRule_NumberOneToOne 1 0 0 255 ECU_ADDRESS 0x70017114 /end MEASUREMENT
/begin MEASUREMENT dataJ1939Dm1Failrs_as[53].dtc_as[9].occ_u8 "" UBYTE CnvRule_NumberOneToOne 1 0 0 255 ECU_ADDRESS 0x70017115 /end MEASUREMENT
/begin MEASUREMENT dataJ1939Dm1Failrs_as[53].dtc_as[10].spn_u32 "" ULONG CnvRule_NumberOneToOne 1 0 0 4294967295 ECU_ADDRESS 0x70017118 /end MEASUREMENT
/begin MEASUREMENT dataJ1939Dm1Failrs_as[53].dtc_as[10].fmi_u8 "" UBYTE CnvRule_NumberOneToOne 1 0 0 255 ECU_ADDRESS 0x7001711C /end MEASUREMENT
/begin MEASUREMENT dataJ1939Dm1Failrs_as[53].dtc_as[10].occ_u8 "" UBYTE CnvRule_NumberOneToOne 1 0 0 255 ECU_ADDRESS 0x7001711D /end MEASUREMENT
/begin MEASUREMENT dataJ1939Dm1Failrs_as[53].dtc_as[11].spn_u32 "" ULONG CnvRule_NumberOneToOne 1 0 0 4294967295 ECU_ADDRESS 0x70017120 /end MEASUREMENT
/begin MEASUREMENT dataJ1939Dm1Failrs_as[53].dtc_as[11].fmi_u8 "" UBYTE CnvRule_NumberOneToOne 1 0 0 255 ECU_ADDRESS 0x70017124 /end MEASUREMENT
/begin MEASUREMENT dataJ1939Dm1Failrs_as[53].dtc_as[11].occ_u8 "" UBYTE CnvRule_NumberOneToOne 1 0 0 255 ECU_ADDRESS 0x70017125 /end MEASUREMENT
/begin MEASUREMENT dataJ1939Dm1Failrs_as[53].dtc_as[12].spn_u32 "" ULONG CnvRule_NumberOneToOne 1 0 0 4294967295 ECU_ADDRESS 0x70017128 /end MEASUREMENT
/begin MEASUREMENT dataJ1939Dm1Failrs_as[53].dtc_as[12].fmi_u8 "" UBYTE CnvRule_NumberOneToOne 1 0 0 255 ECU_ADDRESS 0x7001712C /end MEASUREMENT
/begin MEASUREMENT dataJ1939Dm1Failrs_as[53].dtc_as[12].occ_u8 "" UBYTE CnvRule_NumberOneToOne 1 0 0 255 ECU_ADDRESS 0x7001712D /end MEASUREMENT
/begin MEASUREMENT dataJ1939Dm1Failrs_as[53].dtc_as[13].spn_u32 "" ULONG CnvRule_NumberOneToOne 1 0 0 4294967295 ECU_ADDRESS 0x70017130 /end MEASUREMENT
/begin MEASUREMENT dataJ1939Dm1Failrs_as[53].dtc_as[13].fmi_u8 "" UBYTE CnvRule_NumberOneToOne 1 0 0 255 ECU_ADDRESS 0x70017134 /end MEASUREMENT
/begin MEASUREMENT dataJ1939Dm1Failrs_as[53].dtc_as[13].occ_u8 "" UBYTE CnvRule_NumberOneToOne 1 0 0 255 ECU_ADDRESS 0x70017135 /end MEASUREMENT
/begin MEASUREMENT dataJ1939Dm1Failrs_as[53].dtc_as[14].spn_u32 "" ULONG CnvRule_NumberOneToOne 1 0 0 4294967295 ECU_ADDRESS 0x70017138 /end MEASUREMENT
/begin MEASUREMENT dataJ1939Dm1Failrs_as[53].dtc_as[14].fmi_u8 "" UBYTE CnvRule_NumberOneToOne 1 0 0 255 ECU_ADDRESS 0x7001713C /end MEASUREMENT
/begin MEASUREMENT dataJ1939Dm1Failrs_as[53].dtc_as[14].occ_u8 "" UBYTE CnvRule_NumberOneToOne 1 0 0 255 ECU_ADDRESS 0x7001713D /end MEASUREMENT
/begin MEASUREMENT dataJ1939Dm1Failrs_as[53].dtc_as[15].spn_u32 "" ULONG CnvRule_NumberOneToOne 1 0 0 4294967295 ECU_ADDRESS 0x70017140 /end MEASUREMENT
/begin MEASUREMENT dataJ1939Dm1Failrs_as[53].dtc_as[15].fmi_u8 "" UBYTE CnvRule_NumberOneToOne 1 0 0 255 ECU_ADDRESS 0x70017144 /end MEASUREMENT
/begin MEASUREMENT dataJ1939Dm1Failrs_as[53].dtc_as[15].occ_u8 "" UBYTE CnvRule_NumberOneToOne 1 0 0 255 ECU_ADDRESS 0x70017145 /end MEASUREMENT
/begin MEASUREMENT dataJ1939Dm1Failrs_as[53].dtc_as[16].spn_u32 "" ULONG CnvRule_NumberOneToOne 1 0 0 4294967295 ECU_ADDRESS 0x70017148 /end MEASUREMENT
/begin MEASUREMENT dataJ1939Dm1Failrs_as[53].dtc_as[16].fmi_u8 "" UBYTE CnvRule_NumberOneToOne 1 0 0 255 ECU_ADDRESS 0x7001714C /end MEASUREMENT
/begin MEASUREMENT dataJ1939Dm1Failrs_as[53].dtc_as[16].occ_u8 "" UBYTE CnvRule_NumberOneToOne 1 0 0 255 ECU_ADDRESS 0x7001714D /end MEASUREMENT
/begin MEASUREMENT dataJ1939Dm1Failrs_as[53].dtc_as[17].spn_u32 "" ULONG CnvRule_NumberOneToOne 1 0 0 4294967295 ECU_ADDRESS 0x70017150 /end MEASUREMENT
/begin MEASUREMENT dataJ1939Dm1Failrs_as[53].dtc_as[17].fmi_u8 "" UBYTE CnvRule_NumberOneToOne 1 0 0 255 ECU_ADDRESS 0x70017154 /end MEASUREMENT
/begin MEASUREMENT dataJ1939Dm1Failrs_as[53].dtc_as[17].occ_u8 "" UBYTE CnvRule_NumberOneToOne 1 0 0 255 ECU_ADDRESS 0x70017155 /end MEASUREMENT
/begin MEASUREMENT dataJ1939Dm1Failrs_as[53].dtc_as[18].spn_u32 "" ULONG CnvRule_NumberOneToOne 1 0 0 4294967295 ECU_ADDRESS 0x70017158 /end MEASUREMENT
/begin MEASUREMENT dataJ1939Dm1Failrs_as[53].dtc_as[18].fmi_u8 "" UBYTE CnvRule_NumberOneToOne 1 0 0 255 ECU_ADDRESS 0x7001715C /end MEASUREMENT
/begin MEASUREMENT dataJ1939Dm1Failrs_as[53].dtc_as[18].occ_u8 "" UBYTE CnvRule_NumberOneToOne 1 0 0 255 ECU_ADDRESS 0x7001715D /end MEASUREMENT
/begin MEASUREMENT dataJ1939Dm1Failrs_as[53].dtc_as[19].spn_u32 "" ULONG CnvRule_NumberOneToOne 1 0 0 4294967295 ECU_ADDRESS 0x70017160 /end MEASUREMENT
/begin MEASUREMENT dataJ1939Dm1Failrs_as[53].dtc_as[19].fmi_u8 "" UBYTE CnvRule_NumberOneToOne 1 0 0 255 ECU_ADDRESS 0x70017164 /end MEASUREMENT
/begin MEASUREMENT dataJ1939Dm1Failrs_as[53].dtc_as[19].occ_u8 "" UBYTE CnvRule_NumberOneToOne 1 0 0 255 ECU_ADDRESS 0x70017165 /end MEASUREMENT
/begin MEASUREMENT dataJ1939Dm1Failrs_as[53].dtc_as[20].spn_u32 "" ULONG CnvRule_NumberOneToOne 1 0 0 4294967295 ECU_ADDRESS 0x70017168 /end MEASUREMENT
/begin MEASUREMENT dataJ1939Dm1Failrs_as[53].dtc_as[20].fmi_u8 "" UBYTE CnvRule_NumberOneToOne 1 0 0 255 ECU_ADDRESS 0x7001716C /end MEASUREMENT
/begin MEASUREMENT dataJ1939Dm1Failrs_as[53].dtc_as[20].occ_u8 "" UBYTE CnvRule_NumberOneToOne 1 0 0 255 ECU_ADDRESS 0x7001716D /end MEASUREMENT
/begin MEASUREMENT dataJ1939Dm1Failrs_as[53].dtc_as "" UBYTE CnvRule_NumberOneToOne 1 0 0 255 ECU_ADDRESS 0x700170D0 ARRAY_SIZE 160 /end MEASUREMENT
/begin MEASUREMENT dataJ1939Dm1Failrs_as[54].dtc_as[1].spn_u32 "" ULONG CnvRule_NumberOneToOne 1 0 0 4294967295 ECU_ADDRESS 0x70017174 /end MEASUREMENT
/begin MEASUREMENT dataJ1939Dm1Failrs_as[54].dtc_as[1].fmi_u8 "" UBYTE CnvRule_NumberOneToOne 1 0 0 255 ECU_ADDRESS 0x70017178 /end MEASUREMENT
/begin MEASUREMENT dataJ1939Dm1Failrs_as[54].dtc_as[1].occ_u8 "" UBYTE CnvRule_NumberOneToOne 1 0 0 255 ECU_ADDRESS 0x70017179 /end MEASUREMENT
/begin MEASUREMENT dataJ1939Dm1Failrs_as[54].dtc_as[2].spn_u32 "" ULONG CnvRule_NumberOneToOne 1 0 0 4294967295 ECU_ADDRESS 0x7001717C /end MEASUREMENT
/begin MEASUREMENT dataJ1939Dm1Failrs_as[54].dtc_as[2].fmi_u8 "" UBYTE CnvRule_NumberOneToOne 1 0 0 255 ECU_ADDRESS 0x70017180 /end MEASUREMENT
/begin MEASUREMENT dataJ1939Dm1Failrs_as[54].dtc_as[2].occ_u8 "" UBYTE CnvRule_NumberOneToOne 1 0 0 255 ECU_ADDRESS 0x70017181 /end MEASUREMENT
/begin MEASUREMENT dataJ1939Dm1Failrs_as[54].dtc_as[3].spn_u32 "" ULONG CnvRule_NumberOneToOne 1 0 0 4294967295 ECU_ADDRESS 0x70017184 /end MEASUREMENT
/begin MEASUREMENT dataJ1939Dm1Failrs_as[54].dtc_as[3].fmi_u8 "" UBYTE CnvRule_NumberOneToOne 1 0 0 255 ECU_ADDRESS 0x70017188 /end MEASUREMENT
/begin MEASUREMENT dataJ1939Dm1Failrs_as[54].dtc_as[3].occ_u8 "" UBYTE CnvRule_NumberOneToOne 1 0 0 255 ECU_ADDRESS 0x70017189 /end MEASUREMENT
/begin MEASUREMENT dataJ1939Dm1Failrs_as[54].dtc_as[4].spn_u32 "" ULONG CnvRule_NumberOneToOne 1 0 0 4294967295 ECU_ADDRESS 0x7001718C /end MEASUREMENT
/begin MEASUREMENT dataJ1939Dm1Failrs_as[54].dtc_as[4].fmi_u8 "" UBYTE CnvRule_NumberOneToOne 1 0 0 255 ECU_ADDRESS 0x70017190 /end MEASUREMENT
/begin MEASUREMENT dataJ1939Dm1Failrs_as[54].dtc_as[4].occ_u8 "" UBYTE CnvRule_NumberOneToOne 1 0 0 255 ECU_ADDRESS 0x70017191 /end MEASUREMENT
/begin MEASUREMENT dataJ1939Dm1Failrs_as[54].dtc_as[5].spn_u32 "" ULONG CnvRule_NumberOneToOne 1 0 0 4294967295 ECU_ADDRESS 0x70017194 /end MEASUREMENT
/begin MEASUREMENT dataJ1939Dm1Failrs_as[54].dtc_as[5].fmi_u8 "" UBYTE CnvRule_NumberOneToOne 1 0 0 255 ECU_ADDRESS 0x70017198 /end MEASUREMENT
/begin MEASUREMENT dataJ1939Dm1Failrs_as[54].dtc_as[5].occ_u8 "" UBYTE CnvRule_NumberOneToOne 1 0 0 255 ECU_ADDRESS 0x70017199 /end MEASUREMENT
/begin MEASUREMENT dataJ1939Dm1Failrs_as[54].dtc_as[6].spn_u32 "" ULONG CnvRule_NumberOneToOne 1 0 0 4294967295 ECU_ADDRESS 0x7001719C /end MEASUREMENT
/begin MEASUREMENT dataJ1939Dm1Failrs_as[54].dtc_as[6].fmi_u8 "" UBYTE CnvRule_NumberOneToOne 1 0 0 255 ECU_ADDRESS 0x700171A0 /end MEASUREMENT
/begin MEASUREMENT dataJ1939Dm1Failrs_as[54].dtc_as[6].occ_u8 "" UBYTE CnvRule_NumberOneToOne 1 0 0 255 ECU_ADDRESS 0x700171A1 /end MEASUREMENT
/begin MEASUREMENT dataJ1939Dm1Failrs_as[54].dtc_as[7].spn_u32 "" ULONG CnvRule_NumberOneToOne 1 0 0 4294967295 ECU_ADDRESS 0x700171A4 /end MEASUREMENT
/begin MEASUREMENT dataJ1939Dm1Failrs_as[54].dtc_as[7].fmi_u8 "" UBYTE CnvRule_NumberOneToOne 1 0 0 255 ECU_ADDRESS 0x700171A8 /end MEASUREMENT
/begin MEASUREMENT dataJ1939Dm1Failrs_as[54].dtc_as[7].occ_u8 "" UBYTE CnvRule_NumberOneToOne 1 0 0 255 ECU_ADDRESS 0x700171A9 /end MEASUREMENT
/begin MEASUREMENT dataJ1939Dm1Failrs_as[54].dtc_as[8].spn_u32 "" ULONG CnvRule_NumberOneToOne 1 0 0 4294967295 ECU_ADDRESS 0x700171AC /end MEASUREMENT
/begin MEASUREMENT dataJ1939Dm1Failrs_as[54].dtc_as[8].fmi_u8 "" UBYTE CnvRule_NumberOneToOne 1 0 0 255 ECU_ADDRESS 0x700171B0 /end MEASUREMENT
/begin MEASUREMENT dataJ1939Dm1Failrs_as[54].dtc_as[8].occ_u8 "" UBYTE CnvRule_NumberOneToOne 1 0 0 255 ECU_ADDRESS 0x700171B1 /end MEASUREMENT
/begin MEASUREMENT dataJ1939Dm1Failrs_as[54].dtc_as[9].spn_u32 "" ULONG CnvRule_NumberOneToOne 1 0 0 4294967295 ECU_ADDRESS 0x700171B4 /end MEASUREMENT
/begin MEASUREMENT dataJ1939Dm1Failrs_as[54].dtc_as[9].fmi_u8 "" UBYTE CnvRule_NumberOneToOne 1 0 0 255 ECU_ADDRESS 0x700171B8 /end MEASUREMENT
/begin MEASUREMENT dataJ1939Dm1Failrs_as[54].dtc_as[9].occ_u8 "" UBYTE CnvRule_NumberOneToOne 1 0 0 255 ECU_ADDRESS 0x700171B9 /end MEASUREMENT
/begin MEASUREMENT dataJ1939Dm1Failrs_as[54].dtc_as[10].spn_u32 "" ULONG CnvRule_NumberOneToOne 1 0 0 4294967295 ECU_ADDRESS 0x700171BC /end MEASUREMENT
/begin MEASUREMENT dataJ1939Dm1Failrs_as[54].dtc_as[10].fmi_u8 "" UBYTE CnvRule_NumberOneToOne 1 0 0 255 ECU_ADDRESS 0x700171C0 /end MEASUREMENT
/begin MEASUREMENT dataJ1939Dm1Failrs_as[54].dtc_as[10].occ_u8 "" UBYTE CnvRule_NumberOneToOne 1 0 0 255 ECU_ADDRESS 0x700171C1 /end MEASUREMENT
/begin MEASUREMENT dataJ1939Dm1Failrs_as[54].dtc_as[11].spn_u32 "" ULONG CnvRule_NumberOneToOne 1 0 0 4294967295 ECU_ADDRESS 0x700171C4 /end MEASUREMENT
/begin MEASUREMENT dataJ1939Dm1Failrs_as[54].dtc_as[11].fmi_u8 "" UBYTE CnvRule_NumberOneToOne 1 0 0 255 ECU_ADDRESS 0x700171C8 /end MEASUREMENT
/begin MEASUREMENT dataJ1939Dm1Failrs_as[54].dtc_as[11].occ_u8 "" UBYTE CnvRule_NumberOneToOne 1 0 0 255 ECU_ADDRESS 0x700171C9 /end MEASUREMENT
/begin MEASUREMENT dataJ1939Dm1Failrs_as[54].dtc_as[12].spn_u32 "" ULONG CnvRule_NumberOneToOne 1 0 0 4294967295 ECU_ADDRESS 0x700171CC /end MEASUREMENT
/begin MEASUREMENT dataJ1939Dm1Failrs_as[54].dtc_as[12].fmi_u8 "" UBYTE CnvRule_NumberOneToOne 1 0 0 255 ECU_ADDRESS 0x700171D0 /end MEASUREMENT
/begin MEASUREMENT dataJ1939Dm1Failrs_as[54].dtc_as[12].occ_u8 "" UBYTE CnvRule_NumberOneToOne 1 0 0 255 ECU_ADDRESS 0x700171D1 /end MEASUREMENT
/begin MEASUREMENT dataJ1939Dm1Failrs_as[54].dtc_as[13].spn_u32 "" ULONG CnvRule_NumberOneToOne 1 0 0 4294967295 ECU_ADDRESS 0x700171D4 /end MEASUREMENT
/begin MEASUREMENT dataJ1939Dm1Failrs_as[54].dtc_as[13].fmi_u8 "" UBYTE CnvRule_NumberOneToOne 1 0 0 255 ECU_ADDRESS 0x700171D8 /end MEASUREMENT
/begin MEASUREMENT dataJ1939Dm1Failrs_as[54].dtc_as[13].occ_u8 "" UBYTE CnvRule_NumberOneToOne 1 0 0 255 ECU_ADDRESS 0x700171D9 /end MEASUREMENT
/begin MEASUREMENT dataJ1939Dm1Failrs_as[54].dtc_as[14].spn_u32 "" ULONG CnvRule_NumberOneToOne 1 0 0 4294967295 ECU_ADDRESS 0x700171DC /end MEASUREMENT
/begin MEASUREMENT dataJ1939Dm1Failrs_as[54].dtc_as[14].fmi_u8 "" UBYTE CnvRule_NumberOneToOne 1 0 0 255 ECU_ADDRESS 0x700171E0 /end MEASUREMENT
/begin MEASUREMENT dataJ1939Dm1Failrs_as[54].dtc_as[14].occ_u8 "" UBYTE CnvRule_NumberOneToOne 1 0 0 255 ECU_ADDRESS 0x700171E1 /end MEASUREMENT
/begin MEASUREMENT dataJ1939Dm1Failrs_as[54].dtc_as[15].spn_u32 "" ULONG CnvRule_NumberOneToOne 1 0 0 4294967295 ECU_ADDRESS 0x700171E4 /end MEASUREMENT
/begin MEASUREMENT dataJ1939Dm1Failrs_as[54].dtc_as[15].fmi_u8 "" UBYTE CnvRule_NumberOneToOne 1 0 0 255 ECU_ADDRESS 0x700171E8 /end MEASUREMENT
/begin MEASUREMENT dataJ1939Dm1Failrs_as[54].dtc_as[15].occ_u8 "" UBYTE CnvRule_NumberOneToOne 1 0 0 255 ECU_ADDRESS 0x700171E9 /end MEASUREMENT
/begin MEASUREMENT dataJ1939Dm1Failrs_as[54].dtc_as[16].spn_u32 "" ULONG CnvRule_NumberOneToOne 1 0 0 4294967295 ECU_ADDRESS 0x700171EC /end MEASUREMENT
/begin MEASUREMENT dataJ1939Dm1Failrs_as[54].dtc_as[16].fmi_u8 "" UBYTE CnvRule_NumberOneToOne 1 0 0 255 ECU_ADDRESS 0x700171F0 /end MEASUREMENT
/begin MEASUREMENT dataJ1939Dm1Failrs_as[54].dtc_as[16].occ_u8 "" UBYTE CnvRule_NumberOneToOne 1 0 0 255 ECU_ADDRESS 0x700171F1 /end MEASUREMENT
/begin MEASUREMENT dataJ1939Dm1Failrs_as[54].dtc_as[17].spn_u32 "" ULONG CnvRule_NumberOneToOne 1 0 0 4294967295 ECU_ADDRESS 0x700171F4 /end MEASUREMENT
/begin MEASUREMENT dataJ1939Dm1Failrs_as[54].dtc_as[17].fmi_u8 "" UBYTE CnvRule_NumberOneToOne 1 0 0 255 ECU_ADDRESS 0x700171F8 /end MEASUREMENT
/begin MEASUREMENT dataJ1939Dm1Failrs_as[54].dtc_as[17].occ_u8 "" UBYTE CnvRule_NumberOneToOne 1 0 0 255 ECU_ADDRESS 0x700171F9 /end MEASUREMENT
/begin MEASUREMENT dataJ1939Dm1Failrs_as[54].dtc_as[18].spn_u32 "" ULONG CnvRule_NumberOneToOne 1 0 0 4294967295 ECU_ADDRESS 0x700171FC /end MEASUREMENT
/begin MEASUREMENT dataJ1939Dm1Failrs_as[54].dtc_as[18].fmi_u8 "" UBYTE CnvRule_NumberOneToOne 1 0 0 255 ECU_ADDRESS 0x70017200 /end MEASUREMENT
/begin MEASUREMENT dataJ1939Dm1Failrs_as[54].dtc_as[18].occ_u8 "" UBYTE CnvRule_NumberOneToOne 1 0 0 255 ECU_ADDRESS 0x70017201 /end MEASUREMENT
/begin MEASUREMENT dataJ1939Dm1Failrs_as[54].dtc_as[19].spn_u32 "" ULONG CnvRule_NumberOneToOne 1 0 0 4294967295 ECU_ADDRESS 0x70017204 /end MEASUREMENT
/begin MEASUREMENT dataJ1939Dm1Failrs_as[54].dtc_as[19].fmi_u8 "" UBYTE CnvRule_NumberOneToOne 1 0 0 255 ECU_ADDRESS 0x70017208 /end MEASUREMENT
/begin MEASUREMENT dataJ1939Dm1Failrs_as[54].dtc_as[19].occ_u8 "" UBYTE CnvRule_NumberOneToOne 1 0 0 255 ECU_ADDRESS 0x70017209 /end MEASUREMENT
/begin MEASUREMENT dataJ1939Dm1Failrs_as[54].dtc_as[20].spn_u32 "" ULONG CnvRule_NumberOneToOne 1 0 0 4294967295 ECU_ADDRESS 0x7001720C /end MEASUREMENT
/begin MEASUREMENT dataJ1939Dm1Failrs_as[54].dtc_as[20].fmi_u8 "" UBYTE CnvRule_NumberOneToOne 1 0 0 255 ECU_ADDRESS 0x70017210 /end MEASUREMENT
/begin MEASUREMENT dataJ1939Dm1Failrs_as[54].dtc_as[20].occ_u8 "" UBYTE CnvRule_NumberOneToOne 1 0 0 255 ECU_ADDRESS 0x70017211 /end MEASUREMENT
/begin MEASUREMENT dataJ1939Dm1Failrs_as[54].dtc_as "" UBYTE CnvRule_NumberOneToOne 1 0 0 255 ECU_ADDRESS 0x70017174 ARRAY_SIZE 160 /end MEASUREMENT
/begin MEASUREMENT dataJ1939Dm1Failrs_as[55].dtc_as[1].spn_u32 "" ULONG CnvRule_NumberOneToOne 1 0 0 4294967295 ECU_ADDRESS 0x70017218 /end MEASUREMENT
/begin MEASUREMENT dataJ1939Dm1Failrs_as[55].dtc_as[1].fmi_u8 "" UBYTE CnvRule_NumberOneToOne 1 0 0 255 ECU_ADDRESS 0x7001721C /end MEASUREMENT
/begin MEASUREMENT dataJ1939Dm1Failrs_as[55].dtc_as[1].occ_u8 "" UBYTE CnvRule_NumberOneToOne 1 0 0 255 ECU_ADDRESS 0x7001721D /end MEASUREMENT
/begin MEASUREMENT dataJ1939Dm1Failrs_as[55].dtc_as[2].spn_u32 "" ULONG CnvRule_NumberOneToOne 1 0 0 4294967295 ECU_ADDRESS 0x70017220 /end MEASUREMENT
/begin MEASUREMENT dataJ1939Dm1Failrs_as[55].dtc_as[2].fmi_u8 "" UBYTE CnvRule_NumberOneToOne 1 0 0 255 ECU_ADDRESS 0x70017224 /end MEASUREMENT
/begin MEASUREMENT dataJ1939Dm1Failrs_as[55].dtc_as[2].occ_u8 "" UBYTE CnvRule_NumberOneToOne 1 0 0 255 ECU_ADDRESS 0x70017225 /end MEASUREMENT
/begin MEASUREMENT dataJ1939Dm1Failrs_as[55].dtc_as[3].spn_u32 "" ULONG CnvRule_NumberOneToOne 1 0 0 4294967295 ECU_ADDRESS 0x70017228 /end MEASUREMENT
/begin MEASUREMENT dataJ1939Dm1Failrs_as[55].dtc_as[3].fmi_u8 "" UBYTE CnvRule_NumberOneToOne 1 0 0 255 ECU_ADDRESS 0x7001722C /end MEASUREMENT
/begin MEASUREMENT dataJ1939Dm1Failrs_as[55].dtc_as[3].occ_u8 "" UBYTE CnvRule_NumberOneToOne 1 0 0 255 ECU_ADDRESS 0x7001722D /end MEASUREMENT
/begin MEASUREMENT dataJ1939Dm1Failrs_as[55].dtc_as[4].spn_u32 "" ULONG CnvRule_NumberOneToOne 1 0 0 4294967295 ECU_ADDRESS 0x70017230 /end MEASUREMENT
/begin MEASUREMENT dataJ1939Dm1Failrs_as[55].dtc_as[4].fmi_u8 "" UBYTE CnvRule_NumberOneToOne 1 0 0 255 ECU_ADDRESS 0x70017234 /end MEASUREMENT
/begin MEASUREMENT dataJ1939Dm1Failrs_as[55].dtc_as[4].occ_u8 "" UBYTE CnvRule_NumberOneToOne 1 0 0 255 ECU_ADDRESS 0x70017235 /end MEASUREMENT
/begin MEASUREMENT dataJ1939Dm1Failrs_as[55].dtc_as[5].spn_u32 "" ULONG CnvRule_NumberOneToOne 1 0 0 4294967295 ECU_ADDRESS 0x70017238 /end MEASUREMENT
/begin MEASUREMENT dataJ1939Dm1Failrs_as[55].dtc_as[5].fmi_u8 "" UBYTE CnvRule_NumberOneToOne 1 0 0 255 ECU_ADDRESS 0x7001723C /end MEASUREMENT
/begin MEASUREMENT dataJ1939Dm1Failrs_as[55].dtc_as[5].occ_u8 "" UBYTE CnvRule_NumberOneToOne 1 0 0 255 ECU_ADDRESS 0x7001723D /end MEASUREMENT
/begin MEASUREMENT dataJ1939Dm1Failrs_as[55].dtc_as[6].spn_u32 "" ULONG CnvRule_NumberOneToOne 1 0 0 4294967295 ECU_ADDRESS 0x70017240 /end MEASUREMENT
/begin MEASUREMENT dataJ1939Dm1Failrs_as[55].dtc_as[6].fmi_u8 "" UBYTE CnvRule_NumberOneToOne 1 0 0 255 ECU_ADDRESS 0x70017244 /end MEASUREMENT
/begin MEASUREMENT dataJ1939Dm1Failrs_as[55].dtc_as[6].occ_u8 "" UBYTE CnvRule_NumberOneToOne 1 0 0 255 ECU_ADDRESS 0x70017245 /end MEASUREMENT
/begin MEASUREMENT dataJ1939Dm1Failrs_as[55].dtc_as[7].spn_u32 "" ULONG CnvRule_NumberOneToOne 1 0 0 4294967295 ECU_ADDRESS 0x70017248 /end MEASUREMENT
/begin MEASUREMENT dataJ1939Dm1Failrs_as[55].dtc_as[7].fmi_u8 "" UBYTE CnvRule_NumberOneToOne 1 0 0 255 ECU_ADDRESS 0x7001724C /end MEASUREMENT
/begin MEASUREMENT dataJ1939Dm1Failrs_as[55].dtc_as[7].occ_u8 "" UBYTE CnvRule_NumberOneToOne 1 0 0 255 ECU_ADDRESS 0x7001724D /end MEASUREMENT
/begin MEASUREMENT dataJ1939Dm1Failrs_as[55].dtc_as[8].spn_u32 "" ULONG CnvRule_NumberOneToOne 1 0 0 4294967295 ECU_ADDRESS 0x70017250 /end MEASUREMENT
/begin MEASUREMENT dataJ1939Dm1Failrs_as[55].dtc_as[8].fmi_u8 "" UBYTE CnvRule_NumberOneToOne 1 0 0 255 ECU_ADDRESS 0x70017254 /end MEASUREMENT
/begin MEASUREMENT dataJ1939Dm1Failrs_as[55].dtc_as[8].occ_u8 "" UBYTE CnvRule_NumberOneToOne 1 0 0 255 ECU_ADDRESS 0x70017255 /end MEASUREMENT
/begin MEASUREMENT dataJ1939Dm1Failrs_as[55].dtc_as[9].spn_u32 "" ULONG CnvRule_NumberOneToOne 1 0 0 4294967295 ECU_ADDRESS 0x70017258 /end MEASUREMENT
/begin MEASUREMENT dataJ1939Dm1Failrs_as[55].dtc_as[9].fmi_u8 "" UBYTE CnvRule_NumberOneToOne 1 0 0 255 ECU_ADDRESS 0x7001725C /end MEASUREMENT
/begin MEASUREMENT dataJ1939Dm1Failrs_as[55].dtc_as[9].occ_u8 "" UBYTE CnvRule_NumberOneToOne 1 0 0 255 ECU_ADDRESS 0x7001725D /end MEASUREMENT
/begin MEASUREMENT dataJ1939Dm1Failrs_as[55].dtc_as[10].spn_u32 "" ULONG CnvRule_NumberOneToOne 1 0 0 4294967295 ECU_ADDRESS 0x70017260 /end MEASUREMENT
/begin MEASUREMENT dataJ1939Dm1Failrs_as[55].dtc_as[10].fmi_u8 "" UBYTE CnvRule_NumberOneToOne 1 0 0 255 ECU_ADDRESS 0x70017264 /end MEASUREMENT
/begin MEASUREMENT dataJ1939Dm1Failrs_as[55].dtc_as[10].occ_u8 "" UBYTE CnvRule_NumberOneToOne 1 0 0 255 ECU_ADDRESS 0x70017265 /end MEASUREMENT
/begin MEASUREMENT dataJ1939Dm1Failrs_as[55].dtc_as[11].spn_u32 "" ULONG CnvRule_NumberOneToOne 1 0 0 4294967295 ECU_ADDRESS 0x70017268 /end MEASUREMENT
/begin MEASUREMENT dataJ1939Dm1Failrs_as[55].dtc_as[11].fmi_u8 "" UBYTE CnvRule_NumberOneToOne 1 0 0 255 ECU_ADDRESS 0x7001726C /end MEASUREMENT
/begin MEASUREMENT dataJ1939Dm1Failrs_as[55].dtc_as[11].occ_u8 "" UBYTE CnvRule_NumberOneToOne 1 0 0 255 ECU_ADDRESS 0x7001726D /end MEASUREMENT
/begin MEASUREMENT dataJ1939Dm1Failrs_as[55].dtc_as[12].spn_u32 "" ULONG CnvRule_NumberOneToOne 1 0 0 4294967295 ECU_ADDRESS 0x70017270 /end MEASUREMENT
/begin MEASUREMENT dataJ1939Dm1Failrs_as[55].dtc_as[12].fmi_u8 "" UBYTE CnvRule_NumberOneToOne 1 0 0 255 ECU_ADDRESS 0x70017274 /end MEASUREMENT
/begin MEASUREMENT dataJ1939Dm1Failrs_as[55].dtc_as[12].occ_u8 "" UBYTE CnvRule_NumberOneToOne 1 0 0 255 ECU_ADDRESS 0x70017275 /end MEASUREMENT
/begin MEASUREMENT dataJ1939Dm1Failrs_as[55].dtc_as[13].spn_u32 "" ULONG CnvRule_NumberOneToOne 1 0 0 4294967295 ECU_ADDRESS 0x70017278 /end MEASUREMENT
/begin MEASUREMENT dataJ1939Dm1Failrs_as[55].dtc_as[13].fmi_u8 "" UBYTE CnvRule_NumberOneToOne 1 0 0 255 ECU_ADDRESS 0x7001727C /end MEASUREMENT
/begin MEASUREMENT dataJ1939Dm1Failrs_as[55].dtc_as[13].occ_u8 "" UBYTE CnvRule_NumberOneToOne 1 0 0 255 ECU_ADDRESS 0x7001727D /end MEASUREMENT
/begin MEASUREMENT dataJ1939Dm1Failrs_as[55].dtc_as[14].spn_u32 "" ULONG CnvRule_NumberOneToOne 1 0 0 4294967295 ECU_ADDRESS 0x70017280 /end MEASUREMENT
/begin MEASUREMENT dataJ1939Dm1Failrs_as[55].dtc_as[14].fmi_u8 "" UBYTE CnvRule_NumberOneToOne 1 0 0 255 ECU_ADDRESS 0x70017284 /end MEASUREMENT
/begin MEASUREMENT dataJ1939Dm1Failrs_as[55].dtc_as[14].occ_u8 "" UBYTE CnvRule_NumberOneToOne 1 0 0 255 ECU_ADDRESS 0x70017285 /end MEASUREMENT
/begin MEASUREMENT dataJ1939Dm1Failrs_as[55].dtc_as[15].spn_u32 "" ULONG CnvRule_NumberOneToOne 1 0 0 4294967295 ECU_ADDRESS 0x70017288 /end MEASUREMENT
/begin MEASUREMENT dataJ1939Dm1Failrs_as[55].dtc_as[15].fmi_u8 "" UBYTE CnvRule_NumberOneToOne 1 0 0 255 ECU_ADDRESS 0x7001728C /end MEASUREMENT
/begin MEASUREMENT dataJ1939Dm1Failrs_as[55].dtc_as[15].occ_u8 "" UBYTE CnvRule_NumberOneToOne 1 0 0 255 ECU_ADDRESS 0x7001728D /end MEASUREMENT
/begin MEASUREMENT dataJ1939Dm1Failrs_as[55].dtc_as[16].spn_u32 "" ULONG CnvRule_NumberOneToOne 1 0 0 4294967295 ECU_ADDRESS 0x70017290 /end MEASUREMENT
/begin MEASUREMENT dataJ1939Dm1Failrs_as[55].dtc_as[16].fmi_u8 "" UBYTE CnvRule_NumberOneToOne 1 0 0 255 ECU_ADDRESS 0x70017294 /end MEASUREMENT
/begin MEASUREMENT dataJ1939Dm1Failrs_as[55].dtc_as[16].occ_u8 "" UBYTE CnvRule_NumberOneToOne 1 0 0 255 ECU_ADDRESS 0x70017295 /end MEASUREMENT
/begin MEASUREMENT dataJ1939Dm1Failrs_as[55].dtc_as[17].spn_u32 "" ULONG CnvRule_NumberOneToOne 1 0 0 4294967295 ECU_ADDRESS 0x70017298 /end MEASUREMENT
/begin MEASUREMENT dataJ1939Dm1Failrs_as[55].dtc_as[17].fmi_u8 "" UBYTE CnvRule_NumberOneToOne 1 0 0 255 ECU_ADDRESS 0x7001729C /end MEASUREMENT
/begin MEASUREMENT dataJ1939Dm1Failrs_as[55].dtc_as[17].occ_u8 "" UBYTE CnvRule_NumberOneToOne 1 0 0 255 ECU_ADDRESS 0x7001729D /end MEASUREMENT
/begin MEASUREMENT dataJ1939Dm1Failrs_as[55].dtc_as[18].spn_u32 "" ULONG CnvRule_NumberOneToOne 1 0 0 4294967295 ECU_ADDRESS 0x700172A0 /end MEASUREMENT
/begin MEASUREMENT dataJ1939Dm1Failrs_as[55].dtc_as[18].fmi_u8 "" UBYTE CnvRule_NumberOneToOne 1 0 0 255 ECU_ADDRESS 0x700172A4 /end MEASUREMENT
/begin MEASUREMENT dataJ1939Dm1Failrs_as[55].dtc_as[18].occ_u8 "" UBYTE CnvRule_NumberOneToOne 1 0 0 255 ECU_ADDRESS 0x700172A5 /end MEASUREMENT
/begin MEASUREMENT dataJ1939Dm1Failrs_as[55].dtc_as[19].spn_u32 "" ULONG CnvRule_NumberOneToOne 1 0 0 4294967295 ECU_ADDRESS 0x700172A8 /end MEASUREMENT
/begin MEASUREMENT dataJ1939Dm1Failrs_as[55].dtc_as[19].fmi_u8 "" UBYTE CnvRule_NumberOneToOne 1 0 0 255 ECU_ADDRESS 0x700172AC /end MEASUREMENT
/begin MEASUREMENT dataJ1939Dm1Failrs_as[55].dtc_as[19].occ_u8 "" UBYTE CnvRule_NumberOneToOne 1 0 0 255 ECU_ADDRESS 0x700172AD /end MEASUREMENT
/begin MEASUREMENT dataJ1939Dm1Failrs_as[55].dtc_as[20].spn_u32 "" ULONG CnvRule_NumberOneToOne 1 0 0 4294967295 ECU_ADDRESS 0x700172B0 /end MEASUREMENT
/begin MEASUREMENT dataJ1939Dm1Failrs_as[55].dtc_as[20].fmi_u8 "" UBYTE CnvRule_NumberOneToOne 1 0 0 255 ECU_ADDRESS 0x700172B4 /end MEASUREMENT
/begin MEASUREMENT dataJ1939Dm1Failrs_as[55].dtc_as[20].occ_u8 "" UBYTE CnvRule_NumberOneToOne 1 0 0 255 ECU_ADDRESS 0x700172B5 /end MEASUREMENT
/begin MEASUREMENT dataJ1939Dm1Failrs_as[55].dtc_as "" UBYTE CnvRule_NumberOneToOne 1 0 0 255 ECU_ADDRESS 0x70017218 ARRAY_SIZE 160 /end MEASUREMENT
/begin MEASUREMENT dataJ1939Dm1Failrs_as[56].dtc_as[1].spn_u32 "" ULONG CnvRule_NumberOneToOne 1 0 0 4294967295 ECU_ADDRESS 0x700172BC /end MEASUREMENT
/begin MEASUREMENT dataJ1939Dm1Failrs_as[56].dtc_as[1].fmi_u8 "" UBYTE CnvRule_NumberOneToOne 1 0 0 255 ECU_ADDRESS 0x700172C0 /end MEASUREMENT
/begin MEASUREMENT dataJ1939Dm1Failrs_as[56].dtc_as[1].occ_u8 "" UBYTE CnvRule_NumberOneToOne 1 0 0 255 ECU_ADDRESS 0x700172C1 /end MEASUREMENT
/begin MEASUREMENT dataJ1939Dm1Failrs_as[56].dtc_as[2].spn_u32 "" ULONG CnvRule_NumberOneToOne 1 0 0 4294967295 ECU_ADDRESS 0x700172C4 /end MEASUREMENT
/begin MEASUREMENT dataJ1939Dm1Failrs_as[56].dtc_as[2].fmi_u8 "" UBYTE CnvRule_NumberOneToOne 1 0 0 255 ECU_ADDRESS 0x700172C8 /end MEASUREMENT
/begin MEASUREMENT dataJ1939Dm1Failrs_as[56].dtc_as[2].occ_u8 "" UBYTE CnvRule_NumberOneToOne 1 0 0 255 ECU_ADDRESS 0x700172C9 /end MEASUREMENT
/begin MEASUREMENT dataJ1939Dm1Failrs_as[56].dtc_as[3].spn_u32 "" ULONG CnvRule_NumberOneToOne 1 0 0 4294967295 ECU_ADDRESS 0x700172CC /end MEASUREMENT
/begin MEASUREMENT dataJ1939Dm1Failrs_as[56].dtc_as[3].fmi_u8 "" UBYTE CnvRule_NumberOneToOne 1 0 0 255 ECU_ADDRESS 0x700172D0 /end MEASUREMENT
/begin MEASUREMENT dataJ1939Dm1Failrs_as[56].dtc_as[3].occ_u8 "" UBYTE CnvRule_NumberOneToOne 1 0 0 255 ECU_ADDRESS 0x700172D1 /end MEASUREMENT
/begin MEASUREMENT dataJ1939Dm1Failrs_as[56].dtc_as[4].spn_u32 "" ULONG CnvRule_NumberOneToOne 1 0 0 4294967295 ECU_ADDRESS 0x700172D4 /end MEASUREMENT
/begin MEASUREMENT dataJ1939Dm1Failrs_as[56].dtc_as[4].fmi_u8 "" UBYTE CnvRule_NumberOneToOne 1 0 0 255 ECU_ADDRESS 0x700172D8 /end MEASUREMENT
/begin MEASUREMENT dataJ1939Dm1Failrs_as[56].dtc_as[4].occ_u8 "" UBYTE CnvRule_NumberOneToOne 1 0 0 255 ECU_ADDRESS 0x700172D9 /end MEASUREMENT
/begin MEASUREMENT dataJ1939Dm1Failrs_as[56].dtc_as[5].spn_u32 "" ULONG CnvRule_NumberOneToOne 1 0 0 4294967295 ECU_ADDRESS 0x700172DC /end MEASUREMENT
/begin MEASUREMENT dataJ1939Dm1Failrs_as[56].dtc_as[5].fmi_u8 "" UBYTE CnvRule_NumberOneToOne 1 0 0 255 ECU_ADDRESS 0x700172E0 /end MEASUREMENT
/begin MEASUREMENT dataJ1939Dm1Failrs_as[56].dtc_as[5].occ_u8 "" UBYTE CnvRule_NumberOneToOne 1 0 0 255 ECU_ADDRESS 0x700172E1 /end MEASUREMENT
/begin MEASUREMENT dataJ1939Dm1Failrs_as[56].dtc_as[6].spn_u32 "" ULONG CnvRule_NumberOneToOne 1 0 0 4294967295 ECU_ADDRESS 0x700172E4 /end MEASUREMENT
/begin MEASUREMENT dataJ1939Dm1Failrs_as[56].dtc_as[6].fmi_u8 "" UBYTE CnvRule_NumberOneToOne 1 0 0 255 ECU_ADDRESS 0x700172E8 /end MEASUREMENT
/begin MEASUREMENT dataJ1939Dm1Failrs_as[56].dtc_as[6].occ_u8 "" UBYTE CnvRule_NumberOneToOne 1 0 0 255 ECU_ADDRESS 0x700172E9 /end MEASUREMENT
/begin MEASUREMENT dataJ1939Dm1Failrs_as[56].dtc_as[7].spn_u32 "" ULONG CnvRule_NumberOneToOne 1 0 0 4294967295 ECU_ADDRESS 0x700172EC /end MEASUREMENT
/begin MEASUREMENT dataJ1939Dm1Failrs_as[56].dtc_as[7].fmi_u8 "" UBYTE CnvRule_NumberOneToOne 1 0 0 255 ECU_ADDRESS 0x700172F0 /end MEASUREMENT
/begin MEASUREMENT dataJ1939Dm1Failrs_as[56].dtc_as[7].occ_u8 "" UBYTE CnvRule_NumberOneToOne 1 0 0 255 ECU_ADDRESS 0x700172F1 /end MEASUREMENT
/begin MEASUREMENT dataJ1939Dm1Failrs_as[56].dtc_as[8].spn_u32 "" ULONG CnvRule_NumberOneToOne 1 0 0 4294967295 ECU_ADDRESS 0x700172F4 /end MEASUREMENT
/begin MEASUREMENT dataJ1939Dm1Failrs_as[56].dtc_as[8].fmi_u8 "" UBYTE CnvRule_NumberOneToOne 1 0 0 255 ECU_ADDRESS 0x700172F8 /end MEASUREMENT
/begin MEASUREMENT dataJ1939Dm1Failrs_as[56].dtc_as[8].occ_u8 "" UBYTE CnvRule_NumberOneToOne 1 0 0 255 ECU_ADDRESS 0x700172F9 /end MEASUREMENT
/begin MEASUREMENT dataJ1939Dm1Failrs_as[56].dtc_as[9].spn_u32 "" ULONG CnvRule_NumberOneToOne 1 0 0 4294967295 ECU_ADDRESS 0x700172FC /end MEASUREMENT
/begin MEASUREMENT dataJ1939Dm1Failrs_as[56].dtc_as[9].fmi_u8 "" UBYTE CnvRule_NumberOneToOne 1 0 0 255 ECU_ADDRESS 0x70017300 /end MEASUREMENT
/begin MEASUREMENT dataJ1939Dm1Failrs_as[56].dtc_as[9].occ_u8 "" UBYTE CnvRule_NumberOneToOne 1 0 0 255 ECU_ADDRESS 0x70017301 /end MEASUREMENT
/begin MEASUREMENT dataJ1939Dm1Failrs_as[56].dtc_as[10].spn_u32 "" ULONG CnvRule_NumberOneToOne 1 0 0 4294967295 ECU_ADDRESS 0x70017304 /end MEASUREMENT
/begin MEASUREMENT dataJ1939Dm1Failrs_as[56].dtc_as[10].fmi_u8 "" UBYTE CnvRule_NumberOneToOne 1 0 0 255 ECU_ADDRESS 0x70017308 /end MEASUREMENT
/begin MEASUREMENT dataJ1939Dm1Failrs_as[56].dtc_as[10].occ_u8 "" UBYTE CnvRule_NumberOneToOne 1 0 0 255 ECU_ADDRESS 0x70017309 /end MEASUREMENT
/begin MEASUREMENT dataJ1939Dm1Failrs_as[56].dtc_as[11].spn_u32 "" ULONG CnvRule_NumberOneToOne 1 0 0 4294967295 ECU_ADDRESS 0x7001730C /end MEASUREMENT
/begin MEASUREMENT dataJ1939Dm1Failrs_as[56].dtc_as[11].fmi_u8 "" UBYTE CnvRule_NumberOneToOne 1 0 0 255 ECU_ADDRESS 0x70017310 /end MEASUREMENT
/begin MEASUREMENT dataJ1939Dm1Failrs_as[56].dtc_as[11].occ_u8 "" UBYTE CnvRule_NumberOneToOne 1 0 0 255 ECU_ADDRESS 0x70017311 /end MEASUREMENT
/begin MEASUREMENT dataJ1939Dm1Failrs_as[56].dtc_as[12].spn_u32 "" ULONG CnvRule_NumberOneToOne 1 0 0 4294967295 ECU_ADDRESS 0x70017314 /end MEASUREMENT
/begin MEASUREMENT dataJ1939Dm1Failrs_as[56].dtc_as[12].fmi_u8 "" UBYTE CnvRule_NumberOneToOne 1 0 0 255 ECU_ADDRESS 0x70017318 /end MEASUREMENT
/begin MEASUREMENT dataJ1939Dm1Failrs_as[56].dtc_as[12].occ_u8 "" UBYTE CnvRule_NumberOneToOne 1 0 0 255 ECU_ADDRESS 0x70017319 /end MEASUREMENT
/begin MEASUREMENT dataJ1939Dm1Failrs_as[56].dtc_as[13].spn_u32 "" ULONG CnvRule_NumberOneToOne 1 0 0 4294967295 ECU_ADDRESS 0x7001731C /end MEASUREMENT
/begin MEASUREMENT dataJ1939Dm1Failrs_as[56].dtc_as[13].fmi_u8 "" UBYTE CnvRule_NumberOneToOne 1 0 0 255 ECU_ADDRESS 0x70017320 /end MEASUREMENT
/begin MEASUREMENT dataJ1939Dm1Failrs_as[56].dtc_as[13].occ_u8 "" UBYTE CnvRule_NumberOneToOne 1 0 0 255 ECU_ADDRESS 0x70017321 /end MEASUREMENT
/begin MEASUREMENT dataJ1939Dm1Failrs_as[56].dtc_as[14].spn_u32 "" ULONG CnvRule_NumberOneToOne 1 0 0 4294967295 ECU_ADDRESS 0x70017324 /end MEASUREMENT
/begin MEASUREMENT dataJ1939Dm1Failrs_as[56].dtc_as[14].fmi_u8 "" UBYTE CnvRule_NumberOneToOne 1 0 0 255 ECU_ADDRESS 0x70017328 /end MEASUREMENT
/begin MEASUREMENT dataJ1939Dm1Failrs_as[56].dtc_as[14].occ_u8 "" UBYTE CnvRule_NumberOneToOne 1 0 0 255 ECU_ADDRESS 0x70017329 /end MEASUREMENT
/begin MEASUREMENT dataJ1939Dm1Failrs_as[56].dtc_as[15].spn_u32 "" ULONG CnvRule_NumberOneToOne 1 0 0 4294967295 ECU_ADDRESS 0x7001732C /end MEASUREMENT
/begin MEASUREMENT dataJ1939Dm1Failrs_as[56].dtc_as[15].fmi_u8 "" UBYTE CnvRule_NumberOneToOne 1 0 0 255 ECU_ADDRESS 0x70017330 /end MEASUREMENT
/begin MEASUREMENT dataJ1939Dm1Failrs_as[56].dtc_as[15].occ_u8 "" UBYTE CnvRule_NumberOneToOne 1 0 0 255 ECU_ADDRESS 0x70017331 /end MEASUREMENT
/begin MEASUREMENT dataJ1939Dm1Failrs_as[56].dtc_as[16].spn_u32 "" ULONG CnvRule_NumberOneToOne 1 0 0 4294967295 ECU_ADDRESS 0x70017334 /end MEASUREMENT
/begin MEASUREMENT dataJ1939Dm1Failrs_as[56].dtc_as[16].fmi_u8 "" UBYTE CnvRule_NumberOneToOne 1 0 0 255 ECU_ADDRESS 0x70017338 /end MEASUREMENT
/begin MEASUREMENT dataJ1939Dm1Failrs_as[56].dtc_as[16].occ_u8 "" UBYTE CnvRule_NumberOneToOne 1 0 0 255 ECU_ADDRESS 0x70017339 /end MEASUREMENT
/begin MEASUREMENT dataJ1939Dm1Failrs_as[56].dtc_as[17].spn_u32 "" ULONG CnvRule_NumberOneToOne 1 0 0 4294967295 ECU_ADDRESS 0x7001733C /end MEASUREMENT
/begin MEASUREMENT dataJ1939Dm1Failrs_as[56].dtc_as[17].fmi_u8 "" UBYTE CnvRule_NumberOneToOne 1 0 0 255 ECU_ADDRESS 0x70017340 /end MEASUREMENT
/begin MEASUREMENT dataJ1939Dm1Failrs_as[56].dtc_as[17].occ_u8 "" UBYTE CnvRule_NumberOneToOne 1 0 0 255 ECU_ADDRESS 0x70017341 /end MEASUREMENT
/begin MEASUREMENT dataJ1939Dm1Failrs_as[56].dtc_as[18].spn_u32 "" ULONG CnvRule_NumberOneToOne 1 0 0 4294967295 ECU_ADDRESS 0x70017344 /end MEASUREMENT
/begin MEASUREMENT dataJ1939Dm1Failrs_as[56].dtc_as[18].fmi_u8 "" UBYTE CnvRule_NumberOneToOne 1 0 0 255 ECU_ADDRESS 0x70017348 /end MEASUREMENT
/begin MEASUREMENT dataJ1939Dm1Failrs_as[56].dtc_as[18].occ_u8 "" UBYTE CnvRule_NumberOneToOne 1 0 0 255 ECU_ADDRESS 0x70017349 /end MEASUREMENT
/begin MEASUREMENT dataJ1939Dm1Failrs_as[56].dtc_as[19].spn_u32 "" ULONG CnvRule_NumberOneToOne 1 0 0 4294967295 ECU_ADDRESS 0x7001734C /end MEASUREMENT
/begin MEASUREMENT dataJ1939Dm1Failrs_as[56].dtc_as[19].fmi_u8 "" UBYTE CnvRule_NumberOneToOne 1 0 0 255 ECU_ADDRESS 0x70017350 /end MEASUREMENT
/begin MEASUREMENT dataJ1939Dm1Failrs_as[56].dtc_as[19].occ_u8 "" UBYTE CnvRule_NumberOneToOne 1 0 0 255 ECU_ADDRESS 0x70017351 /end MEASUREMENT
/begin MEASUREMENT dataJ1939Dm1Failrs_as[56].dtc_as[20].spn_u32 "" ULONG CnvRule_NumberOneToOne 1 0 0 4294967295 ECU_ADDRESS 0x70017354 /end MEASUREMENT
/begin MEASUREMENT dataJ1939Dm1Failrs_as[56].dtc_as[20].fmi_u8 "" UBYTE CnvRule_NumberOneToOne 1 0 0 255 ECU_ADDRESS 0x70017358 /end MEASUREMENT
/begin MEASUREMENT dataJ1939Dm1Failrs_as[56].dtc_as[20].occ_u8 "" UBYTE CnvRule_NumberOneToOne 1 0 0 255 ECU_ADDRESS 0x70017359 /end MEASUREMENT
/begin MEASUREMENT dataJ1939Dm1Failrs_as[56].dtc_as "" UBYTE CnvRule_NumberOneToOne 1 0 0 255 ECU_ADDRESS 0x700172BC ARRAY_SIZE 160 /end MEASUREMENT
/begin MEASUREMENT dataJ1939Dm1Failrs_as[57].dtc_as[1].spn_u32 "" ULONG CnvRule_NumberOneToOne 1 0 0 4294967295 ECU_ADDRESS 0x70017360 /end MEASUREMENT
/begin MEASUREMENT dataJ1939Dm1Failrs_as[57].dtc_as[1].fmi_u8 "" UBYTE CnvRule_NumberOneToOne 1 0 0 255 ECU_ADDRESS 0x70017364 /end MEASUREMENT
/begin MEASUREMENT dataJ1939Dm1Failrs_as[57].dtc_as[1].occ_u8 "" UBYTE CnvRule_NumberOneToOne 1 0 0 255 ECU_ADDRESS 0x70017365 /end MEASUREMENT
/begin MEASUREMENT dataJ1939Dm1Failrs_as[57].dtc_as[2].spn_u32 "" ULONG CnvRule_NumberOneToOne 1 0 0 4294967295 ECU_ADDRESS 0x70017368 /end MEASUREMENT
/begin MEASUREMENT dataJ1939Dm1Failrs_as[57].dtc_as[2].fmi_u8 "" UBYTE CnvRule_NumberOneToOne 1 0 0 255 ECU_ADDRESS 0x7001736C /end MEASUREMENT
/begin MEASUREMENT dataJ1939Dm1Failrs_as[57].dtc_as[2].occ_u8 "" UBYTE CnvRule_NumberOneToOne 1 0 0 255 ECU_ADDRESS 0x7001736D /end MEASUREMENT
/begin MEASUREMENT dataJ1939Dm1Failrs_as[57].dtc_as[3].spn_u32 "" ULONG CnvRule_NumberOneToOne 1 0 0 4294967295 ECU_ADDRESS 0x70017370 /end MEASUREMENT
/begin MEASUREMENT dataJ1939Dm1Failrs_as[57].dtc_as[3].fmi_u8 "" UBYTE CnvRule_NumberOneToOne 1 0 0 255 ECU_ADDRESS 0x70017374 /end MEASUREMENT
/begin MEASUREMENT dataJ1939Dm1Failrs_as[57].dtc_as[3].occ_u8 "" UBYTE CnvRule_NumberOneToOne 1 0 0 255 ECU_ADDRESS 0x70017375 /end MEASUREMENT
/begin MEASUREMENT dataJ1939Dm1Failrs_as[57].dtc_as[4].spn_u32 "" ULONG CnvRule_NumberOneToOne 1 0 0 4294967295 ECU_ADDRESS 0x70017378 /end MEASUREMENT
/begin MEASUREMENT dataJ1939Dm1Failrs_as[57].dtc_as[4].fmi_u8 "" UBYTE CnvRule_NumberOneToOne 1 0 0 255 ECU_ADDRESS 0x7001737C /end MEASUREMENT
/begin MEASUREMENT dataJ1939Dm1Failrs_as[57].dtc_as[4].occ_u8 "" UBYTE CnvRule_NumberOneToOne 1 0 0 255 ECU_ADDRESS 0x7001737D /end MEASUREMENT
/begin MEASUREMENT dataJ1939Dm1Failrs_as[57].dtc_as[5].spn_u32 "" ULONG CnvRule_NumberOneToOne 1 0 0 4294967295 ECU_ADDRESS 0x70017380 /end MEASUREMENT
/begin MEASUREMENT dataJ1939Dm1Failrs_as[57].dtc_as[5].fmi_u8 "" UBYTE CnvRule_NumberOneToOne 1 0 0 255 ECU_ADDRESS 0x70017384 /end MEASUREMENT
/begin MEASUREMENT dataJ1939Dm1Failrs_as[57].dtc_as[5].occ_u8 "" UBYTE CnvRule_NumberOneToOne 1 0 0 255 ECU_ADDRESS 0x70017385 /end MEASUREMENT
/begin MEASUREMENT dataJ1939Dm1Failrs_as[57].dtc_as[6].spn_u32 "" ULONG CnvRule_NumberOneToOne 1 0 0 4294967295 ECU_ADDRESS 0x70017388 /end MEASUREMENT
/begin MEASUREMENT dataJ1939Dm1Failrs_as[57].dtc_as[6].fmi_u8 "" UBYTE CnvRule_NumberOneToOne 1 0 0 255 ECU_ADDRESS 0x7001738C /end MEASUREMENT
/begin MEASUREMENT dataJ1939Dm1Failrs_as[57].dtc_as[6].occ_u8 "" UBYTE CnvRule_NumberOneToOne 1 0 0 255 ECU_ADDRESS 0x7001738D /end MEASUREMENT
/begin MEASUREMENT dataJ1939Dm1Failrs_as[57].dtc_as[7].spn_u32 "" ULONG CnvRule_NumberOneToOne 1 0 0 4294967295 ECU_ADDRESS 0x70017390 /end MEASUREMENT
/begin MEASUREMENT dataJ1939Dm1Failrs_as[57].dtc_as[7].fmi_u8 "" UBYTE CnvRule_NumberOneToOne 1 0 0 255 ECU_ADDRESS 0x70017394 /end MEASUREMENT
/begin MEASUREMENT dataJ1939Dm1Failrs_as[57].dtc_as[7].occ_u8 "" UBYTE CnvRule_NumberOneToOne 1 0 0 255 ECU_ADDRESS 0x70017395 /end MEASUREMENT
/begin MEASUREMENT dataJ1939Dm1Failrs_as[57].dtc_as[8].spn_u32 "" ULONG CnvRule_NumberOneToOne 1 0 0 4294967295 ECU_ADDRESS 0x70017398 /end MEASUREMENT
/begin MEASUREMENT dataJ1939Dm1Failrs_as[57].dtc_as[8].fmi_u8 "" UBYTE CnvRule_NumberOneToOne 1 0 0 255 ECU_ADDRESS 0x7001739C /end MEASUREMENT
/begin MEASUREMENT dataJ1939Dm1Failrs_as[57].dtc_as[8].occ_u8 "" UBYTE CnvRule_NumberOneToOne 1 0 0 255 ECU_ADDRESS 0x7001739D /end MEASUREMENT
/begin MEASUREMENT dataJ1939Dm1Failrs_as[57].dtc_as[9].spn_u32 "" ULONG CnvRule_NumberOneToOne 1 0 0 4294967295 ECU_ADDRESS 0x700173A0 /end MEASUREMENT
/begin MEASUREMENT dataJ1939Dm1Failrs_as[57].dtc_as[9].fmi_u8 "" UBYTE CnvRule_NumberOneToOne 1 0 0 255 ECU_ADDRESS 0x700173A4 /end MEASUREMENT
/begin MEASUREMENT dataJ1939Dm1Failrs_as[57].dtc_as[9].occ_u8 "" UBYTE CnvRule_NumberOneToOne 1 0 0 255 ECU_ADDRESS 0x700173A5 /end MEASUREMENT
/begin MEASUREMENT dataJ1939Dm1Failrs_as[57].dtc_as[10].spn_u32 "" ULONG CnvRule_NumberOneToOne 1 0 0 4294967295 ECU_ADDRESS 0x700173A8 /end MEASUREMENT
/begin MEASUREMENT dataJ1939Dm1Failrs_as[57].dtc_as[10].fmi_u8 "" UBYTE CnvRule_NumberOneToOne 1 0 0 255 ECU_ADDRESS 0x700173AC /end MEASUREMENT
/begin MEASUREMENT dataJ1939Dm1Failrs_as[57].dtc_as[10].occ_u8 "" UBYTE CnvRule_NumberOneToOne 1 0 0 255 ECU_ADDRESS 0x700173AD /end MEASUREMENT
/begin MEASUREMENT dataJ1939Dm1Failrs_as[57].dtc_as[11].spn_u32 "" ULONG CnvRule_NumberOneToOne 1 0 0 4294967295 ECU_ADDRESS 0x700173B0 /end MEASUREMENT
/begin MEASUREMENT dataJ1939Dm1Failrs_as[57].dtc_as[11].fmi_u8 "" UBYTE CnvRule_NumberOneToOne 1 0 0 255 ECU_ADDRESS 0x700173B4 /end MEASUREMENT
/begin MEASUREMENT dataJ1939Dm1Failrs_as[57].dtc_as[11].occ_u8 "" UBYTE CnvRule_NumberOneToOne 1 0 0 255 ECU_ADDRESS 0x700173B5 /end MEASUREMENT
/begin MEASUREMENT dataJ1939Dm1Failrs_as[57].dtc_as[12].spn_u32 "" ULONG CnvRule_NumberOneToOne 1 0 0 4294967295 ECU_ADDRESS 0x700173B8 /end MEASUREMENT
/begin MEASUREMENT dataJ1939Dm1Failrs_as[57].dtc_as[12].fmi_u8 "" UBYTE CnvRule_NumberOneToOne 1 0 0 255 ECU_ADDRESS 0x700173BC /end MEASUREMENT
/begin MEASUREMENT dataJ1939Dm1Failrs_as[57].dtc_as[12].occ_u8 "" UBYTE CnvRule_NumberOneToOne 1 0 0 255 ECU_ADDRESS 0x700173BD /end MEASUREMENT
/begin MEASUREMENT dataJ1939Dm1Failrs_as[57].dtc_as[13].spn_u32 "" ULONG CnvRule_NumberOneToOne 1 0 0 4294967295 ECU_ADDRESS 0x700173C0 /end MEASUREMENT
/begin MEASUREMENT dataJ1939Dm1Failrs_as[57].dtc_as[13].fmi_u8 "" UBYTE CnvRule_NumberOneToOne 1 0 0 255 ECU_ADDRESS 0x700173C4 /end MEASUREMENT
/begin MEASUREMENT dataJ1939Dm1Failrs_as[57].dtc_as[13].occ_u8 "" UBYTE CnvRule_NumberOneToOne 1 0 0 255 ECU_ADDRESS 0x700173C5 /end MEASUREMENT
/begin MEASUREMENT dataJ1939Dm1Failrs_as[57].dtc_as[14].spn_u32 "" ULONG CnvRule_NumberOneToOne 1 0 0 4294967295 ECU_ADDRESS 0x700173C8 /end MEASUREMENT
/begin MEASUREMENT dataJ1939Dm1Failrs_as[57].dtc_as[14].fmi_u8 "" UBYTE CnvRule_NumberOneToOne 1 0 0 255 ECU_ADDRESS 0x700173CC /end MEASUREMENT
/begin MEASUREMENT dataJ1939Dm1Failrs_as[57].dtc_as[14].occ_u8 "" UBYTE CnvRule_NumberOneToOne 1 0 0 255 ECU_ADDRESS 0x700173CD /end MEASUREMENT
/begin MEASUREMENT dataJ1939Dm1Failrs_as[57].dtc_as[15].spn_u32 "" ULONG CnvRule_NumberOneToOne 1 0 0 4294967295 ECU_ADDRESS 0x700173D0 /end MEASUREMENT
/begin MEASUREMENT dataJ1939Dm1Failrs_as[57].dtc_as[15].fmi_u8 "" UBYTE CnvRule_NumberOneToOne 1 0 0 255 ECU_ADDRESS 0x700173D4 /end MEASUREMENT
/begin MEASUREMENT dataJ1939Dm1Failrs_as[57].dtc_as[15].occ_u8 "" UBYTE CnvRule_NumberOneToOne 1 0 0 255 ECU_ADDRESS 0x700173D5 /end MEASUREMENT
/begin MEASUREMENT dataJ1939Dm1Failrs_as[57].dtc_as[16].spn_u32 "" ULONG CnvRule_NumberOneToOne 1 0 0 4294967295 ECU_ADDRESS 0x700173D8 /end MEASUREMENT
/begin MEASUREMENT dataJ1939Dm1Failrs_as[57].dtc_as[16].fmi_u8 "" UBYTE CnvRule_NumberOneToOne 1 0 0 255 ECU_ADDRESS 0x700173DC /end MEASUREMENT
/begin MEASUREMENT dataJ1939Dm1Failrs_as[57].dtc_as[16].occ_u8 "" UBYTE CnvRule_NumberOneToOne 1 0 0 255 ECU_ADDRESS 0x700173DD /end MEASUREMENT
/begin MEASUREMENT dataJ1939Dm1Failrs_as[57].dtc_as[17].spn_u32 "" ULONG CnvRule_NumberOneToOne 1 0 0 4294967295 ECU_ADDRESS 0x700173E0 /end MEASUREMENT
/begin MEASUREMENT dataJ1939Dm1Failrs_as[57].dtc_as[17].fmi_u8 "" UBYTE CnvRule_NumberOneToOne 1 0 0 255 ECU_ADDRESS 0x700173E4 /end MEASUREMENT
/begin MEASUREMENT dataJ1939Dm1Failrs_as[57].dtc_as[17].occ_u8 "" UBYTE CnvRule_NumberOneToOne 1 0 0 255 ECU_ADDRESS 0x700173E5 /end MEASUREMENT
/begin MEASUREMENT dataJ1939Dm1Failrs_as[57].dtc_as[18].spn_u32 "" ULONG CnvRule_NumberOneToOne 1 0 0 4294967295 ECU_ADDRESS 0x700173E8 /end MEASUREMENT
/begin MEASUREMENT dataJ1939Dm1Failrs_as[57].dtc_as[18].fmi_u8 "" UBYTE CnvRule_NumberOneToOne 1 0 0 255 ECU_ADDRESS 0x700173EC /end MEASUREMENT
/begin MEASUREMENT dataJ1939Dm1Failrs_as[57].dtc_as[18].occ_u8 "" UBYTE CnvRule_NumberOneToOne 1 0 0 255 ECU_ADDRESS 0x700173ED /end MEASUREMENT
/begin MEASUREMENT dataJ1939Dm1Failrs_as[57].dtc_as[19].spn_u32 "" ULONG CnvRule_NumberOneToOne 1 0 0 4294967295 ECU_ADDRESS 0x700173F0 /end MEASUREMENT
/begin MEASUREMENT dataJ1939Dm1Failrs_as[57].dtc_as[19].fmi_u8 "" UBYTE CnvRule_NumberOneToOne 1 0 0 255 ECU_ADDRESS 0x700173F4 /end MEASUREMENT
/begin MEASUREMENT dataJ1939Dm1Failrs_as[57].dtc_as[19].occ_u8 "" UBYTE CnvRule_NumberOneToOne 1 0 0 255 ECU_ADDRESS 0x700173F5 /end MEASUREMENT
/begin MEASUREMENT dataJ1939Dm1Failrs_as[57].dtc_as[20].spn_u32 "" ULONG CnvRule_NumberOneToOne 1 0 0 4294967295 ECU_ADDRESS 0x700173F8 /end MEASUREMENT
/begin MEASUREMENT dataJ1939Dm1Failrs_as[57].dtc_as[20].fmi_u8 "" UBYTE CnvRule_NumberOneToOne 1 0 0 255 ECU_ADDRESS 0x700173FC /end MEASUREMENT
/begin MEASUREMENT dataJ1939Dm1Failrs_as[57].dtc_as[20].occ_u8 "" UBYTE CnvRule_NumberOneToOne 1 0 0 255 ECU_ADDRESS 0x700173FD /end MEASUREMENT
/begin MEASUREMENT dataJ1939Dm1Failrs_as[57].dtc_as "" UBYTE CnvRule_NumberOneToOne 1 0 0 255 ECU_ADDRESS 0x70017360 ARRAY_SIZE 160 /end MEASUREMENT
/begin MEASUREMENT dataJ1939Dm1Failrs_as[58].dtc_as[1].spn_u32 "" ULONG CnvRule_NumberOneToOne 1 0 0 4294967295 ECU_ADDRESS 0x70017404 /end MEASUREMENT
/begin MEASUREMENT dataJ1939Dm1Failrs_as[58].dtc_as[1].fmi_u8 "" UBYTE CnvRule_NumberOneToOne 1 0 0 255 ECU_ADDRESS 0x70017408 /end MEASUREMENT
/begin MEASUREMENT dataJ1939Dm1Failrs_as[58].dtc_as[1].occ_u8 "" UBYTE CnvRule_NumberOneToOne 1 0 0 255 ECU_ADDRESS 0x70017409 /end MEASUREMENT
/begin MEASUREMENT dataJ1939Dm1Failrs_as[58].dtc_as[2].spn_u32 "" ULONG CnvRule_NumberOneToOne 1 0 0 4294967295 ECU_ADDRESS 0x7001740C /end MEASUREMENT
/begin MEASUREMENT dataJ1939Dm1Failrs_as[58].dtc_as[2].fmi_u8 "" UBYTE CnvRule_NumberOneToOne 1 0 0 255 ECU_ADDRESS 0x70017410 /end MEASUREMENT
/begin MEASUREMENT dataJ1939Dm1Failrs_as[58].dtc_as[2].occ_u8 "" UBYTE CnvRule_NumberOneToOne 1 0 0 255 ECU_ADDRESS 0x70017411 /end MEASUREMENT
/begin MEASUREMENT dataJ1939Dm1Failrs_as[58].dtc_as[3].spn_u32 "" ULONG CnvRule_NumberOneToOne 1 0 0 4294967295 ECU_ADDRESS 0x70017414 /end MEASUREMENT
/begin MEASUREMENT dataJ1939Dm1Failrs_as[58].dtc_as[3].fmi_u8 "" UBYTE CnvRule_NumberOneToOne 1 0 0 255 ECU_ADDRESS 0x70017418 /end MEASUREMENT
/begin MEASUREMENT dataJ1939Dm1Failrs_as[58].dtc_as[3].occ_u8 "" UBYTE CnvRule_NumberOneToOne 1 0 0 255 ECU_ADDRESS 0x70017419 /end MEASUREMENT
/begin MEASUREMENT dataJ1939Dm1Failrs_as[58].dtc_as[4].spn_u32 "" ULONG CnvRule_NumberOneToOne 1 0 0 4294967295 ECU_ADDRESS 0x7001741C /end MEASUREMENT
/begin MEASUREMENT dataJ1939Dm1Failrs_as[58].dtc_as[4].fmi_u8 "" UBYTE CnvRule_NumberOneToOne 1 0 0 255 ECU_ADDRESS 0x70017420 /end MEASUREMENT
/begin MEASUREMENT dataJ1939Dm1Failrs_as[58].dtc_as[4].occ_u8 "" UBYTE CnvRule_NumberOneToOne 1 0 0 255 ECU_ADDRESS 0x70017421 /end MEASUREMENT
/begin MEASUREMENT dataJ1939Dm1Failrs_as[58].dtc_as[5].spn_u32 "" ULONG CnvRule_NumberOneToOne 1 0 0 4294967295 ECU_ADDRESS 0x70017424 /end MEASUREMENT
/begin MEASUREMENT dataJ1939Dm1Failrs_as[58].dtc_as[5].fmi_u8 "" UBYTE CnvRule_NumberOneToOne 1 0 0 255 ECU_ADDRESS 0x70017428 /end MEASUREMENT
/begin MEASUREMENT dataJ1939Dm1Failrs_as[58].dtc_as[5].occ_u8 "" UBYTE CnvRule_NumberOneToOne 1 0 0 255 ECU_ADDRESS 0x70017429 /end MEASUREMENT
/begin MEASUREMENT dataJ1939Dm1Failrs_as[58].dtc_as[6].spn_u32 "" ULONG CnvRule_NumberOneToOne 1 0 0 4294967295 ECU_ADDRESS 0x7001742C /end MEASUREMENT
/begin MEASUREMENT dataJ1939Dm1Failrs_as[58].dtc_as[6].fmi_u8 "" UBYTE CnvRule_NumberOneToOne 1 0 0 255 ECU_ADDRESS 0x70017430 /end MEASUREMENT
/begin MEASUREMENT dataJ1939Dm1Failrs_as[58].dtc_as[6].occ_u8 "" UBYTE CnvRule_NumberOneToOne 1 0 0 255 ECU_ADDRESS 0x70017431 /end MEASUREMENT
/begin MEASUREMENT dataJ1939Dm1Failrs_as[58].dtc_as[7].spn_u32 "" ULONG CnvRule_NumberOneToOne 1 0 0 4294967295 ECU_ADDRESS 0x70017434 /end MEASUREMENT
/begin MEASUREMENT dataJ1939Dm1Failrs_as[58].dtc_as[7].fmi_u8 "" UBYTE CnvRule_NumberOneToOne 1 0 0 255 ECU_ADDRESS 0x70017438 /end MEASUREMENT
/begin MEASUREMENT dataJ1939Dm1Failrs_as[58].dtc_as[7].occ_u8 "" UBYTE CnvRule_NumberOneToOne 1 0 0 255 ECU_ADDRESS 0x70017439 /end MEASUREMENT
/begin MEASUREMENT dataJ1939Dm1Failrs_as[58].dtc_as[8].spn_u32 "" ULONG CnvRule_NumberOneToOne 1 0 0 4294967295 ECU_ADDRESS 0x7001743C /end MEASUREMENT
/begin MEASUREMENT dataJ1939Dm1Failrs_as[58].dtc_as[8].fmi_u8 "" UBYTE CnvRule_NumberOneToOne 1 0 0 255 ECU_ADDRESS 0x70017440 /end MEASUREMENT
/begin MEASUREMENT dataJ1939Dm1Failrs_as[58].dtc_as[8].occ_u8 "" UBYTE CnvRule_NumberOneToOne 1 0 0 255 ECU_ADDRESS 0x70017441 /end MEASUREMENT
/begin MEASUREMENT dataJ1939Dm1Failrs_as[58].dtc_as[9].spn_u32 "" ULONG CnvRule_NumberOneToOne 1 0 0 4294967295 ECU_ADDRESS 0x70017444 /end MEASUREMENT
/begin MEASUREMENT dataJ1939Dm1Failrs_as[58].dtc_as[9].fmi_u8 "" UBYTE CnvRule_NumberOneToOne 1 0 0 255 ECU_ADDRESS 0x70017448 /end MEASUREMENT
/begin MEASUREMENT dataJ1939Dm1Failrs_as[58].dtc_as[9].occ_u8 "" UBYTE CnvRule_NumberOneToOne 1 0 0 255 ECU_ADDRESS 0x70017449 /end MEASUREMENT
/begin MEASUREMENT dataJ1939Dm1Failrs_as[58].dtc_as[10].spn_u32 "" ULONG CnvRule_NumberOneToOne 1 0 0 4294967295 ECU_ADDRESS 0x7001744C /end MEASUREMENT
/begin MEASUREMENT dataJ1939Dm1Failrs_as[58].dtc_as[10].fmi_u8 "" UBYTE CnvRule_NumberOneToOne 1 0 0 255 ECU_ADDRESS 0x70017450 /end MEASUREMENT
/begin MEASUREMENT dataJ1939Dm1Failrs_as[58].dtc_as[10].occ_u8 "" UBYTE CnvRule_NumberOneToOne 1 0 0 255 ECU_ADDRESS 0x70017451 /end MEASUREMENT
/begin MEASUREMENT dataJ1939Dm1Failrs_as[58].dtc_as[11].spn_u32 "" ULONG CnvRule_NumberOneToOne 1 0 0 4294967295 ECU_ADDRESS 0x70017454 /end MEASUREMENT
/begin MEASUREMENT dataJ1939Dm1Failrs_as[58].dtc_as[11].fmi_u8 "" UBYTE CnvRule_NumberOneToOne 1 0 0 255 ECU_ADDRESS 0x70017458 /end MEASUREMENT
/begin MEASUREMENT dataJ1939Dm1Failrs_as[58].dtc_as[11].occ_u8 "" UBYTE CnvRule_NumberOneToOne 1 0 0 255 ECU_ADDRESS 0x70017459 /end MEASUREMENT
/begin MEASUREMENT dataJ1939Dm1Failrs_as[58].dtc_as[12].spn_u32 "" ULONG CnvRule_NumberOneToOne 1 0 0 4294967295 ECU_ADDRESS 0x7001745C /end MEASUREMENT
/begin MEASUREMENT dataJ1939Dm1Failrs_as[58].dtc_as[12].fmi_u8 "" UBYTE CnvRule_NumberOneToOne 1 0 0 255 ECU_ADDRESS 0x70017460 /end MEASUREMENT
/begin MEASUREMENT dataJ1939Dm1Failrs_as[58].dtc_as[12].occ_u8 "" UBYTE CnvRule_NumberOneToOne 1 0 0 255 ECU_ADDRESS 0x70017461 /end MEASUREMENT
/begin MEASUREMENT dataJ1939Dm1Failrs_as[58].dtc_as[13].spn_u32 "" ULONG CnvRule_NumberOneToOne 1 0 0 4294967295 ECU_ADDRESS 0x70017464 /end MEASUREMENT
/begin MEASUREMENT dataJ1939Dm1Failrs_as[58].dtc_as[13].fmi_u8 "" UBYTE CnvRule_NumberOneToOne 1 0 0 255 ECU_ADDRESS 0x70017468 /end MEASUREMENT
/begin MEASUREMENT dataJ1939Dm1Failrs_as[58].dtc_as[13].occ_u8 "" UBYTE CnvRule_NumberOneToOne 1 0 0 255 ECU_ADDRESS 0x70017469 /end MEASUREMENT
/begin MEASUREMENT dataJ1939Dm1Failrs_as[58].dtc_as[14].spn_u32 "" ULONG CnvRule_NumberOneToOne 1 0 0 4294967295 ECU_ADDRESS 0x7001746C /end MEASUREMENT
/begin MEASUREMENT dataJ1939Dm1Failrs_as[58].dtc_as[14].fmi_u8 "" UBYTE CnvRule_NumberOneToOne 1 0 0 255 ECU_ADDRESS 0x70017470 /end MEASUREMENT
/begin MEASUREMENT dataJ1939Dm1Failrs_as[58].dtc_as[14].occ_u8 "" UBYTE CnvRule_NumberOneToOne 1 0 0 255 ECU_ADDRESS 0x70017471 /end MEASUREMENT
/begin MEASUREMENT dataJ1939Dm1Failrs_as[58].dtc_as[15].spn_u32 "" ULONG CnvRule_NumberOneToOne 1 0 0 4294967295 ECU_ADDRESS 0x70017474 /end MEASUREMENT
/begin MEASUREMENT dataJ1939Dm1Failrs_as[58].dtc_as[15].fmi_u8 "" UBYTE CnvRule_NumberOneToOne 1 0 0 255 ECU_ADDRESS 0x70017478 /end MEASUREMENT
/begin MEASUREMENT dataJ1939Dm1Failrs_as[58].dtc_as[15].occ_u8 "" UBYTE CnvRule_NumberOneToOne 1 0 0 255 ECU_ADDRESS 0x70017479 /end MEASUREMENT
/begin MEASUREMENT dataJ1939Dm1Failrs_as[58].dtc_as[16].spn_u32 "" ULONG CnvRule_NumberOneToOne 1 0 0 4294967295 ECU_ADDRESS 0x7001747C /end MEASUREMENT
/begin MEASUREMENT dataJ1939Dm1Failrs_as[58].dtc_as[16].fmi_u8 "" UBYTE CnvRule_NumberOneToOne 1 0 0 255 ECU_ADDRESS 0x70017480 /end MEASUREMENT
/begin MEASUREMENT dataJ1939Dm1Failrs_as[58].dtc_as[16].occ_u8 "" UBYTE CnvRule_NumberOneToOne 1 0 0 255 ECU_ADDRESS 0x70017481 /end MEASUREMENT
/begin MEASUREMENT dataJ1939Dm1Failrs_as[58].dtc_as[17].spn_u32 "" ULONG CnvRule_NumberOneToOne 1 0 0 4294967295 ECU_ADDRESS 0x70017484 /end MEASUREMENT
/begin MEASUREMENT dataJ1939Dm1Failrs_as[58].dtc_as[17].fmi_u8 "" UBYTE CnvRule_NumberOneToOne 1 0 0 255 ECU_ADDRESS 0x70017488 /end MEASUREMENT
/begin MEASUREMENT dataJ1939Dm1Failrs_as[58].dtc_as[17].occ_u8 "" UBYTE CnvRule_NumberOneToOne 1 0 0 255 ECU_ADDRESS 0x70017489 /end MEASUREMENT
/begin MEASUREMENT dataJ1939Dm1Failrs_as[58].dtc_as[18].spn_u32 "" ULONG CnvRule_NumberOneToOne 1 0 0 4294967295 ECU_ADDRESS 0x7001748C /end MEASUREMENT
/begin MEASUREMENT dataJ1939Dm1Failrs_as[58].dtc_as[18].fmi_u8 "" UBYTE CnvRule_NumberOneToOne 1 0 0 255 ECU_ADDRESS 0x70017490 /end MEASUREMENT
/begin MEASUREMENT dataJ1939Dm1Failrs_as[58].dtc_as[18].occ_u8 "" UBYTE CnvRule_NumberOneToOne 1 0 0 255 ECU_ADDRESS 0x70017491 /end MEASUREMENT
/begin MEASUREMENT dataJ1939Dm1Failrs_as[58].dtc_as[19].spn_u32 "" ULONG CnvRule_NumberOneToOne 1 0 0 4294967295 ECU_ADDRESS 0x70017494 /end MEASUREMENT
/begin MEASUREMENT dataJ1939Dm1Failrs_as[58].dtc_as[19].fmi_u8 "" UBYTE CnvRule_NumberOneToOne 1 0 0 255 ECU_ADDRESS 0x70017498 /end MEASUREMENT
/begin MEASUREMENT dataJ1939Dm1Failrs_as[58].dtc_as[19].occ_u8 "" UBYTE CnvRule_NumberOneToOne 1 0 0 255 ECU_ADDRESS 0x70017499 /end MEASUREMENT
/begin MEASUREMENT dataJ1939Dm1Failrs_as[58].dtc_as[20].spn_u32 "" ULONG CnvRule_NumberOneToOne 1 0 0 4294967295 ECU_ADDRESS 0x7001749C /end MEASUREMENT
/begin MEASUREMENT dataJ1939Dm1Failrs_as[58].dtc_as[20].fmi_u8 "" UBYTE CnvRule_NumberOneToOne 1 0 0 255 ECU_ADDRESS 0x700174A0 /end MEASUREMENT
/begin MEASUREMENT dataJ1939Dm1Failrs_as[58].dtc_as[20].occ_u8 "" UBYTE CnvRule_NumberOneToOne 1 0 0 255 ECU_ADDRESS 0x700174A1 /end MEASUREMENT
/begin MEASUREMENT dataJ1939Dm1Failrs_as[58].dtc_as "" UBYTE CnvRule_NumberOneToOne 1 0 0 255 ECU_ADDRESS 0x70017404 ARRAY_SIZE 160 /end MEASUREMENT
/begin MEASUREMENT dataJ1939Dm1Failrs_as[59].dtc_as[1].spn_u32 "" ULONG CnvRule_NumberOneToOne 1 0 0 4294967295 ECU_ADDRESS 0x700174A8 /end MEASUREMENT
/begin MEASUREMENT dataJ1939Dm1Failrs_as[59].dtc_as[1].fmi_u8 "" UBYTE CnvRule_NumberOneToOne 1 0 0 255 ECU_ADDRESS 0x700174AC /end MEASUREMENT
/begin MEASUREMENT dataJ1939Dm1Failrs_as[59].dtc_as[1].occ_u8 "" UBYTE CnvRule_NumberOneToOne 1 0 0 255 ECU_ADDRESS 0x700174AD /end MEASUREMENT
/begin MEASUREMENT dataJ1939Dm1Failrs_as[59].dtc_as[2].spn_u32 "" ULONG CnvRule_NumberOneToOne 1 0 0 4294967295 ECU_ADDRESS 0x700174B0 /end MEASUREMENT
/begin MEASUREMENT dataJ1939Dm1Failrs_as[59].dtc_as[2].fmi_u8 "" UBYTE CnvRule_NumberOneToOne 1 0 0 255 ECU_ADDRESS 0x700174B4 /end MEASUREMENT
/begin MEASUREMENT dataJ1939Dm1Failrs_as[59].dtc_as[2].occ_u8 "" UBYTE CnvRule_NumberOneToOne 1 0 0 255 ECU_ADDRESS 0x700174B5 /end MEASUREMENT
/begin MEASUREMENT dataJ1939Dm1Failrs_as[59].dtc_as[3].spn_u32 "" ULONG CnvRule_NumberOneToOne 1 0 0 4294967295 ECU_ADDRESS 0x700174B8 /end MEASUREMENT
/begin MEASUREMENT dataJ1939Dm1Failrs_as[59].dtc_as[3].fmi_u8 "" UBYTE CnvRule_NumberOneToOne 1 0 0 255 ECU_ADDRESS 0x700174BC /end MEASUREMENT
/begin MEASUREMENT dataJ1939Dm1Failrs_as[59].dtc_as[3].occ_u8 "" UBYTE CnvRule_NumberOneToOne 1 0 0 255 ECU_ADDRESS 0x700174BD /end MEASUREMENT
/begin MEASUREMENT dataJ1939Dm1Failrs_as[59].dtc_as[4].spn_u32 "" ULONG CnvRule_NumberOneToOne 1 0 0 4294967295 ECU_ADDRESS 0x700174C0 /end MEASUREMENT
/begin MEASUREMENT dataJ1939Dm1Failrs_as[59].dtc_as[4].fmi_u8 "" UBYTE CnvRule_NumberOneToOne 1 0 0 255 ECU_ADDRESS 0x700174C4 /end MEASUREMENT
/begin MEASUREMENT dataJ1939Dm1Failrs_as[59].dtc_as[4].occ_u8 "" UBYTE CnvRule_NumberOneToOne 1 0 0 255 ECU_ADDRESS 0x700174C5 /end MEASUREMENT
/begin MEASUREMENT dataJ1939Dm1Failrs_as[59].dtc_as[5].spn_u32 "" ULONG CnvRule_NumberOneToOne 1 0 0 4294967295 ECU_ADDRESS 0x700174C8 /end MEASUREMENT
/begin MEASUREMENT dataJ1939Dm1Failrs_as[59].dtc_as[5].fmi_u8 "" UBYTE CnvRule_NumberOneToOne 1 0 0 255 ECU_ADDRESS 0x700174CC /end MEASUREMENT
/begin MEASUREMENT dataJ1939Dm1Failrs_as[59].dtc_as[5].occ_u8 "" UBYTE CnvRule_NumberOneToOne 1 0 0 255 ECU_ADDRESS 0x700174CD /end MEASUREMENT
/begin MEASUREMENT dataJ1939Dm1Failrs_as[59].dtc_as[6].spn_u32 "" ULONG CnvRule_NumberOneToOne 1 0 0 4294967295 ECU_ADDRESS 0x700174D0 /end MEASUREMENT
/begin MEASUREMENT dataJ1939Dm1Failrs_as[59].dtc_as[6].fmi_u8 "" UBYTE CnvRule_NumberOneToOne 1 0 0 255 ECU_ADDRESS 0x700174D4 /end MEASUREMENT
/begin MEASUREMENT dataJ1939Dm1Failrs_as[59].dtc_as[6].occ_u8 "" UBYTE CnvRule_NumberOneToOne 1 0 0 255 ECU_ADDRESS 0x700174D5 /end MEASUREMENT
/begin MEASUREMENT dataJ1939Dm1Failrs_as[59].dtc_as[7].spn_u32 "" ULONG CnvRule_NumberOneToOne 1 0 0 4294967295 ECU_ADDRESS 0x700174D8 /end MEASUREMENT
/begin MEASUREMENT dataJ1939Dm1Failrs_as[59].dtc_as[7].fmi_u8 "" UBYTE CnvRule_NumberOneToOne 1 0 0 255 ECU_ADDRESS 0x700174DC /end MEASUREMENT
/begin MEASUREMENT dataJ1939Dm1Failrs_as[59].dtc_as[7].occ_u8 "" UBYTE CnvRule_NumberOneToOne 1 0 0 255 ECU_ADDRESS 0x700174DD /end MEASUREMENT
/begin MEASUREMENT dataJ1939Dm1Failrs_as[59].dtc_as[8].spn_u32 "" ULONG CnvRule_NumberOneToOne 1 0 0 4294967295 ECU_ADDRESS 0x700174E0 /end MEASUREMENT
/begin MEASUREMENT dataJ1939Dm1Failrs_as[59].dtc_as[8].fmi_u8 "" UBYTE CnvRule_NumberOneToOne 1 0 0 255 ECU_ADDRESS 0x700174E4 /end MEASUREMENT
/begin MEASUREMENT dataJ1939Dm1Failrs_as[59].dtc_as[8].occ_u8 "" UBYTE CnvRule_NumberOneToOne 1 0 0 255 ECU_ADDRESS 0x700174E5 /end MEASUREMENT
/begin MEASUREMENT dataJ1939Dm1Failrs_as[59].dtc_as[9].spn_u32 "" ULONG CnvRule_NumberOneToOne 1 0 0 4294967295 ECU_ADDRESS 0x700174E8 /end MEASUREMENT
/begin MEASUREMENT dataJ1939Dm1Failrs_as[59].dtc_as[9].fmi_u8 "" UBYTE CnvRule_NumberOneToOne 1 0 0 255 ECU_ADDRESS 0x700174EC /end MEASUREMENT
/begin MEASUREMENT dataJ1939Dm1Failrs_as[59].dtc_as[9].occ_u8 "" UBYTE CnvRule_NumberOneToOne 1 0 0 255 ECU_ADDRESS 0x700174ED /end MEASUREMENT
/begin MEASUREMENT dataJ1939Dm1Failrs_as[59].dtc_as[10].spn_u32 "" ULONG CnvRule_NumberOneToOne 1 0 0 4294967295 ECU_ADDRESS 0x700174F0 /end MEASUREMENT
/begin MEASUREMENT dataJ1939Dm1Failrs_as[59].dtc_as[10].fmi_u8 "" UBYTE CnvRule_NumberOneToOne 1 0 0 255 ECU_ADDRESS 0x700174F4 /end MEASUREMENT
/begin MEASUREMENT dataJ1939Dm1Failrs_as[59].dtc_as[10].occ_u8 "" UBYTE CnvRule_NumberOneToOne 1 0 0 255 ECU_ADDRESS 0x700174F5 /end MEASUREMENT
/begin MEASUREMENT dataJ1939Dm1Failrs_as[59].dtc_as[11].spn_u32 "" ULONG CnvRule_NumberOneToOne 1 0 0 4294967295 ECU_ADDRESS 0x700174F8 /end MEASUREMENT
/begin MEASUREMENT dataJ1939Dm1Failrs_as[59].dtc_as[11].fmi_u8 "" UBYTE CnvRule_NumberOneToOne 1 0 0 255 ECU_ADDRESS 0x700174FC /end MEASUREMENT
/begin MEASUREMENT dataJ1939Dm1Failrs_as[59].dtc_as[11].occ_u8 "" UBYTE CnvRule_NumberOneToOne 1 0 0 255 ECU_ADDRESS 0x700174FD /end MEASUREMENT
/begin MEASUREMENT dataJ1939Dm1Failrs_as[59].dtc_as[12].spn_u32 "" ULONG CnvRule_NumberOneToOne 1 0 0 4294967295 ECU_ADDRESS 0x70017500 /end MEASUREMENT
/begin MEASUREMENT dataJ1939Dm1Failrs_as[59].dtc_as[12].fmi_u8 "" UBYTE CnvRule_NumberOneToOne 1 0 0 255 ECU_ADDRESS 0x70017504 /end MEASUREMENT
/begin MEASUREMENT dataJ1939Dm1Failrs_as[59].dtc_as[12].occ_u8 "" UBYTE CnvRule_NumberOneToOne 1 0 0 255 ECU_ADDRESS 0x70017505 /end MEASUREMENT
/begin MEASUREMENT dataJ1939Dm1Failrs_as[59].dtc_as[13].spn_u32 "" ULONG CnvRule_NumberOneToOne 1 0 0 4294967295 ECU_ADDRESS 0x70017508 /end MEASUREMENT
/begin MEASUREMENT dataJ1939Dm1Failrs_as[59].dtc_as[13].fmi_u8 "" UBYTE CnvRule_NumberOneToOne 1 0 0 255 ECU_ADDRESS 0x7001750C /end MEASUREMENT
/begin MEASUREMENT dataJ1939Dm1Failrs_as[59].dtc_as[13].occ_u8 "" UBYTE CnvRule_NumberOneToOne 1 0 0 255 ECU_ADDRESS 0x7001750D /end MEASUREMENT
/begin MEASUREMENT dataJ1939Dm1Failrs_as[59].dtc_as[14].spn_u32 "" ULONG CnvRule_NumberOneToOne 1 0 0 4294967295 ECU_ADDRESS 0x70017510 /end MEASUREMENT
/begin MEASUREMENT dataJ1939Dm1Failrs_as[59].dtc_as[14].fmi_u8 "" UBYTE CnvRule_NumberOneToOne 1 0 0 255 ECU_ADDRESS 0x70017514 /end MEASUREMENT
/begin MEASUREMENT dataJ1939Dm1Failrs_as[59].dtc_as[14].occ_u8 "" UBYTE CnvRule_NumberOneToOne 1 0 0 255 ECU_ADDRESS 0x70017515 /end MEASUREMENT
/begin MEASUREMENT dataJ1939Dm1Failrs_as[59].dtc_as[15].spn_u32 "" ULONG CnvRule_NumberOneToOne 1 0 0 4294967295 ECU_ADDRESS 0x70017518 /end MEASUREMENT
/begin MEASUREMENT dataJ1939Dm1Failrs_as[59].dtc_as[15].fmi_u8 "" UBYTE CnvRule_NumberOneToOne 1 0 0 255 ECU_ADDRESS 0x7001751C /end MEASUREMENT
/begin MEASUREMENT dataJ1939Dm1Failrs_as[59].dtc_as[15].occ_u8 "" UBYTE CnvRule_NumberOneToOne 1 0 0 255 ECU_ADDRESS 0x7001751D /end MEASUREMENT
/begin MEASUREMENT dataJ1939Dm1Failrs_as[59].dtc_as[16].spn_u32 "" ULONG CnvRule_NumberOneToOne 1 0 0 4294967295 ECU_ADDRESS 0x70017520 /end MEASUREMENT
/begin MEASUREMENT dataJ1939Dm1Failrs_as[59].dtc_as[16].fmi_u8 "" UBYTE CnvRule_NumberOneToOne 1 0 0 255 ECU_ADDRESS 0x70017524 /end MEASUREMENT
/begin MEASUREMENT dataJ1939Dm1Failrs_as[59].dtc_as[16].occ_u8 "" UBYTE CnvRule_NumberOneToOne 1 0 0 255 ECU_ADDRESS 0x70017525 /end MEASUREMENT
/begin MEASUREMENT dataJ1939Dm1Failrs_as[59].dtc_as[17].spn_u32 "" ULONG CnvRule_NumberOneToOne 1 0 0 4294967295 ECU_ADDRESS 0x70017528 /end MEASUREMENT
/begin MEASUREMENT dataJ1939Dm1Failrs_as[59].dtc_as[17].fmi_u8 "" UBYTE CnvRule_NumberOneToOne 1 0 0 255 ECU_ADDRESS 0x7001752C /end MEASUREMENT
/begin MEASUREMENT dataJ1939Dm1Failrs_as[59].dtc_as[17].occ_u8 "" UBYTE CnvRule_NumberOneToOne 1 0 0 255 ECU_ADDRESS 0x7001752D /end MEASUREMENT
/begin MEASUREMENT dataJ1939Dm1Failrs_as[59].dtc_as[18].spn_u32 "" ULONG CnvRule_NumberOneToOne 1 0 0 4294967295 ECU_ADDRESS 0x70017530 /end MEASUREMENT
/begin MEASUREMENT dataJ1939Dm1Failrs_as[59].dtc_as[18].fmi_u8 "" UBYTE CnvRule_NumberOneToOne 1 0 0 255 ECU_ADDRESS 0x70017534 /end MEASUREMENT
/begin MEASUREMENT dataJ1939Dm1Failrs_as[59].dtc_as[18].occ_u8 "" UBYTE CnvRule_NumberOneToOne 1 0 0 255 ECU_ADDRESS 0x70017535 /end MEASUREMENT
/begin MEASUREMENT dataJ1939Dm1Failrs_as[59].dtc_as[19].spn_u32 "" ULONG CnvRule_NumberOneToOne 1 0 0 4294967295 ECU_ADDRESS 0x70017538 /end MEASUREMENT
/begin MEASUREMENT dataJ1939Dm1Failrs_as[59].dtc_as[19].fmi_u8 "" UBYTE CnvRule_NumberOneToOne 1 0 0 255 ECU_ADDRESS 0x7001753C /end MEASUREMENT
/begin MEASUREMENT dataJ1939Dm1Failrs_as[59].dtc_as[19].occ_u8 "" UBYTE CnvRule_NumberOneToOne 1 0 0 255 ECU_ADDRESS 0x7001753D /end MEASUREMENT
/begin MEASUREMENT dataJ1939Dm1Failrs_as[59].dtc_as[20].spn_u32 "" ULONG CnvRule_NumberOneToOne 1 0 0 4294967295 ECU_ADDRESS 0x70017540 /end MEASUREMENT
/begin MEASUREMENT dataJ1939Dm1Failrs_as[59].dtc_as[20].fmi_u8 "" UBYTE CnvRule_NumberOneToOne 1 0 0 255 ECU_ADDRESS 0x70017544 /end MEASUREMENT
/begin MEASUREMENT dataJ1939Dm1Failrs_as[59].dtc_as[20].occ_u8 "" UBYTE CnvRule_NumberOneToOne 1 0 0 255 ECU_ADDRESS 0x70017545 /end MEASUREMENT
/begin MEASUREMENT dataJ1939Dm1Failrs_as[59].dtc_as "" UBYTE CnvRule_NumberOneToOne 1 0 0 255 ECU_ADDRESS 0x700174A8 ARRAY_SIZE 160 /end MEASUREMENT
/begin MEASUREMENT dataJ1939Dm1Failrs_as[60].dtc_as[1].spn_u32 "" ULONG CnvRule_NumberOneToOne 1 0 0 4294967295 ECU_ADDRESS 0x7001754C /end MEASUREMENT
/begin MEASUREMENT dataJ1939Dm1Failrs_as[60].dtc_as[1].fmi_u8 "" UBYTE CnvRule_NumberOneToOne 1 0 0 255 ECU_ADDRESS 0x70017550 /end MEASUREMENT
/begin MEASUREMENT dataJ1939Dm1Failrs_as[60].dtc_as[1].occ_u8 "" UBYTE CnvRule_NumberOneToOne 1 0 0 255 ECU_ADDRESS 0x70017551 /end MEASUREMENT
/begin MEASUREMENT dataJ1939Dm1Failrs_as[60].dtc_as[2].spn_u32 "" ULONG CnvRule_NumberOneToOne 1 0 0 4294967295 ECU_ADDRESS 0x70017554 /end MEASUREMENT
/begin MEASUREMENT dataJ1939Dm1Failrs_as[60].dtc_as[2].fmi_u8 "" UBYTE CnvRule_NumberOneToOne 1 0 0 255 ECU_ADDRESS 0x70017558 /end MEASUREMENT
/begin MEASUREMENT dataJ1939Dm1Failrs_as[60].dtc_as[2].occ_u8 "" UBYTE CnvRule_NumberOneToOne 1 0 0 255 ECU_ADDRESS 0x70017559 /end MEASUREMENT
/begin MEASUREMENT dataJ1939Dm1Failrs_as[60].dtc_as[3].spn_u32 "" ULONG CnvRule_NumberOneToOne 1 0 0 4294967295 ECU_ADDRESS 0x7001755C /end MEASUREMENT
/begin MEASUREMENT dataJ1939Dm1Failrs_as[60].dtc_as[3].fmi_u8 "" UBYTE CnvRule_NumberOneToOne 1 0 0 255 ECU_ADDRESS 0x70017560 /end MEASUREMENT
/begin MEASUREMENT dataJ1939Dm1Failrs_as[60].dtc_as[3].occ_u8 "" UBYTE CnvRule_NumberOneToOne 1 0 0 255 ECU_ADDRESS 0x70017561 /end MEASUREMENT
/begin MEASUREMENT dataJ1939Dm1Failrs_as[60].dtc_as[4].spn_u32 "" ULONG CnvRule_NumberOneToOne 1 0 0 4294967295 ECU_ADDRESS 0x70017564 /end MEASUREMENT
/begin MEASUREMENT dataJ1939Dm1Failrs_as[60].dtc_as[4].fmi_u8 "" UBYTE CnvRule_NumberOneToOne 1 0 0 255 ECU_ADDRESS 0x70017568 /end MEASUREMENT
/begin MEASUREMENT dataJ1939Dm1Failrs_as[60].dtc_as[4].occ_u8 "" UBYTE CnvRule_NumberOneToOne 1 0 0 255 ECU_ADDRESS 0x70017569 /end MEASUREMENT
/begin MEASUREMENT dataJ1939Dm1Failrs_as[60].dtc_as[5].spn_u32 "" ULONG CnvRule_NumberOneToOne 1 0 0 4294967295 ECU_ADDRESS 0x7001756C /end MEASUREMENT
/begin MEASUREMENT dataJ1939Dm1Failrs_as[60].dtc_as[5].fmi_u8 "" UBYTE CnvRule_NumberOneToOne 1 0 0 255 ECU_ADDRESS 0x70017570 /end MEASUREMENT
/begin MEASUREMENT dataJ1939Dm1Failrs_as[60].dtc_as[5].occ_u8 "" UBYTE CnvRule_NumberOneToOne 1 0 0 255 ECU_ADDRESS 0x70017571 /end MEASUREMENT
/begin MEASUREMENT dataJ1939Dm1Failrs_as[60].dtc_as[6].spn_u32 "" ULONG CnvRule_NumberOneToOne 1 0 0 4294967295 ECU_ADDRESS 0x70017574 /end MEASUREMENT
/begin MEASUREMENT dataJ1939Dm1Failrs_as[60].dtc_as[6].fmi_u8 "" UBYTE CnvRule_NumberOneToOne 1 0 0 255 ECU_ADDRESS 0x70017578 /end MEASUREMENT
/begin MEASUREMENT dataJ1939Dm1Failrs_as[60].dtc_as[6].occ_u8 "" UBYTE CnvRule_NumberOneToOne 1 0 0 255 ECU_ADDRESS 0x70017579 /end MEASUREMENT
/begin MEASUREMENT dataJ1939Dm1Failrs_as[60].dtc_as[7].spn_u32 "" ULONG CnvRule_NumberOneToOne 1 0 0 4294967295 ECU_ADDRESS 0x7001757C /end MEASUREMENT
/begin MEASUREMENT dataJ1939Dm1Failrs_as[60].dtc_as[7].fmi_u8 "" UBYTE CnvRule_NumberOneToOne 1 0 0 255 ECU_ADDRESS 0x70017580 /end MEASUREMENT
/begin MEASUREMENT dataJ1939Dm1Failrs_as[60].dtc_as[7].occ_u8 "" UBYTE CnvRule_NumberOneToOne 1 0 0 255 ECU_ADDRESS 0x70017581 /end MEASUREMENT
/begin MEASUREMENT dataJ1939Dm1Failrs_as[60].dtc_as[8].spn_u32 "" ULONG CnvRule_NumberOneToOne 1 0 0 4294967295 ECU_ADDRESS 0x70017584 /end MEASUREMENT
/begin MEASUREMENT dataJ1939Dm1Failrs_as[60].dtc_as[8].fmi_u8 "" UBYTE CnvRule_NumberOneToOne 1 0 0 255 ECU_ADDRESS 0x70017588 /end MEASUREMENT
/begin MEASUREMENT dataJ1939Dm1Failrs_as[60].dtc_as[8].occ_u8 "" UBYTE CnvRule_NumberOneToOne 1 0 0 255 ECU_ADDRESS 0x70017589 /end MEASUREMENT
/begin MEASUREMENT dataJ1939Dm1Failrs_as[60].dtc_as[9].spn_u32 "" ULONG CnvRule_NumberOneToOne 1 0 0 4294967295 ECU_ADDRESS 0x7001758C /end MEASUREMENT
/begin MEASUREMENT dataJ1939Dm1Failrs_as[60].dtc_as[9].fmi_u8 "" UBYTE CnvRule_NumberOneToOne 1 0 0 255 ECU_ADDRESS 0x70017590 /end MEASUREMENT
/begin MEASUREMENT dataJ1939Dm1Failrs_as[60].dtc_as[9].occ_u8 "" UBYTE CnvRule_NumberOneToOne 1 0 0 255 ECU_ADDRESS 0x70017591 /end MEASUREMENT
/begin MEASUREMENT dataJ1939Dm1Failrs_as[60].dtc_as[10].spn_u32 "" ULONG CnvRule_NumberOneToOne 1 0 0 4294967295 ECU_ADDRESS 0x70017594 /end MEASUREMENT
/begin MEASUREMENT dataJ1939Dm1Failrs_as[60].dtc_as[10].fmi_u8 "" UBYTE CnvRule_NumberOneToOne 1 0 0 255 ECU_ADDRESS 0x70017598 /end MEASUREMENT
/begin MEASUREMENT dataJ1939Dm1Failrs_as[60].dtc_as[10].occ_u8 "" UBYTE CnvRule_NumberOneToOne 1 0 0 255 ECU_ADDRESS 0x70017599 /end MEASUREMENT
/begin MEASUREMENT dataJ1939Dm1Failrs_as[60].dtc_as[11].spn_u32 "" ULONG CnvRule_NumberOneToOne 1 0 0 4294967295 ECU_ADDRESS 0x7001759C /end MEASUREMENT
/begin MEASUREMENT dataJ1939Dm1Failrs_as[60].dtc_as[11].fmi_u8 "" UBYTE CnvRule_NumberOneToOne 1 0 0 255 ECU_ADDRESS 0x700175A0 /end MEASUREMENT
/begin MEASUREMENT dataJ1939Dm1Failrs_as[60].dtc_as[11].occ_u8 "" UBYTE CnvRule_NumberOneToOne 1 0 0 255 ECU_ADDRESS 0x700175A1 /end MEASUREMENT
/begin MEASUREMENT dataJ1939Dm1Failrs_as[60].dtc_as[12].spn_u32 "" ULONG CnvRule_NumberOneToOne 1 0 0 4294967295 ECU_ADDRESS 0x700175A4 /end MEASUREMENT
/begin MEASUREMENT dataJ1939Dm1Failrs_as[60].dtc_as[12].fmi_u8 "" UBYTE CnvRule_NumberOneToOne 1 0 0 255 ECU_ADDRESS 0x700175A8 /end MEASUREMENT
/begin MEASUREMENT dataJ1939Dm1Failrs_as[60].dtc_as[12].occ_u8 "" UBYTE CnvRule_NumberOneToOne 1 0 0 255 ECU_ADDRESS 0x700175A9 /end MEASUREMENT
/begin MEASUREMENT dataJ1939Dm1Failrs_as[60].dtc_as[13].spn_u32 "" ULONG CnvRule_NumberOneToOne 1 0 0 4294967295 ECU_ADDRESS 0x700175AC /end MEASUREMENT
/begin MEASUREMENT dataJ1939Dm1Failrs_as[60].dtc_as[13].fmi_u8 "" UBYTE CnvRule_NumberOneToOne 1 0 0 255 ECU_ADDRESS 0x700175B0 /end MEASUREMENT
/begin MEASUREMENT dataJ1939Dm1Failrs_as[60].dtc_as[13].occ_u8 "" UBYTE CnvRule_NumberOneToOne 1 0 0 255 ECU_ADDRESS 0x700175B1 /end MEASUREMENT
/begin MEASUREMENT dataJ1939Dm1Failrs_as[60].dtc_as[14].spn_u32 "" ULONG CnvRule_NumberOneToOne 1 0 0 4294967295 ECU_ADDRESS 0x700175B4 /end MEASUREMENT
/begin MEASUREMENT dataJ1939Dm1Failrs_as[60].dtc_as[14].fmi_u8 "" UBYTE CnvRule_NumberOneToOne 1 0 0 255 ECU_ADDRESS 0x700175B8 /end MEASUREMENT
/begin MEASUREMENT dataJ1939Dm1Failrs_as[60].dtc_as[14].occ_u8 "" UBYTE CnvRule_NumberOneToOne 1 0 0 255 ECU_ADDRESS 0x700175B9 /end MEASUREMENT
/begin MEASUREMENT dataJ1939Dm1Failrs_as[60].dtc_as[15].spn_u32 "" ULONG CnvRule_NumberOneToOne 1 0 0 4294967295 ECU_ADDRESS 0x700175BC /end MEASUREMENT
/begin MEASUREMENT dataJ1939Dm1Failrs_as[60].dtc_as[15].fmi_u8 "" UBYTE CnvRule_NumberOneToOne 1 0 0 255 ECU_ADDRESS 0x700175C0 /end MEASUREMENT
/begin MEASUREMENT dataJ1939Dm1Failrs_as[60].dtc_as[15].occ_u8 "" UBYTE CnvRule_NumberOneToOne 1 0 0 255 ECU_ADDRESS 0x700175C1 /end MEASUREMENT
/begin MEASUREMENT dataJ1939Dm1Failrs_as[60].dtc_as[16].spn_u32 "" ULONG CnvRule_NumberOneToOne 1 0 0 4294967295 ECU_ADDRESS 0x700175C4 /end MEASUREMENT
/begin MEASUREMENT dataJ1939Dm1Failrs_as[60].dtc_as[16].fmi_u8 "" UBYTE CnvRule_NumberOneToOne 1 0 0 255 ECU_ADDRESS 0x700175C8 /end MEASUREMENT
/begin MEASUREMENT dataJ1939Dm1Failrs_as[60].dtc_as[16].occ_u8 "" UBYTE CnvRule_NumberOneToOne 1 0 0 255 ECU_ADDRESS 0x700175C9 /end MEASUREMENT
/begin MEASUREMENT dataJ1939Dm1Failrs_as[60].dtc_as[17].spn_u32 "" ULONG CnvRule_NumberOneToOne 1 0 0 4294967295 ECU_ADDRESS 0x700175CC /end MEASUREMENT
/begin MEASUREMENT dataJ1939Dm1Failrs_as[60].dtc_as[17].fmi_u8 "" UBYTE CnvRule_NumberOneToOne 1 0 0 255 ECU_ADDRESS 0x700175D0 /end MEASUREMENT
/begin MEASUREMENT dataJ1939Dm1Failrs_as[60].dtc_as[17].occ_u8 "" UBYTE CnvRule_NumberOneToOne 1 0 0 255 ECU_ADDRESS 0x700175D1 /end MEASUREMENT
/begin MEASUREMENT dataJ1939Dm1Failrs_as[60].dtc_as[18].spn_u32 "" ULONG CnvRule_NumberOneToOne 1 0 0 4294967295 ECU_ADDRESS 0x700175D4 /end MEASUREMENT
/begin MEASUREMENT dataJ1939Dm1Failrs_as[60].dtc_as[18].fmi_u8 "" UBYTE CnvRule_NumberOneToOne 1 0 0 255 ECU_ADDRESS 0x700175D8 /end MEASUREMENT
/begin MEASUREMENT dataJ1939Dm1Failrs_as[60].dtc_as[18].occ_u8 "" UBYTE CnvRule_NumberOneToOne 1 0 0 255 ECU_ADDRESS 0x700175D9 /end MEASUREMENT
/begin MEASUREMENT dataJ1939Dm1Failrs_as[60].dtc_as[19].spn_u32 "" ULONG CnvRule_NumberOneToOne 1 0 0 4294967295 ECU_ADDRESS 0x700175DC /end MEASUREMENT
/begin MEASUREMENT dataJ1939Dm1Failrs_as[60].dtc_as[19].fmi_u8 "" UBYTE CnvRule_NumberOneToOne 1 0 0 255 ECU_ADDRESS 0x700175E0 /end MEASUREMENT
/begin MEASUREMENT dataJ1939Dm1Failrs_as[60].dtc_as[19].occ_u8 "" UBYTE CnvRule_NumberOneToOne 1 0 0 255 ECU_ADDRESS 0x700175E1 /end MEASUREMENT
/begin MEASUREMENT dataJ1939Dm1Failrs_as[60].dtc_as[20].spn_u32 "" ULONG CnvRule_NumberOneToOne 1 0 0 4294967295 ECU_ADDRESS 0x700175E4 /end MEASUREMENT
/begin MEASUREMENT dataJ1939Dm1Failrs_as[60].dtc_as[20].fmi_u8 "" UBYTE CnvRule_NumberOneToOne 1 0 0 255 ECU_ADDRESS 0x700175E8 /end MEASUREMENT
/begin MEASUREMENT dataJ1939Dm1Failrs_as[60].dtc_as[20].occ_u8 "" UBYTE CnvRule_NumberOneToOne 1 0 0 255 ECU_ADDRESS 0x700175E9 /end MEASUREMENT
/begin MEASUREMENT dataJ1939Dm1Failrs_as[60].dtc_as "" UBYTE CnvRule_NumberOneToOne 1 0 0 255 ECU_ADDRESS 0x7001754C ARRAY_SIZE 160 /end MEASUREMENT
/begin MEASUREMENT dataJ1939Dm1Failrs_as[61].dtc_as[1].spn_u32 "" ULONG CnvRule_NumberOneToOne 1 0 0 4294967295 ECU_ADDRESS 0x700175F0 /end MEASUREMENT
/begin MEASUREMENT dataJ1939Dm1Failrs_as[61].dtc_as[1].fmi_u8 "" UBYTE CnvRule_NumberOneToOne 1 0 0 255 ECU_ADDRESS 0x700175F4 /end MEASUREMENT
/begin MEASUREMENT dataJ1939Dm1Failrs_as[61].dtc_as[1].occ_u8 "" UBYTE CnvRule_NumberOneToOne 1 0 0 255 ECU_ADDRESS 0x700175F5 /end MEASUREMENT
/begin MEASUREMENT dataJ1939Dm1Failrs_as[61].dtc_as[2].spn_u32 "" ULONG CnvRule_NumberOneToOne 1 0 0 4294967295 ECU_ADDRESS 0x700175F8 /end MEASUREMENT
/begin MEASUREMENT dataJ1939Dm1Failrs_as[61].dtc_as[2].fmi_u8 "" UBYTE CnvRule_NumberOneToOne 1 0 0 255 ECU_ADDRESS 0x700175FC /end MEASUREMENT
/begin MEASUREMENT dataJ1939Dm1Failrs_as[61].dtc_as[2].occ_u8 "" UBYTE CnvRule_NumberOneToOne 1 0 0 255 ECU_ADDRESS 0x700175FD /end MEASUREMENT
/begin MEASUREMENT dataJ1939Dm1Failrs_as[61].dtc_as[3].spn_u32 "" ULONG CnvRule_NumberOneToOne 1 0 0 4294967295 ECU_ADDRESS 0x70017600 /end MEASUREMENT
/begin MEASUREMENT dataJ1939Dm1Failrs_as[61].dtc_as[3].fmi_u8 "" UBYTE CnvRule_NumberOneToOne 1 0 0 255 ECU_ADDRESS 0x70017604 /end MEASUREMENT
/begin MEASUREMENT dataJ1939Dm1Failrs_as[61].dtc_as[3].occ_u8 "" UBYTE CnvRule_NumberOneToOne 1 0 0 255 ECU_ADDRESS 0x70017605 /end MEASUREMENT
/begin MEASUREMENT dataJ1939Dm1Failrs_as[61].dtc_as[4].spn_u32 "" ULONG CnvRule_NumberOneToOne 1 0 0 4294967295 ECU_ADDRESS 0x70017608 /end MEASUREMENT
/begin MEASUREMENT dataJ1939Dm1Failrs_as[61].dtc_as[4].fmi_u8 "" UBYTE CnvRule_NumberOneToOne 1 0 0 255 ECU_ADDRESS 0x7001760C /end MEASUREMENT
/begin MEASUREMENT dataJ1939Dm1Failrs_as[61].dtc_as[4].occ_u8 "" UBYTE CnvRule_NumberOneToOne 1 0 0 255 ECU_ADDRESS 0x7001760D /end MEASUREMENT
/begin MEASUREMENT dataJ1939Dm1Failrs_as[61].dtc_as[5].spn_u32 "" ULONG CnvRule_NumberOneToOne 1 0 0 4294967295 ECU_ADDRESS 0x70017610 /end MEASUREMENT
/begin MEASUREMENT dataJ1939Dm1Failrs_as[61].dtc_as[5].fmi_u8 "" UBYTE CnvRule_NumberOneToOne 1 0 0 255 ECU_ADDRESS 0x70017614 /end MEASUREMENT
/begin MEASUREMENT dataJ1939Dm1Failrs_as[61].dtc_as[5].occ_u8 "" UBYTE CnvRule_NumberOneToOne 1 0 0 255 ECU_ADDRESS 0x70017615 /end MEASUREMENT
/begin MEASUREMENT dataJ1939Dm1Failrs_as[61].dtc_as[6].spn_u32 "" ULONG CnvRule_NumberOneToOne 1 0 0 4294967295 ECU_ADDRESS 0x70017618 /end MEASUREMENT
/begin MEASUREMENT dataJ1939Dm1Failrs_as[61].dtc_as[6].fmi_u8 "" UBYTE CnvRule_NumberOneToOne 1 0 0 255 ECU_ADDRESS 0x7001761C /end MEASUREMENT
/begin MEASUREMENT dataJ1939Dm1Failrs_as[61].dtc_as[6].occ_u8 "" UBYTE CnvRule_NumberOneToOne 1 0 0 255 ECU_ADDRESS 0x7001761D /end MEASUREMENT
/begin MEASUREMENT dataJ1939Dm1Failrs_as[61].dtc_as[7].spn_u32 "" ULONG CnvRule_NumberOneToOne 1 0 0 4294967295 ECU_ADDRESS 0x70017620 /end MEASUREMENT
/begin MEASUREMENT dataJ1939Dm1Failrs_as[61].dtc_as[7].fmi_u8 "" UBYTE CnvRule_NumberOneToOne 1 0 0 255 ECU_ADDRESS 0x70017624 /end MEASUREMENT
/begin MEASUREMENT dataJ1939Dm1Failrs_as[61].dtc_as[7].occ_u8 "" UBYTE CnvRule_NumberOneToOne 1 0 0 255 ECU_ADDRESS 0x70017625 /end MEASUREMENT
/begin MEASUREMENT dataJ1939Dm1Failrs_as[61].dtc_as[8].spn_u32 "" ULONG CnvRule_NumberOneToOne 1 0 0 4294967295 ECU_ADDRESS 0x70017628 /end MEASUREMENT
/begin MEASUREMENT dataJ1939Dm1Failrs_as[61].dtc_as[8].fmi_u8 "" UBYTE CnvRule_NumberOneToOne 1 0 0 255 ECU_ADDRESS 0x7001762C /end MEASUREMENT
/begin MEASUREMENT dataJ1939Dm1Failrs_as[61].dtc_as[8].occ_u8 "" UBYTE CnvRule_NumberOneToOne 1 0 0 255 ECU_ADDRESS 0x7001762D /end MEASUREMENT
/begin MEASUREMENT dataJ1939Dm1Failrs_as[61].dtc_as[9].spn_u32 "" ULONG CnvRule_NumberOneToOne 1 0 0 4294967295 ECU_ADDRESS 0x70017630 /end MEASUREMENT
/begin MEASUREMENT dataJ1939Dm1Failrs_as[61].dtc_as[9].fmi_u8 "" UBYTE CnvRule_NumberOneToOne 1 0 0 255 ECU_ADDRESS 0x70017634 /end MEASUREMENT
/begin MEASUREMENT dataJ1939Dm1Failrs_as[61].dtc_as[9].occ_u8 "" UBYTE CnvRule_NumberOneToOne 1 0 0 255 ECU_ADDRESS 0x70017635 /end MEASUREMENT
/begin MEASUREMENT dataJ1939Dm1Failrs_as[61].dtc_as[10].spn_u32 "" ULONG CnvRule_NumberOneToOne 1 0 0 4294967295 ECU_ADDRESS 0x70017638 /end MEASUREMENT
/begin MEASUREMENT dataJ1939Dm1Failrs_as[61].dtc_as[10].fmi_u8 "" UBYTE CnvRule_NumberOneToOne 1 0 0 255 ECU_ADDRESS 0x7001763C /end MEASUREMENT
/begin MEASUREMENT dataJ1939Dm1Failrs_as[61].dtc_as[10].occ_u8 "" UBYTE CnvRule_NumberOneToOne 1 0 0 255 ECU_ADDRESS 0x7001763D /end MEASUREMENT
/begin MEASUREMENT dataJ1939Dm1Failrs_as[61].dtc_as[11].spn_u32 "" ULONG CnvRule_NumberOneToOne 1 0 0 4294967295 ECU_ADDRESS 0x70017640 /end MEASUREMENT
/begin MEASUREMENT dataJ1939Dm1Failrs_as[61].dtc_as[11].fmi_u8 "" UBYTE CnvRule_NumberOneToOne 1 0 0 255 ECU_ADDRESS 0x70017644 /end MEASUREMENT
/begin MEASUREMENT dataJ1939Dm1Failrs_as[61].dtc_as[11].occ_u8 "" UBYTE CnvRule_NumberOneToOne 1 0 0 255 ECU_ADDRESS 0x70017645 /end MEASUREMENT
/begin MEASUREMENT dataJ1939Dm1Failrs_as[61].dtc_as[12].spn_u32 "" ULONG CnvRule_NumberOneToOne 1 0 0 4294967295 ECU_ADDRESS 0x70017648 /end MEASUREMENT
/begin MEASUREMENT dataJ1939Dm1Failrs_as[61].dtc_as[12].fmi_u8 "" UBYTE CnvRule_NumberOneToOne 1 0 0 255 ECU_ADDRESS 0x7001764C /end MEASUREMENT
/begin MEASUREMENT dataJ1939Dm1Failrs_as[61].dtc_as[12].occ_u8 "" UBYTE CnvRule_NumberOneToOne 1 0 0 255 ECU_ADDRESS 0x7001764D /end MEASUREMENT
/begin MEASUREMENT dataJ1939Dm1Failrs_as[61].dtc_as[13].spn_u32 "" ULONG CnvRule_NumberOneToOne 1 0 0 4294967295 ECU_ADDRESS 0x70017650 /end MEASUREMENT
/begin MEASUREMENT dataJ1939Dm1Failrs_as[61].dtc_as[13].fmi_u8 "" UBYTE CnvRule_NumberOneToOne 1 0 0 255 ECU_ADDRESS 0x70017654 /end MEASUREMENT
/begin MEASUREMENT dataJ1939Dm1Failrs_as[61].dtc_as[13].occ_u8 "" UBYTE CnvRule_NumberOneToOne 1 0 0 255 ECU_ADDRESS 0x70017655 /end MEASUREMENT
/begin MEASUREMENT dataJ1939Dm1Failrs_as[61].dtc_as[14].spn_u32 "" ULONG CnvRule_NumberOneToOne 1 0 0 4294967295 ECU_ADDRESS 0x70017658 /end MEASUREMENT
/begin MEASUREMENT dataJ1939Dm1Failrs_as[61].dtc_as[14].fmi_u8 "" UBYTE CnvRule_NumberOneToOne 1 0 0 255 ECU_ADDRESS 0x7001765C /end MEASUREMENT
/begin MEASUREMENT dataJ1939Dm1Failrs_as[61].dtc_as[14].occ_u8 "" UBYTE CnvRule_NumberOneToOne 1 0 0 255 ECU_ADDRESS 0x7001765D /end MEASUREMENT
/begin MEASUREMENT dataJ1939Dm1Failrs_as[61].dtc_as[15].spn_u32 "" ULONG CnvRule_NumberOneToOne 1 0 0 4294967295 ECU_ADDRESS 0x70017660 /end MEASUREMENT
/begin MEASUREMENT dataJ1939Dm1Failrs_as[61].dtc_as[15].fmi_u8 "" UBYTE CnvRule_NumberOneToOne 1 0 0 255 ECU_ADDRESS 0x70017664 /end MEASUREMENT
/begin MEASUREMENT dataJ1939Dm1Failrs_as[61].dtc_as[15].occ_u8 "" UBYTE CnvRule_NumberOneToOne 1 0 0 255 ECU_ADDRESS 0x70017665 /end MEASUREMENT
/begin MEASUREMENT dataJ1939Dm1Failrs_as[61].dtc_as[16].spn_u32 "" ULONG CnvRule_NumberOneToOne 1 0 0 4294967295 ECU_ADDRESS 0x70017668 /end MEASUREMENT
/begin MEASUREMENT dataJ1939Dm1Failrs_as[61].dtc_as[16].fmi_u8 "" UBYTE CnvRule_NumberOneToOne 1 0 0 255 ECU_ADDRESS 0x7001766C /end MEASUREMENT
/begin MEASUREMENT dataJ1939Dm1Failrs_as[61].dtc_as[16].occ_u8 "" UBYTE CnvRule_NumberOneToOne 1 0 0 255 ECU_ADDRESS 0x7001766D /end MEASUREMENT
/begin MEASUREMENT dataJ1939Dm1Failrs_as[61].dtc_as[17].spn_u32 "" ULONG CnvRule_NumberOneToOne 1 0 0 4294967295 ECU_ADDRESS 0x70017670 /end MEASUREMENT
/begin MEASUREMENT dataJ1939Dm1Failrs_as[61].dtc_as[17].fmi_u8 "" UBYTE CnvRule_NumberOneToOne 1 0 0 255 ECU_ADDRESS 0x70017674 /end MEASUREMENT
/begin MEASUREMENT dataJ1939Dm1Failrs_as[61].dtc_as[17].occ_u8 "" UBYTE CnvRule_NumberOneToOne 1 0 0 255 ECU_ADDRESS 0x70017675 /end MEASUREMENT
/begin MEASUREMENT dataJ1939Dm1Failrs_as[61].dtc_as[18].spn_u32 "" ULONG CnvRule_NumberOneToOne 1 0 0 4294967295 ECU_ADDRESS 0x70017678 /end MEASUREMENT
/begin MEASUREMENT dataJ1939Dm1Failrs_as[61].dtc_as[18].fmi_u8 "" UBYTE CnvRule_NumberOneToOne 1 0 0 255 ECU_ADDRESS 0x7001767C /end MEASUREMENT
/begin MEASUREMENT dataJ1939Dm1Failrs_as[61].dtc_as[18].occ_u8 "" UBYTE CnvRule_NumberOneToOne 1 0 0 255 ECU_ADDRESS 0x7001767D /end MEASUREMENT
/begin MEASUREMENT dataJ1939Dm1Failrs_as[61].dtc_as[19].spn_u32 "" ULONG CnvRule_NumberOneToOne 1 0 0 4294967295 ECU_ADDRESS 0x70017680 /end MEASUREMENT
/begin MEASUREMENT dataJ1939Dm1Failrs_as[61].dtc_as[19].fmi_u8 "" UBYTE CnvRule_NumberOneToOne 1 0 0 255 ECU_ADDRESS 0x70017684 /end MEASUREMENT
/begin MEASUREMENT dataJ1939Dm1Failrs_as[61].dtc_as[19].occ_u8 "" UBYTE CnvRule_NumberOneToOne 1 0 0 255 ECU_ADDRESS 0x70017685 /end MEASUREMENT
/begin MEASUREMENT dataJ1939Dm1Failrs_as[61].dtc_as[20].spn_u32 "" ULONG CnvRule_NumberOneToOne 1 0 0 4294967295 ECU_ADDRESS 0x70017688 /end MEASUREMENT
/begin MEASUREMENT dataJ1939Dm1Failrs_as[61].dtc_as[20].fmi_u8 "" UBYTE CnvRule_NumberOneToOne 1 0 0 255 ECU_ADDRESS 0x7001768C /end MEASUREMENT
/begin MEASUREMENT dataJ1939Dm1Failrs_as[61].dtc_as[20].occ_u8 "" UBYTE CnvRule_NumberOneToOne 1 0 0 255 ECU_ADDRESS 0x7001768D /end MEASUREMENT
/begin MEASUREMENT dataJ1939Dm1Failrs_as[61].dtc_as "" UBYTE CnvRule_NumberOneToOne 1 0 0 255 ECU_ADDRESS 0x700175F0 ARRAY_SIZE 160 /end MEASUREMENT
/begin MEASUREMENT dataJ1939Dm1Failrs_as[62].dtc_as[1].spn_u32 "" ULONG CnvRule_NumberOneToOne 1 0 0 4294967295 ECU_ADDRESS 0x70017694 /end MEASUREMENT
/begin MEASUREMENT dataJ1939Dm1Failrs_as[62].dtc_as[1].fmi_u8 "" UBYTE CnvRule_NumberOneToOne 1 0 0 255 ECU_ADDRESS 0x70017698 /end MEASUREMENT
/begin MEASUREMENT dataJ1939Dm1Failrs_as[62].dtc_as[1].occ_u8 "" UBYTE CnvRule_NumberOneToOne 1 0 0 255 ECU_ADDRESS 0x70017699 /end MEASUREMENT
/begin MEASUREMENT dataJ1939Dm1Failrs_as[62].dtc_as[2].spn_u32 "" ULONG CnvRule_NumberOneToOne 1 0 0 4294967295 ECU_ADDRESS 0x7001769C /end MEASUREMENT
/begin MEASUREMENT dataJ1939Dm1Failrs_as[62].dtc_as[2].fmi_u8 "" UBYTE CnvRule_NumberOneToOne 1 0 0 255 ECU_ADDRESS 0x700176A0 /end MEASUREMENT
/begin MEASUREMENT dataJ1939Dm1Failrs_as[62].dtc_as[2].occ_u8 "" UBYTE CnvRule_NumberOneToOne 1 0 0 255 ECU_ADDRESS 0x700176A1 /end MEASUREMENT
/begin MEASUREMENT dataJ1939Dm1Failrs_as[62].dtc_as[3].spn_u32 "" ULONG CnvRule_NumberOneToOne 1 0 0 4294967295 ECU_ADDRESS 0x700176A4 /end MEASUREMENT
/begin MEASUREMENT dataJ1939Dm1Failrs_as[62].dtc_as[3].fmi_u8 "" UBYTE CnvRule_NumberOneToOne 1 0 0 255 ECU_ADDRESS 0x700176A8 /end MEASUREMENT
/begin MEASUREMENT dataJ1939Dm1Failrs_as[62].dtc_as[3].occ_u8 "" UBYTE CnvRule_NumberOneToOne 1 0 0 255 ECU_ADDRESS 0x700176A9 /end MEASUREMENT
/begin MEASUREMENT dataJ1939Dm1Failrs_as[62].dtc_as[4].spn_u32 "" ULONG CnvRule_NumberOneToOne 1 0 0 4294967295 ECU_ADDRESS 0x700176AC /end MEASUREMENT
/begin MEASUREMENT dataJ1939Dm1Failrs_as[62].dtc_as[4].fmi_u8 "" UBYTE CnvRule_NumberOneToOne 1 0 0 255 ECU_ADDRESS 0x700176B0 /end MEASUREMENT
/begin MEASUREMENT dataJ1939Dm1Failrs_as[62].dtc_as[4].occ_u8 "" UBYTE CnvRule_NumberOneToOne 1 0 0 255 ECU_ADDRESS 0x700176B1 /end MEASUREMENT
/begin MEASUREMENT dataJ1939Dm1Failrs_as[62].dtc_as[5].spn_u32 "" ULONG CnvRule_NumberOneToOne 1 0 0 4294967295 ECU_ADDRESS 0x700176B4 /end MEASUREMENT
/begin MEASUREMENT dataJ1939Dm1Failrs_as[62].dtc_as[5].fmi_u8 "" UBYTE CnvRule_NumberOneToOne 1 0 0 255 ECU_ADDRESS 0x700176B8 /end MEASUREMENT
/begin MEASUREMENT dataJ1939Dm1Failrs_as[62].dtc_as[5].occ_u8 "" UBYTE CnvRule_NumberOneToOne 1 0 0 255 ECU_ADDRESS 0x700176B9 /end MEASUREMENT
/begin MEASUREMENT dataJ1939Dm1Failrs_as[62].dtc_as[6].spn_u32 "" ULONG CnvRule_NumberOneToOne 1 0 0 4294967295 ECU_ADDRESS 0x700176BC /end MEASUREMENT
/begin MEASUREMENT dataJ1939Dm1Failrs_as[62].dtc_as[6].fmi_u8 "" UBYTE CnvRule_NumberOneToOne 1 0 0 255 ECU_ADDRESS 0x700176C0 /end MEASUREMENT
/begin MEASUREMENT dataJ1939Dm1Failrs_as[62].dtc_as[6].occ_u8 "" UBYTE CnvRule_NumberOneToOne 1 0 0 255 ECU_ADDRESS 0x700176C1 /end MEASUREMENT
/begin MEASUREMENT dataJ1939Dm1Failrs_as[62].dtc_as[7].spn_u32 "" ULONG CnvRule_NumberOneToOne 1 0 0 4294967295 ECU_ADDRESS 0x700176C4 /end MEASUREMENT
/begin MEASUREMENT dataJ1939Dm1Failrs_as[62].dtc_as[7].fmi_u8 "" UBYTE CnvRule_NumberOneToOne 1 0 0 255 ECU_ADDRESS 0x700176C8 /end MEASUREMENT
/begin MEASUREMENT dataJ1939Dm1Failrs_as[62].dtc_as[7].occ_u8 "" UBYTE CnvRule_NumberOneToOne 1 0 0 255 ECU_ADDRESS 0x700176C9 /end MEASUREMENT
/begin MEASUREMENT dataJ1939Dm1Failrs_as[62].dtc_as[8].spn_u32 "" ULONG CnvRule_NumberOneToOne 1 0 0 4294967295 ECU_ADDRESS 0x700176CC /end MEASUREMENT
/begin MEASUREMENT dataJ1939Dm1Failrs_as[62].dtc_as[8].fmi_u8 "" UBYTE CnvRule_NumberOneToOne 1 0 0 255 ECU_ADDRESS 0x700176D0 /end MEASUREMENT
/begin MEASUREMENT dataJ1939Dm1Failrs_as[62].dtc_as[8].occ_u8 "" UBYTE CnvRule_NumberOneToOne 1 0 0 255 ECU_ADDRESS 0x700176D1 /end MEASUREMENT
/begin MEASUREMENT dataJ1939Dm1Failrs_as[62].dtc_as[9].spn_u32 "" ULONG CnvRule_NumberOneToOne 1 0 0 4294967295 ECU_ADDRESS 0x700176D4 /end MEASUREMENT
/begin MEASUREMENT dataJ1939Dm1Failrs_as[62].dtc_as[9].fmi_u8 "" UBYTE CnvRule_NumberOneToOne 1 0 0 255 ECU_ADDRESS 0x700176D8 /end MEASUREMENT
/begin MEASUREMENT dataJ1939Dm1Failrs_as[62].dtc_as[9].occ_u8 "" UBYTE CnvRule_NumberOneToOne 1 0 0 255 ECU_ADDRESS 0x700176D9 /end MEASUREMENT
/begin MEASUREMENT dataJ1939Dm1Failrs_as[62].dtc_as[10].spn_u32 "" ULONG CnvRule_NumberOneToOne 1 0 0 4294967295 ECU_ADDRESS 0x700176DC /end MEASUREMENT
/begin MEASUREMENT dataJ1939Dm1Failrs_as[62].dtc_as[10].fmi_u8 "" UBYTE CnvRule_NumberOneToOne 1 0 0 255 ECU_ADDRESS 0x700176E0 /end MEASUREMENT
/begin MEASUREMENT dataJ1939Dm1Failrs_as[62].dtc_as[10].occ_u8 "" UBYTE CnvRule_NumberOneToOne 1 0 0 255 ECU_ADDRESS 0x700176E1 /end MEASUREMENT
/begin MEASUREMENT dataJ1939Dm1Failrs_as[62].dtc_as[11].spn_u32 "" ULONG CnvRule_NumberOneToOne 1 0 0 4294967295 ECU_ADDRESS 0x700176E4 /end MEASUREMENT
/begin MEASUREMENT dataJ1939Dm1Failrs_as[62].dtc_as[11].fmi_u8 "" UBYTE CnvRule_NumberOneToOne 1 0 0 255 ECU_ADDRESS 0x700176E8 /end MEASUREMENT
/begin MEASUREMENT dataJ1939Dm1Failrs_as[62].dtc_as[11].occ_u8 "" UBYTE CnvRule_NumberOneToOne 1 0 0 255 ECU_ADDRESS 0x700176E9 /end MEASUREMENT
/begin MEASUREMENT dataJ1939Dm1Failrs_as[62].dtc_as[12].spn_u32 "" ULONG CnvRule_NumberOneToOne 1 0 0 4294967295 ECU_ADDRESS 0x700176EC /end MEASUREMENT
/begin MEASUREMENT dataJ1939Dm1Failrs_as[62].dtc_as[12].fmi_u8 "" UBYTE CnvRule_NumberOneToOne 1 0 0 255 ECU_ADDRESS 0x700176F0 /end MEASUREMENT
/begin MEASUREMENT dataJ1939Dm1Failrs_as[62].dtc_as[12].occ_u8 "" UBYTE CnvRule_NumberOneToOne 1 0 0 255 ECU_ADDRESS 0x700176F1 /end MEASUREMENT
/begin MEASUREMENT dataJ1939Dm1Failrs_as[62].dtc_as[13].spn_u32 "" ULONG CnvRule_NumberOneToOne 1 0 0 4294967295 ECU_ADDRESS 0x700176F4 /end MEASUREMENT
/begin MEASUREMENT dataJ1939Dm1Failrs_as[62].dtc_as[13].fmi_u8 "" UBYTE CnvRule_NumberOneToOne 1 0 0 255 ECU_ADDRESS 0x700176F8 /end MEASUREMENT
/begin MEASUREMENT dataJ1939Dm1Failrs_as[62].dtc_as[13].occ_u8 "" UBYTE CnvRule_NumberOneToOne 1 0 0 255 ECU_ADDRESS 0x700176F9 /end MEASUREMENT
/begin MEASUREMENT dataJ1939Dm1Failrs_as[62].dtc_as[14].spn_u32 "" ULONG CnvRule_NumberOneToOne 1 0 0 4294967295 ECU_ADDRESS 0x700176FC /end MEASUREMENT
/begin MEASUREMENT dataJ1939Dm1Failrs_as[62].dtc_as[14].fmi_u8 "" UBYTE CnvRule_NumberOneToOne 1 0 0 255 ECU_ADDRESS 0x70017700 /end MEASUREMENT
/begin MEASUREMENT dataJ1939Dm1Failrs_as[62].dtc_as[14].occ_u8 "" UBYTE CnvRule_NumberOneToOne 1 0 0 255 ECU_ADDRESS 0x70017701 /end MEASUREMENT
/begin MEASUREMENT dataJ1939Dm1Failrs_as[62].dtc_as[15].spn_u32 "" ULONG CnvRule_NumberOneToOne 1 0 0 4294967295 ECU_ADDRESS 0x70017704 /end MEASUREMENT
/begin MEASUREMENT dataJ1939Dm1Failrs_as[62].dtc_as[15].fmi_u8 "" UBYTE CnvRule_NumberOneToOne 1 0 0 255 ECU_ADDRESS 0x70017708 /end MEASUREMENT
/begin MEASUREMENT dataJ1939Dm1Failrs_as[62].dtc_as[15].occ_u8 "" UBYTE CnvRule_NumberOneToOne 1 0 0 255 ECU_ADDRESS 0x70017709 /end MEASUREMENT
/begin MEASUREMENT dataJ1939Dm1Failrs_as[62].dtc_as[16].spn_u32 "" ULONG CnvRule_NumberOneToOne 1 0 0 4294967295 ECU_ADDRESS 0x7001770C /end MEASUREMENT
/begin MEASUREMENT dataJ1939Dm1Failrs_as[62].dtc_as[16].fmi_u8 "" UBYTE CnvRule_NumberOneToOne 1 0 0 255 ECU_ADDRESS 0x70017710 /end MEASUREMENT
/begin MEASUREMENT dataJ1939Dm1Failrs_as[62].dtc_as[16].occ_u8 "" UBYTE CnvRule_NumberOneToOne 1 0 0 255 ECU_ADDRESS 0x70017711 /end MEASUREMENT
/begin MEASUREMENT dataJ1939Dm1Failrs_as[62].dtc_as[17].spn_u32 "" ULONG CnvRule_NumberOneToOne 1 0 0 4294967295 ECU_ADDRESS 0x70017714 /end MEASUREMENT
/begin MEASUREMENT dataJ1939Dm1Failrs_as[62].dtc_as[17].fmi_u8 "" UBYTE CnvRule_NumberOneToOne 1 0 0 255 ECU_ADDRESS 0x70017718 /end MEASUREMENT
/begin MEASUREMENT dataJ1939Dm1Failrs_as[62].dtc_as[17].occ_u8 "" UBYTE CnvRule_NumberOneToOne 1 0 0 255 ECU_ADDRESS 0x70017719 /end MEASUREMENT
/begin MEASUREMENT dataJ1939Dm1Failrs_as[62].dtc_as[18].spn_u32 "" ULONG CnvRule_NumberOneToOne 1 0 0 4294967295 ECU_ADDRESS 0x7001771C /end MEASUREMENT
/begin MEASUREMENT dataJ1939Dm1Failrs_as[62].dtc_as[18].fmi_u8 "" UBYTE CnvRule_NumberOneToOne 1 0 0 255 ECU_ADDRESS 0x70017720 /end MEASUREMENT
/begin MEASUREMENT dataJ1939Dm1Failrs_as[62].dtc_as[18].occ_u8 "" UBYTE CnvRule_NumberOneToOne 1 0 0 255 ECU_ADDRESS 0x70017721 /end MEASUREMENT
/begin MEASUREMENT dataJ1939Dm1Failrs_as[62].dtc_as[19].spn_u32 "" ULONG CnvRule_NumberOneToOne 1 0 0 4294967295 ECU_ADDRESS 0x70017724 /end MEASUREMENT
/begin MEASUREMENT dataJ1939Dm1Failrs_as[62].dtc_as[19].fmi_u8 "" UBYTE CnvRule_NumberOneToOne 1 0 0 255 ECU_ADDRESS 0x70017728 /end MEASUREMENT
/begin MEASUREMENT dataJ1939Dm1Failrs_as[62].dtc_as[19].occ_u8 "" UBYTE CnvRule_NumberOneToOne 1 0 0 255 ECU_ADDRESS 0x70017729 /end MEASUREMENT
/begin MEASUREMENT dataJ1939Dm1Failrs_as[62].dtc_as[20].spn_u32 "" ULONG CnvRule_NumberOneToOne 1 0 0 4294967295 ECU_ADDRESS 0x7001772C /end MEASUREMENT
/begin MEASUREMENT dataJ1939Dm1Failrs_as[62].dtc_as[20].fmi_u8 "" UBYTE CnvRule_NumberOneToOne 1 0 0 255 ECU_ADDRESS 0x70017730 /end MEASUREMENT
/begin MEASUREMENT dataJ1939Dm1Failrs_as[62].dtc_as[20].occ_u8 "" UBYTE CnvRule_NumberOneToOne 1 0 0 255 ECU_ADDRESS 0x70017731 /end MEASUREMENT
/begin MEASUREMENT dataJ1939Dm1Failrs_as[62].dtc_as "" UBYTE CnvRule_NumberOneToOne 1 0 0 255 ECU_ADDRESS 0x70017694 ARRAY_SIZE 160 /end MEASUREMENT
/begin MEASUREMENT dataJ1939Dm1Failrs_as[63].dtc_as[1].spn_u32 "" ULONG CnvRule_NumberOneToOne 1 0 0 4294967295 ECU_ADDRESS 0x70017738 /end MEASUREMENT
/begin MEASUREMENT dataJ1939Dm1Failrs_as[63].dtc_as[1].fmi_u8 "" UBYTE CnvRule_NumberOneToOne 1 0 0 255 ECU_ADDRESS 0x7001773C /end MEASUREMENT
/begin MEASUREMENT dataJ1939Dm1Failrs_as[63].dtc_as[1].occ_u8 "" UBYTE CnvRule_NumberOneToOne 1 0 0 255 ECU_ADDRESS 0x7001773D /end MEASUREMENT
/begin MEASUREMENT dataJ1939Dm1Failrs_as[63].dtc_as[2].spn_u32 "" ULONG CnvRule_NumberOneToOne 1 0 0 4294967295 ECU_ADDRESS 0x70017740 /end MEASUREMENT
/begin MEASUREMENT dataJ1939Dm1Failrs_as[63].dtc_as[2].fmi_u8 "" UBYTE CnvRule_NumberOneToOne 1 0 0 255 ECU_ADDRESS 0x70017744 /end MEASUREMENT
/begin MEASUREMENT dataJ1939Dm1Failrs_as[63].dtc_as[2].occ_u8 "" UBYTE CnvRule_NumberOneToOne 1 0 0 255 ECU_ADDRESS 0x70017745 /end MEASUREMENT
/begin MEASUREMENT dataJ1939Dm1Failrs_as[63].dtc_as[3].spn_u32 "" ULONG CnvRule_NumberOneToOne 1 0 0 4294967295 ECU_ADDRESS 0x70017748 /end MEASUREMENT
/begin MEASUREMENT dataJ1939Dm1Failrs_as[63].dtc_as[3].fmi_u8 "" UBYTE CnvRule_NumberOneToOne 1 0 0 255 ECU_ADDRESS 0x7001774C /end MEASUREMENT
/begin MEASUREMENT dataJ1939Dm1Failrs_as[63].dtc_as[3].occ_u8 "" UBYTE CnvRule_NumberOneToOne 1 0 0 255 ECU_ADDRESS 0x7001774D /end MEASUREMENT
/begin MEASUREMENT dataJ1939Dm1Failrs_as[63].dtc_as[4].spn_u32 "" ULONG CnvRule_NumberOneToOne 1 0 0 4294967295 ECU_ADDRESS 0x70017750 /end MEASUREMENT
/begin MEASUREMENT dataJ1939Dm1Failrs_as[63].dtc_as[4].fmi_u8 "" UBYTE CnvRule_NumberOneToOne 1 0 0 255 ECU_ADDRESS 0x70017754 /end MEASUREMENT
/begin MEASUREMENT dataJ1939Dm1Failrs_as[63].dtc_as[4].occ_u8 "" UBYTE CnvRule_NumberOneToOne 1 0 0 255 ECU_ADDRESS 0x70017755 /end MEASUREMENT
/begin MEASUREMENT dataJ1939Dm1Failrs_as[63].dtc_as[5].spn_u32 "" ULONG CnvRule_NumberOneToOne 1 0 0 4294967295 ECU_ADDRESS 0x70017758 /end MEASUREMENT
/begin MEASUREMENT dataJ1939Dm1Failrs_as[63].dtc_as[5].fmi_u8 "" UBYTE CnvRule_NumberOneToOne 1 0 0 255 ECU_ADDRESS 0x7001775C /end MEASUREMENT
/begin MEASUREMENT dataJ1939Dm1Failrs_as[63].dtc_as[5].occ_u8 "" UBYTE CnvRule_NumberOneToOne 1 0 0 255 ECU_ADDRESS 0x7001775D /end MEASUREMENT
/begin MEASUREMENT dataJ1939Dm1Failrs_as[63].dtc_as[6].spn_u32 "" ULONG CnvRule_NumberOneToOne 1 0 0 4294967295 ECU_ADDRESS 0x70017760 /end MEASUREMENT
/begin MEASUREMENT dataJ1939Dm1Failrs_as[63].dtc_as[6].fmi_u8 "" UBYTE CnvRule_NumberOneToOne 1 0 0 255 ECU_ADDRESS 0x70017764 /end MEASUREMENT
/begin MEASUREMENT dataJ1939Dm1Failrs_as[63].dtc_as[6].occ_u8 "" UBYTE CnvRule_NumberOneToOne 1 0 0 255 ECU_ADDRESS 0x70017765 /end MEASUREMENT
/begin MEASUREMENT dataJ1939Dm1Failrs_as[63].dtc_as[7].spn_u32 "" ULONG CnvRule_NumberOneToOne 1 0 0 4294967295 ECU_ADDRESS 0x70017768 /end MEASUREMENT
/begin MEASUREMENT dataJ1939Dm1Failrs_as[63].dtc_as[7].fmi_u8 "" UBYTE CnvRule_NumberOneToOne 1 0 0 255 ECU_ADDRESS 0x7001776C /end MEASUREMENT
/begin MEASUREMENT dataJ1939Dm1Failrs_as[63].dtc_as[7].occ_u8 "" UBYTE CnvRule_NumberOneToOne 1 0 0 255 ECU_ADDRESS 0x7001776D /end MEASUREMENT
/begin MEASUREMENT dataJ1939Dm1Failrs_as[63].dtc_as[8].spn_u32 "" ULONG CnvRule_NumberOneToOne 1 0 0 4294967295 ECU_ADDRESS 0x70017770 /end MEASUREMENT
/begin MEASUREMENT dataJ1939Dm1Failrs_as[63].dtc_as[8].fmi_u8 "" UBYTE CnvRule_NumberOneToOne 1 0 0 255 ECU_ADDRESS 0x70017774 /end MEASUREMENT
/begin MEASUREMENT dataJ1939Dm1Failrs_as[63].dtc_as[8].occ_u8 "" UBYTE CnvRule_NumberOneToOne 1 0 0 255 ECU_ADDRESS 0x70017775 /end MEASUREMENT
/begin MEASUREMENT dataJ1939Dm1Failrs_as[63].dtc_as[9].spn_u32 "" ULONG CnvRule_NumberOneToOne 1 0 0 4294967295 ECU_ADDRESS 0x70017778 /end MEASUREMENT
/begin MEASUREMENT dataJ1939Dm1Failrs_as[63].dtc_as[9].fmi_u8 "" UBYTE CnvRule_NumberOneToOne 1 0 0 255 ECU_ADDRESS 0x7001777C /end MEASUREMENT
/begin MEASUREMENT dataJ1939Dm1Failrs_as[63].dtc_as[9].occ_u8 "" UBYTE CnvRule_NumberOneToOne 1 0 0 255 ECU_ADDRESS 0x7001777D /end MEASUREMENT
/begin MEASUREMENT dataJ1939Dm1Failrs_as[63].dtc_as[10].spn_u32 "" ULONG CnvRule_NumberOneToOne 1 0 0 4294967295 ECU_ADDRESS 0x70017780 /end MEASUREMENT
/begin MEASUREMENT dataJ1939Dm1Failrs_as[63].dtc_as[10].fmi_u8 "" UBYTE CnvRule_NumberOneToOne 1 0 0 255 ECU_ADDRESS 0x70017784 /end MEASUREMENT
/begin MEASUREMENT dataJ1939Dm1Failrs_as[63].dtc_as[10].occ_u8 "" UBYTE CnvRule_NumberOneToOne 1 0 0 255 ECU_ADDRESS 0x70017785 /end MEASUREMENT
/begin MEASUREMENT dataJ1939Dm1Failrs_as[63].dtc_as[11].spn_u32 "" ULONG CnvRule_NumberOneToOne 1 0 0 4294967295 ECU_ADDRESS 0x70017788 /end MEASUREMENT
/begin MEASUREMENT dataJ1939Dm1Failrs_as[63].dtc_as[11].fmi_u8 "" UBYTE CnvRule_NumberOneToOne 1 0 0 255 ECU_ADDRESS 0x7001778C /end MEASUREMENT
/begin MEASUREMENT dataJ1939Dm1Failrs_as[63].dtc_as[11].occ_u8 "" UBYTE CnvRule_NumberOneToOne 1 0 0 255 ECU_ADDRESS 0x7001778D /end MEASUREMENT
/begin MEASUREMENT dataJ1939Dm1Failrs_as[63].dtc_as[12].spn_u32 "" ULONG CnvRule_NumberOneToOne 1 0 0 4294967295 ECU_ADDRESS 0x70017790 /end MEASUREMENT
/begin MEASUREMENT dataJ1939Dm1Failrs_as[63].dtc_as[12].fmi_u8 "" UBYTE CnvRule_NumberOneToOne 1 0 0 255 ECU_ADDRESS 0x70017794 /end MEASUREMENT
/begin MEASUREMENT dataJ1939Dm1Failrs_as[63].dtc_as[12].occ_u8 "" UBYTE CnvRule_NumberOneToOne 1 0 0 255 ECU_ADDRESS 0x70017795 /end MEASUREMENT
/begin MEASUREMENT dataJ1939Dm1Failrs_as[63].dtc_as[13].spn_u32 "" ULONG CnvRule_NumberOneToOne 1 0 0 4294967295 ECU_ADDRESS 0x70017798 /end MEASUREMENT
/begin MEASUREMENT dataJ1939Dm1Failrs_as[63].dtc_as[13].fmi_u8 "" UBYTE CnvRule_NumberOneToOne 1 0 0 255 ECU_ADDRESS 0x7001779C /end MEASUREMENT
/begin MEASUREMENT dataJ1939Dm1Failrs_as[63].dtc_as[13].occ_u8 "" UBYTE CnvRule_NumberOneToOne 1 0 0 255 ECU_ADDRESS 0x7001779D /end MEASUREMENT
/begin MEASUREMENT dataJ1939Dm1Failrs_as[63].dtc_as[14].spn_u32 "" ULONG CnvRule_NumberOneToOne 1 0 0 4294967295 ECU_ADDRESS 0x700177A0 /end MEASUREMENT
/begin MEASUREMENT dataJ1939Dm1Failrs_as[63].dtc_as[14].fmi_u8 "" UBYTE CnvRule_NumberOneToOne 1 0 0 255 ECU_ADDRESS 0x700177A4 /end MEASUREMENT
/begin MEASUREMENT dataJ1939Dm1Failrs_as[63].dtc_as[14].occ_u8 "" UBYTE CnvRule_NumberOneToOne 1 0 0 255 ECU_ADDRESS 0x700177A5 /end MEASUREMENT
/begin MEASUREMENT dataJ1939Dm1Failrs_as[63].dtc_as[15].spn_u32 "" ULONG CnvRule_NumberOneToOne 1 0 0 4294967295 ECU_ADDRESS 0x700177A8 /end MEASUREMENT
/begin MEASUREMENT dataJ1939Dm1Failrs_as[63].dtc_as[15].fmi_u8 "" UBYTE CnvRule_NumberOneToOne 1 0 0 255 ECU_ADDRESS 0x700177AC /end MEASUREMENT
/begin MEASUREMENT dataJ1939Dm1Failrs_as[63].dtc_as[15].occ_u8 "" UBYTE CnvRule_NumberOneToOne 1 0 0 255 ECU_ADDRESS 0x700177AD /end MEASUREMENT
/begin MEASUREMENT dataJ1939Dm1Failrs_as[63].dtc_as[16].spn_u32 "" ULONG CnvRule_NumberOneToOne 1 0 0 4294967295 ECU_ADDRESS 0x700177B0 /end MEASUREMENT
/begin MEASUREMENT dataJ1939Dm1Failrs_as[63].dtc_as[16].fmi_u8 "" UBYTE CnvRule_NumberOneToOne 1 0 0 255 ECU_ADDRESS 0x700177B4 /end MEASUREMENT
/begin MEASUREMENT dataJ1939Dm1Failrs_as[63].dtc_as[16].occ_u8 "" UBYTE CnvRule_NumberOneToOne 1 0 0 255 ECU_ADDRESS 0x700177B5 /end MEASUREMENT
/begin MEASUREMENT dataJ1939Dm1Failrs_as[63].dtc_as[17].spn_u32 "" ULONG CnvRule_NumberOneToOne 1 0 0 4294967295 ECU_ADDRESS 0x700177B8 /end MEASUREMENT
/begin MEASUREMENT dataJ1939Dm1Failrs_as[63].dtc_as[17].fmi_u8 "" UBYTE CnvRule_NumberOneToOne 1 0 0 255 ECU_ADDRESS 0x700177BC /end MEASUREMENT
/begin MEASUREMENT dataJ1939Dm1Failrs_as[63].dtc_as[17].occ_u8 "" UBYTE CnvRule_NumberOneToOne 1 0 0 255 ECU_ADDRESS 0x700177BD /end MEASUREMENT
/begin MEASUREMENT dataJ1939Dm1Failrs_as[63].dtc_as[18].spn_u32 "" ULONG CnvRule_NumberOneToOne 1 0 0 4294967295 ECU_ADDRESS 0x700177C0 /end MEASUREMENT
/begin MEASUREMENT dataJ1939Dm1Failrs_as[63].dtc_as[18].fmi_u8 "" UBYTE CnvRule_NumberOneToOne 1 0 0 255 ECU_ADDRESS 0x700177C4 /end MEASUREMENT
/begin MEASUREMENT dataJ1939Dm1Failrs_as[63].dtc_as[18].occ_u8 "" UBYTE CnvRule_NumberOneToOne 1 0 0 255 ECU_ADDRESS 0x700177C5 /end MEASUREMENT
/begin MEASUREMENT dataJ1939Dm1Failrs_as[63].dtc_as[19].spn_u32 "" ULONG CnvRule_NumberOneToOne 1 0 0 4294967295 ECU_ADDRESS 0x700177C8 /end MEASUREMENT
/begin MEASUREMENT dataJ1939Dm1Failrs_as[63].dtc_as[19].fmi_u8 "" UBYTE CnvRule_NumberOneToOne 1 0 0 255 ECU_ADDRESS 0x700177CC /end MEASUREMENT
/begin MEASUREMENT dataJ1939Dm1Failrs_as[63].dtc_as[19].occ_u8 "" UBYTE CnvRule_NumberOneToOne 1 0 0 255 ECU_ADDRESS 0x700177CD /end MEASUREMENT
/begin MEASUREMENT dataJ1939Dm1Failrs_as[63].dtc_as[20].spn_u32 "" ULONG CnvRule_NumberOneToOne 1 0 0 4294967295 ECU_ADDRESS 0x700177D0 /end MEASUREMENT
/begin MEASUREMENT dataJ1939Dm1Failrs_as[63].dtc_as[20].fmi_u8 "" UBYTE CnvRule_NumberOneToOne 1 0 0 255 ECU_ADDRESS 0x700177D4 /end MEASUREMENT
/begin MEASUREMENT dataJ1939Dm1Failrs_as[63].dtc_as[20].occ_u8 "" UBYTE CnvRule_NumberOneToOne 1 0 0 255 ECU_ADDRESS 0x700177D5 /end MEASUREMENT
/begin MEASUREMENT dataJ1939Dm1Failrs_as[63].dtc_as "" UBYTE CnvRule_NumberOneToOne 1 0 0 255 ECU_ADDRESS 0x70017738 ARRAY_SIZE 160 /end MEASUREMENT
/begin MEASUREMENT dataJ1939Dm1Failrs_as[64].dtc_as[1].spn_u32 "" ULONG CnvRule_NumberOneToOne 1 0 0 4294967295 ECU_ADDRESS 0x700177DC /end MEASUREMENT
/begin MEASUREMENT dataJ1939Dm1Failrs_as[64].dtc_as[1].fmi_u8 "" UBYTE CnvRule_NumberOneToOne 1 0 0 255 ECU_ADDRESS 0x700177E0 /end MEASUREMENT
/begin MEASUREMENT dataJ1939Dm1Failrs_as[64].dtc_as[1].occ_u8 "" UBYTE CnvRule_NumberOneToOne 1 0 0 255 ECU_ADDRESS 0x700177E1 /end MEASUREMENT
/begin MEASUREMENT dataJ1939Dm1Failrs_as[64].dtc_as[2].spn_u32 "" ULONG CnvRule_NumberOneToOne 1 0 0 4294967295 ECU_ADDRESS 0x700177E4 /end MEASUREMENT
/begin MEASUREMENT dataJ1939Dm1Failrs_as[64].dtc_as[2].fmi_u8 "" UBYTE CnvRule_NumberOneToOne 1 0 0 255 ECU_ADDRESS 0x700177E8 /end MEASUREMENT
/begin MEASUREMENT dataJ1939Dm1Failrs_as[64].dtc_as[2].occ_u8 "" UBYTE CnvRule_NumberOneToOne 1 0 0 255 ECU_ADDRESS 0x700177E9 /end MEASUREMENT
/begin MEASUREMENT dataJ1939Dm1Failrs_as[64].dtc_as[3].spn_u32 "" ULONG CnvRule_NumberOneToOne 1 0 0 4294967295 ECU_ADDRESS 0x700177EC /end MEASUREMENT
/begin MEASUREMENT dataJ1939Dm1Failrs_as[64].dtc_as[3].fmi_u8 "" UBYTE CnvRule_NumberOneToOne 1 0 0 255 ECU_ADDRESS 0x700177F0 /end MEASUREMENT
/begin MEASUREMENT dataJ1939Dm1Failrs_as[64].dtc_as[3].occ_u8 "" UBYTE CnvRule_NumberOneToOne 1 0 0 255 ECU_ADDRESS 0x700177F1 /end MEASUREMENT
/begin MEASUREMENT dataJ1939Dm1Failrs_as[64].dtc_as[4].spn_u32 "" ULONG CnvRule_NumberOneToOne 1 0 0 4294967295 ECU_ADDRESS 0x700177F4 /end MEASUREMENT
/begin MEASUREMENT dataJ1939Dm1Failrs_as[64].dtc_as[4].fmi_u8 "" UBYTE CnvRule_NumberOneToOne 1 0 0 255 ECU_ADDRESS 0x700177F8 /end MEASUREMENT
/begin MEASUREMENT dataJ1939Dm1Failrs_as[64].dtc_as[4].occ_u8 "" UBYTE CnvRule_NumberOneToOne 1 0 0 255 ECU_ADDRESS 0x700177F9 /end MEASUREMENT
/begin MEASUREMENT dataJ1939Dm1Failrs_as[64].dtc_as[5].spn_u32 "" ULONG CnvRule_NumberOneToOne 1 0 0 4294967295 ECU_ADDRESS 0x700177FC /end MEASUREMENT
/begin MEASUREMENT dataJ1939Dm1Failrs_as[64].dtc_as[5].fmi_u8 "" UBYTE CnvRule_NumberOneToOne 1 0 0 255 ECU_ADDRESS 0x70017800 /end MEASUREMENT
/begin MEASUREMENT dataJ1939Dm1Failrs_as[64].dtc_as[5].occ_u8 "" UBYTE CnvRule_NumberOneToOne 1 0 0 255 ECU_ADDRESS 0x70017801 /end MEASUREMENT
/begin MEASUREMENT dataJ1939Dm1Failrs_as[64].dtc_as[6].spn_u32 "" ULONG CnvRule_NumberOneToOne 1 0 0 4294967295 ECU_ADDRESS 0x70017804 /end MEASUREMENT
/begin MEASUREMENT dataJ1939Dm1Failrs_as[64].dtc_as[6].fmi_u8 "" UBYTE CnvRule_NumberOneToOne 1 0 0 255 ECU_ADDRESS 0x70017808 /end MEASUREMENT
/begin MEASUREMENT dataJ1939Dm1Failrs_as[64].dtc_as[6].occ_u8 "" UBYTE CnvRule_NumberOneToOne 1 0 0 255 ECU_ADDRESS 0x70017809 /end MEASUREMENT
/begin MEASUREMENT dataJ1939Dm1Failrs_as[64].dtc_as[7].spn_u32 "" ULONG CnvRule_NumberOneToOne 1 0 0 4294967295 ECU_ADDRESS 0x7001780C /end MEASUREMENT
/begin MEASUREMENT dataJ1939Dm1Failrs_as[64].dtc_as[7].fmi_u8 "" UBYTE CnvRule_NumberOneToOne 1 0 0 255 ECU_ADDRESS 0x70017810 /end MEASUREMENT
/begin MEASUREMENT dataJ1939Dm1Failrs_as[64].dtc_as[7].occ_u8 "" UBYTE CnvRule_NumberOneToOne 1 0 0 255 ECU_ADDRESS 0x70017811 /end MEASUREMENT
/begin MEASUREMENT dataJ1939Dm1Failrs_as[64].dtc_as[8].spn_u32 "" ULONG CnvRule_NumberOneToOne 1 0 0 4294967295 ECU_ADDRESS 0x70017814 /end MEASUREMENT
/begin MEASUREMENT dataJ1939Dm1Failrs_as[64].dtc_as[8].fmi_u8 "" UBYTE CnvRule_NumberOneToOne 1 0 0 255 ECU_ADDRESS 0x70017818 /end MEASUREMENT
/begin MEASUREMENT dataJ1939Dm1Failrs_as[64].dtc_as[8].occ_u8 "" UBYTE CnvRule_NumberOneToOne 1 0 0 255 ECU_ADDRESS 0x70017819 /end MEASUREMENT
/begin MEASUREMENT dataJ1939Dm1Failrs_as[64].dtc_as[9].spn_u32 "" ULONG CnvRule_NumberOneToOne 1 0 0 4294967295 ECU_ADDRESS 0x7001781C /end MEASUREMENT
/begin MEASUREMENT dataJ1939Dm1Failrs_as[64].dtc_as[9].fmi_u8 "" UBYTE CnvRule_NumberOneToOne 1 0 0 255 ECU_ADDRESS 0x70017820 /end MEASUREMENT
/begin MEASUREMENT dataJ1939Dm1Failrs_as[64].dtc_as[9].occ_u8 "" UBYTE CnvRule_NumberOneToOne 1 0 0 255 ECU_ADDRESS 0x70017821 /end MEASUREMENT
/begin MEASUREMENT dataJ1939Dm1Failrs_as[64].dtc_as[10].spn_u32 "" ULONG CnvRule_NumberOneToOne 1 0 0 4294967295 ECU_ADDRESS 0x70017824 /end MEASUREMENT
/begin MEASUREMENT dataJ1939Dm1Failrs_as[64].dtc_as[10].fmi_u8 "" UBYTE CnvRule_NumberOneToOne 1 0 0 255 ECU_ADDRESS 0x70017828 /end MEASUREMENT
/begin MEASUREMENT dataJ1939Dm1Failrs_as[64].dtc_as[10].occ_u8 "" UBYTE CnvRule_NumberOneToOne 1 0 0 255 ECU_ADDRESS 0x70017829 /end MEASUREMENT
/begin MEASUREMENT dataJ1939Dm1Failrs_as[64].dtc_as[11].spn_u32 "" ULONG CnvRule_NumberOneToOne 1 0 0 4294967295 ECU_ADDRESS 0x7001782C /end MEASUREMENT
/begin MEASUREMENT dataJ1939Dm1Failrs_as[64].dtc_as[11].fmi_u8 "" UBYTE CnvRule_NumberOneToOne 1 0 0 255 ECU_ADDRESS 0x70017830 /end MEASUREMENT
/begin MEASUREMENT dataJ1939Dm1Failrs_as[64].dtc_as[11].occ_u8 "" UBYTE CnvRule_NumberOneToOne 1 0 0 255 ECU_ADDRESS 0x70017831 /end MEASUREMENT
/begin MEASUREMENT dataJ1939Dm1Failrs_as[64].dtc_as[12].spn_u32 "" ULONG CnvRule_NumberOneToOne 1 0 0 4294967295 ECU_ADDRESS 0x70017834 /end MEASUREMENT
/begin MEASUREMENT dataJ1939Dm1Failrs_as[64].dtc_as[12].fmi_u8 "" UBYTE CnvRule_NumberOneToOne 1 0 0 255 ECU_ADDRESS 0x70017838 /end MEASUREMENT
/begin MEASUREMENT dataJ1939Dm1Failrs_as[64].dtc_as[12].occ_u8 "" UBYTE CnvRule_NumberOneToOne 1 0 0 255 ECU_ADDRESS 0x70017839 /end MEASUREMENT
/begin MEASUREMENT dataJ1939Dm1Failrs_as[64].dtc_as[13].spn_u32 "" ULONG CnvRule_NumberOneToOne 1 0 0 4294967295 ECU_ADDRESS 0x7001783C /end MEASUREMENT
/begin MEASUREMENT dataJ1939Dm1Failrs_as[64].dtc_as[13].fmi_u8 "" UBYTE CnvRule_NumberOneToOne 1 0 0 255 ECU_ADDRESS 0x70017840 /end MEASUREMENT
/begin MEASUREMENT dataJ1939Dm1Failrs_as[64].dtc_as[13].occ_u8 "" UBYTE CnvRule_NumberOneToOne 1 0 0 255 ECU_ADDRESS 0x70017841 /end MEASUREMENT
/begin MEASUREMENT dataJ1939Dm1Failrs_as[64].dtc_as[14].spn_u32 "" ULONG CnvRule_NumberOneToOne 1 0 0 4294967295 ECU_ADDRESS 0x70017844 /end MEASUREMENT
/begin MEASUREMENT dataJ1939Dm1Failrs_as[64].dtc_as[14].fmi_u8 "" UBYTE CnvRule_NumberOneToOne 1 0 0 255 ECU_ADDRESS 0x70017848 /end MEASUREMENT
/begin MEASUREMENT dataJ1939Dm1Failrs_as[64].dtc_as[14].occ_u8 "" UBYTE CnvRule_NumberOneToOne 1 0 0 255 ECU_ADDRESS 0x70017849 /end MEASUREMENT
/begin MEASUREMENT dataJ1939Dm1Failrs_as[64].dtc_as[15].spn_u32 "" ULONG CnvRule_NumberOneToOne 1 0 0 4294967295 ECU_ADDRESS 0x7001784C /end MEASUREMENT
/begin MEASUREMENT dataJ1939Dm1Failrs_as[64].dtc_as[15].fmi_u8 "" UBYTE CnvRule_NumberOneToOne 1 0 0 255 ECU_ADDRESS 0x70017850 /end MEASUREMENT
/begin MEASUREMENT dataJ1939Dm1Failrs_as[64].dtc_as[15].occ_u8 "" UBYTE CnvRule_NumberOneToOne 1 0 0 255 ECU_ADDRESS 0x70017851 /end MEASUREMENT
/begin MEASUREMENT dataJ1939Dm1Failrs_as[64].dtc_as[16].spn_u32 "" ULONG CnvRule_NumberOneToOne 1 0 0 4294967295 ECU_ADDRESS 0x70017854 /end MEASUREMENT
/begin MEASUREMENT dataJ1939Dm1Failrs_as[64].dtc_as[16].fmi_u8 "" UBYTE CnvRule_NumberOneToOne 1 0 0 255 ECU_ADDRESS 0x70017858 /end MEASUREMENT
/begin MEASUREMENT dataJ1939Dm1Failrs_as[64].dtc_as[16].occ_u8 "" UBYTE CnvRule_NumberOneToOne 1 0 0 255 ECU_ADDRESS 0x70017859 /end MEASUREMENT
/begin MEASUREMENT dataJ1939Dm1Failrs_as[64].dtc_as[17].spn_u32 "" ULONG CnvRule_NumberOneToOne 1 0 0 4294967295 ECU_ADDRESS 0x7001785C /end MEASUREMENT
/begin MEASUREMENT dataJ1939Dm1Failrs_as[64].dtc_as[17].fmi_u8 "" UBYTE CnvRule_NumberOneToOne 1 0 0 255 ECU_ADDRESS 0x70017860 /end MEASUREMENT
/begin MEASUREMENT dataJ1939Dm1Failrs_as[64].dtc_as[17].occ_u8 "" UBYTE CnvRule_NumberOneToOne 1 0 0 255 ECU_ADDRESS 0x70017861 /end MEASUREMENT
/begin MEASUREMENT dataJ1939Dm1Failrs_as[64].dtc_as[18].spn_u32 "" ULONG CnvRule_NumberOneToOne 1 0 0 4294967295 ECU_ADDRESS 0x70017864 /end MEASUREMENT
/begin MEASUREMENT dataJ1939Dm1Failrs_as[64].dtc_as[18].fmi_u8 "" UBYTE CnvRule_NumberOneToOne 1 0 0 255 ECU_ADDRESS 0x70017868 /end MEASUREMENT
/begin MEASUREMENT dataJ1939Dm1Failrs_as[64].dtc_as[18].occ_u8 "" UBYTE CnvRule_NumberOneToOne 1 0 0 255 ECU_ADDRESS 0x70017869 /end MEASUREMENT
/begin MEASUREMENT dataJ1939Dm1Failrs_as[64].dtc_as[19].spn_u32 "" ULONG CnvRule_NumberOneToOne 1 0 0 4294967295 ECU_ADDRESS 0x7001786C /end MEASUREMENT
/begin MEASUREMENT dataJ1939Dm1Failrs_as[64].dtc_as[19].fmi_u8 "" UBYTE CnvRule_NumberOneToOne 1 0 0 255 ECU_ADDRESS 0x70017870 /end MEASUREMENT
/begin MEASUREMENT dataJ1939Dm1Failrs_as[64].dtc_as[19].occ_u8 "" UBYTE CnvRule_NumberOneToOne 1 0 0 255 ECU_ADDRESS 0x70017871 /end MEASUREMENT
/begin MEASUREMENT dataJ1939Dm1Failrs_as[64].dtc_as[20].spn_u32 "" ULONG CnvRule_NumberOneToOne 1 0 0 4294967295 ECU_ADDRESS 0x70017874 /end MEASUREMENT
/begin MEASUREMENT dataJ1939Dm1Failrs_as[64].dtc_as[20].fmi_u8 "" UBYTE CnvRule_NumberOneToOne 1 0 0 255 ECU_ADDRESS 0x70017878 /end MEASUREMENT
/begin MEASUREMENT dataJ1939Dm1Failrs_as[64].dtc_as[20].occ_u8 "" UBYTE CnvRule_NumberOneToOne 1 0 0 255 ECU_ADDRESS 0x70017879 /end MEASUREMENT
/begin MEASUREMENT dataJ1939Dm1Failrs_as[64].dtc_as "" UBYTE CnvRule_NumberOneToOne 1 0 0 255 ECU_ADDRESS 0x700177DC ARRAY_SIZE 160 /end MEASUREMENT
/begin MEASUREMENT dataJ1939Dm1Failrs_as[65].dtc_as[1].spn_u32 "" ULONG CnvRule_NumberOneToOne 1 0 0 4294967295 ECU_ADDRESS 0x70017880 /end MEASUREMENT
/begin MEASUREMENT dataJ1939Dm1Failrs_as[65].dtc_as[1].fmi_u8 "" UBYTE CnvRule_NumberOneToOne 1 0 0 255 ECU_ADDRESS 0x70017884 /end MEASUREMENT
/begin MEASUREMENT dataJ1939Dm1Failrs_as[65].dtc_as[1].occ_u8 "" UBYTE CnvRule_NumberOneToOne 1 0 0 255 ECU_ADDRESS 0x70017885 /end MEASUREMENT
/begin MEASUREMENT dataJ1939Dm1Failrs_as[65].dtc_as[2].spn_u32 "" ULONG CnvRule_NumberOneToOne 1 0 0 4294967295 ECU_ADDRESS 0x70017888 /end MEASUREMENT
/begin MEASUREMENT dataJ1939Dm1Failrs_as[65].dtc_as[2].fmi_u8 "" UBYTE CnvRule_NumberOneToOne 1 0 0 255 ECU_ADDRESS 0x7001788C /end MEASUREMENT
/begin MEASUREMENT dataJ1939Dm1Failrs_as[65].dtc_as[2].occ_u8 "" UBYTE CnvRule_NumberOneToOne 1 0 0 255 ECU_ADDRESS 0x7001788D /end MEASUREMENT
/begin MEASUREMENT dataJ1939Dm1Failrs_as[65].dtc_as[3].spn_u32 "" ULONG CnvRule_NumberOneToOne 1 0 0 4294967295 ECU_ADDRESS 0x70017890 /end MEASUREMENT
/begin MEASUREMENT dataJ1939Dm1Failrs_as[65].dtc_as[3].fmi_u8 "" UBYTE CnvRule_NumberOneToOne 1 0 0 255 ECU_ADDRESS 0x70017894 /end MEASUREMENT
/begin MEASUREMENT dataJ1939Dm1Failrs_as[65].dtc_as[3].occ_u8 "" UBYTE CnvRule_NumberOneToOne 1 0 0 255 ECU_ADDRESS 0x70017895 /end MEASUREMENT
/begin MEASUREMENT dataJ1939Dm1Failrs_as[65].dtc_as[4].spn_u32 "" ULONG CnvRule_NumberOneToOne 1 0 0 4294967295 ECU_ADDRESS 0x70017898 /end MEASUREMENT
/begin MEASUREMENT dataJ1939Dm1Failrs_as[65].dtc_as[4].fmi_u8 "" UBYTE CnvRule_NumberOneToOne 1 0 0 255 ECU_ADDRESS 0x7001789C /end MEASUREMENT
/begin MEASUREMENT dataJ1939Dm1Failrs_as[65].dtc_as[4].occ_u8 "" UBYTE CnvRule_NumberOneToOne 1 0 0 255 ECU_ADDRESS 0x7001789D /end MEASUREMENT
/begin MEASUREMENT dataJ1939Dm1Failrs_as[65].dtc_as[5].spn_u32 "" ULONG CnvRule_NumberOneToOne 1 0 0 4294967295 ECU_ADDRESS 0x700178A0 /end MEASUREMENT
/begin MEASUREMENT dataJ1939Dm1Failrs_as[65].dtc_as[5].fmi_u8 "" UBYTE CnvRule_NumberOneToOne 1 0 0 255 ECU_ADDRESS 0x700178A4 /end MEASUREMENT
/begin MEASUREMENT dataJ1939Dm1Failrs_as[65].dtc_as[5].occ_u8 "" UBYTE CnvRule_NumberOneToOne 1 0 0 255 ECU_ADDRESS 0x700178A5 /end MEASUREMENT
/begin MEASUREMENT dataJ1939Dm1Failrs_as[65].dtc_as[6].spn_u32 "" ULONG CnvRule_NumberOneToOne 1 0 0 4294967295 ECU_ADDRESS 0x700178A8 /end MEASUREMENT
/begin MEASUREMENT dataJ1939Dm1Failrs_as[65].dtc_as[6].fmi_u8 "" UBYTE CnvRule_NumberOneToOne 1 0 0 255 ECU_ADDRESS 0x700178AC /end MEASUREMENT
/begin MEASUREMENT dataJ1939Dm1Failrs_as[65].dtc_as[6].occ_u8 "" UBYTE CnvRule_NumberOneToOne 1 0 0 255 ECU_ADDRESS 0x700178AD /end MEASUREMENT
/begin MEASUREMENT dataJ1939Dm1Failrs_as[65].dtc_as[7].spn_u32 "" ULONG CnvRule_NumberOneToOne 1 0 0 4294967295 ECU_ADDRESS 0x700178B0 /end MEASUREMENT
/begin MEASUREMENT dataJ1939Dm1Failrs_as[65].dtc_as[7].fmi_u8 "" UBYTE CnvRule_NumberOneToOne 1 0 0 255 ECU_ADDRESS 0x700178B4 /end MEASUREMENT
/begin MEASUREMENT dataJ1939Dm1Failrs_as[65].dtc_as[7].occ_u8 "" UBYTE CnvRule_NumberOneToOne 1 0 0 255 ECU_ADDRESS 0x700178B5 /end MEASUREMENT
/begin MEASUREMENT dataJ1939Dm1Failrs_as[65].dtc_as[8].spn_u32 "" ULONG CnvRule_NumberOneToOne 1 0 0 4294967295 ECU_ADDRESS 0x700178B8 /end MEASUREMENT
/begin MEASUREMENT dataJ1939Dm1Failrs_as[65].dtc_as[8].fmi_u8 "" UBYTE CnvRule_NumberOneToOne 1 0 0 255 ECU_ADDRESS 0x700178BC /end MEASUREMENT
/begin MEASUREMENT dataJ1939Dm1Failrs_as[65].dtc_as[8].occ_u8 "" UBYTE CnvRule_NumberOneToOne 1 0 0 255 ECU_ADDRESS 0x700178BD /end MEASUREMENT
/begin MEASUREMENT dataJ1939Dm1Failrs_as[65].dtc_as[9].spn_u32 "" ULONG CnvRule_NumberOneToOne 1 0 0 4294967295 ECU_ADDRESS 0x700178C0 /end MEASUREMENT
/begin MEASUREMENT dataJ1939Dm1Failrs_as[65].dtc_as[9].fmi_u8 "" UBYTE CnvRule_NumberOneToOne 1 0 0 255 ECU_ADDRESS 0x700178C4 /end MEASUREMENT
/begin MEASUREMENT dataJ1939Dm1Failrs_as[65].dtc_as[9].occ_u8 "" UBYTE CnvRule_NumberOneToOne 1 0 0 255 ECU_ADDRESS 0x700178C5 /end MEASUREMENT
/begin MEASUREMENT dataJ1939Dm1Failrs_as[65].dtc_as[10].spn_u32 "" ULONG CnvRule_NumberOneToOne 1 0 0 4294967295 ECU_ADDRESS 0x700178C8 /end MEASUREMENT
/begin MEASUREMENT dataJ1939Dm1Failrs_as[65].dtc_as[10].fmi_u8 "" UBYTE CnvRule_NumberOneToOne 1 0 0 255 ECU_ADDRESS 0x700178CC /end MEASUREMENT
/begin MEASUREMENT dataJ1939Dm1Failrs_as[65].dtc_as[10].occ_u8 "" UBYTE CnvRule_NumberOneToOne 1 0 0 255 ECU_ADDRESS 0x700178CD /end MEASUREMENT
/begin MEASUREMENT dataJ1939Dm1Failrs_as[65].dtc_as[11].spn_u32 "" ULONG CnvRule_NumberOneToOne 1 0 0 4294967295 ECU_ADDRESS 0x700178D0 /end MEASUREMENT
/begin MEASUREMENT dataJ1939Dm1Failrs_as[65].dtc_as[11].fmi_u8 "" UBYTE CnvRule_NumberOneToOne 1 0 0 255 ECU_ADDRESS 0x700178D4 /end MEASUREMENT
/begin MEASUREMENT dataJ1939Dm1Failrs_as[65].dtc_as[11].occ_u8 "" UBYTE CnvRule_NumberOneToOne 1 0 0 255 ECU_ADDRESS 0x700178D5 /end MEASUREMENT
/begin MEASUREMENT dataJ1939Dm1Failrs_as[65].dtc_as[12].spn_u32 "" ULONG CnvRule_NumberOneToOne 1 0 0 4294967295 ECU_ADDRESS 0x700178D8 /end MEASUREMENT
/begin MEASUREMENT dataJ1939Dm1Failrs_as[65].dtc_as[12].fmi_u8 "" UBYTE CnvRule_NumberOneToOne 1 0 0 255 ECU_ADDRESS 0x700178DC /end MEASUREMENT
/begin MEASUREMENT dataJ1939Dm1Failrs_as[65].dtc_as[12].occ_u8 "" UBYTE CnvRule_NumberOneToOne 1 0 0 255 ECU_ADDRESS 0x700178DD /end MEASUREMENT
/begin MEASUREMENT dataJ1939Dm1Failrs_as[65].dtc_as[13].spn_u32 "" ULONG CnvRule_NumberOneToOne 1 0 0 4294967295 ECU_ADDRESS 0x700178E0 /end MEASUREMENT
/begin MEASUREMENT dataJ1939Dm1Failrs_as[65].dtc_as[13].fmi_u8 "" UBYTE CnvRule_NumberOneToOne 1 0 0 255 ECU_ADDRESS 0x700178E4 /end MEASUREMENT
/begin MEASUREMENT dataJ1939Dm1Failrs_as[65].dtc_as[13].occ_u8 "" UBYTE CnvRule_NumberOneToOne 1 0 0 255 ECU_ADDRESS 0x700178E5 /end MEASUREMENT
/begin MEASUREMENT dataJ1939Dm1Failrs_as[65].dtc_as[14].spn_u32 "" ULONG CnvRule_NumberOneToOne 1 0 0 4294967295 ECU_ADDRESS 0x700178E8 /end MEASUREMENT
/begin MEASUREMENT dataJ1939Dm1Failrs_as[65].dtc_as[14].fmi_u8 "" UBYTE CnvRule_NumberOneToOne 1 0 0 255 ECU_ADDRESS 0x700178EC /end MEASUREMENT
/begin MEASUREMENT dataJ1939Dm1Failrs_as[65].dtc_as[14].occ_u8 "" UBYTE CnvRule_NumberOneToOne 1 0 0 255 ECU_ADDRESS 0x700178ED /end MEASUREMENT
/begin MEASUREMENT dataJ1939Dm1Failrs_as[65].dtc_as[15].spn_u32 "" ULONG CnvRule_NumberOneToOne 1 0 0 4294967295 ECU_ADDRESS 0x700178F0 /end MEASUREMENT
/begin MEASUREMENT dataJ1939Dm1Failrs_as[65].dtc_as[15].fmi_u8 "" UBYTE CnvRule_NumberOneToOne 1 0 0 255 ECU_ADDRESS 0x700178F4 /end MEASUREMENT
/begin MEASUREMENT dataJ1939Dm1Failrs_as[65].dtc_as[15].occ_u8 "" UBYTE CnvRule_NumberOneToOne 1 0 0 255 ECU_ADDRESS 0x700178F5 /end MEASUREMENT
/begin MEASUREMENT dataJ1939Dm1Failrs_as[65].dtc_as[16].spn_u32 "" ULONG CnvRule_NumberOneToOne 1 0 0 4294967295 ECU_ADDRESS 0x700178F8 /end MEASUREMENT
/begin MEASUREMENT dataJ1939Dm1Failrs_as[65].dtc_as[16].fmi_u8 "" UBYTE CnvRule_NumberOneToOne 1 0 0 255 ECU_ADDRESS 0x700178FC /end MEASUREMENT
/begin MEASUREMENT dataJ1939Dm1Failrs_as[65].dtc_as[16].occ_u8 "" UBYTE CnvRule_NumberOneToOne 1 0 0 255 ECU_ADDRESS 0x700178FD /end MEASUREMENT
/begin MEASUREMENT dataJ1939Dm1Failrs_as[65].dtc_as[17].spn_u32 "" ULONG CnvRule_NumberOneToOne 1 0 0 4294967295 ECU_ADDRESS 0x70017900 /end MEASUREMENT
/begin MEASUREMENT dataJ1939Dm1Failrs_as[65].dtc_as[17].fmi_u8 "" UBYTE CnvRule_NumberOneToOne 1 0 0 255 ECU_ADDRESS 0x70017904 /end MEASUREMENT
/begin MEASUREMENT dataJ1939Dm1Failrs_as[65].dtc_as[17].occ_u8 "" UBYTE CnvRule_NumberOneToOne 1 0 0 255 ECU_ADDRESS 0x70017905 /end MEASUREMENT
/begin MEASUREMENT dataJ1939Dm1Failrs_as[65].dtc_as[18].spn_u32 "" ULONG CnvRule_NumberOneToOne 1 0 0 4294967295 ECU_ADDRESS 0x70017908 /end MEASUREMENT
/begin MEASUREMENT dataJ1939Dm1Failrs_as[65].dtc_as[18].fmi_u8 "" UBYTE CnvRule_NumberOneToOne 1 0 0 255 ECU_ADDRESS 0x7001790C /end MEASUREMENT
/begin MEASUREMENT dataJ1939Dm1Failrs_as[65].dtc_as[18].occ_u8 "" UBYTE CnvRule_NumberOneToOne 1 0 0 255 ECU_ADDRESS 0x7001790D /end MEASUREMENT
/begin MEASUREMENT dataJ1939Dm1Failrs_as[65].dtc_as[19].spn_u32 "" ULONG CnvRule_NumberOneToOne 1 0 0 4294967295 ECU_ADDRESS 0x70017910 /end MEASUREMENT
/begin MEASUREMENT dataJ1939Dm1Failrs_as[65].dtc_as[19].fmi_u8 "" UBYTE CnvRule_NumberOneToOne 1 0 0 255 ECU_ADDRESS 0x70017914 /end MEASUREMENT
/begin MEASUREMENT dataJ1939Dm1Failrs_as[65].dtc_as[19].occ_u8 "" UBYTE CnvRule_NumberOneToOne 1 0 0 255 ECU_ADDRESS 0x70017915 /end MEASUREMENT
/begin MEASUREMENT dataJ1939Dm1Failrs_as[65].dtc_as[20].spn_u32 "" ULONG CnvRule_NumberOneToOne 1 0 0 4294967295 ECU_ADDRESS 0x70017918 /end MEASUREMENT
/begin MEASUREMENT dataJ1939Dm1Failrs_as[65].dtc_as[20].fmi_u8 "" UBYTE CnvRule_NumberOneToOne 1 0 0 255 ECU_ADDRESS 0x7001791C /end MEASUREMENT
/begin MEASUREMENT dataJ1939Dm1Failrs_as[65].dtc_as[20].occ_u8 "" UBYTE CnvRule_NumberOneToOne 1 0 0 255 ECU_ADDRESS 0x7001791D /end MEASUREMENT
/begin MEASUREMENT dataJ1939Dm1Failrs_as[65].dtc_as "" UBYTE CnvRule_NumberOneToOne 1 0 0 255 ECU_ADDRESS 0x70017880 ARRAY_SIZE 160 /end MEASUREMENT
/begin MEASUREMENT dataJ1939Dm1Failrs_as[66].dtc_as[1].spn_u32 "" ULONG CnvRule_NumberOneToOne 1 0 0 4294967295 ECU_ADDRESS 0x70017924 /end MEASUREMENT
/begin MEASUREMENT dataJ1939Dm1Failrs_as[66].dtc_as[1].fmi_u8 "" UBYTE CnvRule_NumberOneToOne 1 0 0 255 ECU_ADDRESS 0x70017928 /end MEASUREMENT
/begin MEASUREMENT dataJ1939Dm1Failrs_as[66].dtc_as[1].occ_u8 "" UBYTE CnvRule_NumberOneToOne 1 0 0 255 ECU_ADDRESS 0x70017929 /end MEASUREMENT
/begin MEASUREMENT dataJ1939Dm1Failrs_as[66].dtc_as[2].spn_u32 "" ULONG CnvRule_NumberOneToOne 1 0 0 4294967295 ECU_ADDRESS 0x7001792C /end MEASUREMENT
/begin MEASUREMENT dataJ1939Dm1Failrs_as[66].dtc_as[2].fmi_u8 "" UBYTE CnvRule_NumberOneToOne 1 0 0 255 ECU_ADDRESS 0x70017930 /end MEASUREMENT
/begin MEASUREMENT dataJ1939Dm1Failrs_as[66].dtc_as[2].occ_u8 "" UBYTE CnvRule_NumberOneToOne 1 0 0 255 ECU_ADDRESS 0x70017931 /end MEASUREMENT
/begin MEASUREMENT dataJ1939Dm1Failrs_as[66].dtc_as[3].spn_u32 "" ULONG CnvRule_NumberOneToOne 1 0 0 4294967295 ECU_ADDRESS 0x70017934 /end MEASUREMENT
/begin MEASUREMENT dataJ1939Dm1Failrs_as[66].dtc_as[3].fmi_u8 "" UBYTE CnvRule_NumberOneToOne 1 0 0 255 ECU_ADDRESS 0x70017938 /end MEASUREMENT
/begin MEASUREMENT dataJ1939Dm1Failrs_as[66].dtc_as[3].occ_u8 "" UBYTE CnvRule_NumberOneToOne 1 0 0 255 ECU_ADDRESS 0x70017939 /end MEASUREMENT
/begin MEASUREMENT dataJ1939Dm1Failrs_as[66].dtc_as[4].spn_u32 "" ULONG CnvRule_NumberOneToOne 1 0 0 4294967295 ECU_ADDRESS 0x7001793C /end MEASUREMENT
/begin MEASUREMENT dataJ1939Dm1Failrs_as[66].dtc_as[4].fmi_u8 "" UBYTE CnvRule_NumberOneToOne 1 0 0 255 ECU_ADDRESS 0x70017940 /end MEASUREMENT
/begin MEASUREMENT dataJ1939Dm1Failrs_as[66].dtc_as[4].occ_u8 "" UBYTE CnvRule_NumberOneToOne 1 0 0 255 ECU_ADDRESS 0x70017941 /end MEASUREMENT
/begin MEASUREMENT dataJ1939Dm1Failrs_as[66].dtc_as[5].spn_u32 "" ULONG CnvRule_NumberOneToOne 1 0 0 4294967295 ECU_ADDRESS 0x70017944 /end MEASUREMENT
/begin MEASUREMENT dataJ1939Dm1Failrs_as[66].dtc_as[5].fmi_u8 "" UBYTE CnvRule_NumberOneToOne 1 0 0 255 ECU_ADDRESS 0x70017948 /end MEASUREMENT
/begin MEASUREMENT dataJ1939Dm1Failrs_as[66].dtc_as[5].occ_u8 "" UBYTE CnvRule_NumberOneToOne 1 0 0 255 ECU_ADDRESS 0x70017949 /end MEASUREMENT
/begin MEASUREMENT dataJ1939Dm1Failrs_as[66].dtc_as[6].spn_u32 "" ULONG CnvRule_NumberOneToOne 1 0 0 4294967295 ECU_ADDRESS 0x7001794C /end MEASUREMENT
/begin MEASUREMENT dataJ1939Dm1Failrs_as[66].dtc_as[6].fmi_u8 "" UBYTE CnvRule_NumberOneToOne 1 0 0 255 ECU_ADDRESS 0x70017950 /end MEASUREMENT
/begin MEASUREMENT dataJ1939Dm1Failrs_as[66].dtc_as[6].occ_u8 "" UBYTE CnvRule_NumberOneToOne 1 0 0 255 ECU_ADDRESS 0x70017951 /end MEASUREMENT
/begin MEASUREMENT dataJ1939Dm1Failrs_as[66].dtc_as[7].spn_u32 "" ULONG CnvRule_NumberOneToOne 1 0 0 4294967295 ECU_ADDRESS 0x70017954 /end MEASUREMENT
/begin MEASUREMENT dataJ1939Dm1Failrs_as[66].dtc_as[7].fmi_u8 "" UBYTE CnvRule_NumberOneToOne 1 0 0 255 ECU_ADDRESS 0x70017958 /end MEASUREMENT
/begin MEASUREMENT dataJ1939Dm1Failrs_as[66].dtc_as[7].occ_u8 "" UBYTE CnvRule_NumberOneToOne 1 0 0 255 ECU_ADDRESS 0x70017959 /end MEASUREMENT
/begin MEASUREMENT dataJ1939Dm1Failrs_as[66].dtc_as[8].spn_u32 "" ULONG CnvRule_NumberOneToOne 1 0 0 4294967295 ECU_ADDRESS 0x7001795C /end MEASUREMENT
/begin MEASUREMENT dataJ1939Dm1Failrs_as[66].dtc_as[8].fmi_u8 "" UBYTE CnvRule_NumberOneToOne 1 0 0 255 ECU_ADDRESS 0x70017960 /end MEASUREMENT
/begin MEASUREMENT dataJ1939Dm1Failrs_as[66].dtc_as[8].occ_u8 "" UBYTE CnvRule_NumberOneToOne 1 0 0 255 ECU_ADDRESS 0x70017961 /end MEASUREMENT
/begin MEASUREMENT dataJ1939Dm1Failrs_as[66].dtc_as[9].spn_u32 "" ULONG CnvRule_NumberOneToOne 1 0 0 4294967295 ECU_ADDRESS 0x70017964 /end MEASUREMENT
/begin MEASUREMENT dataJ1939Dm1Failrs_as[66].dtc_as[9].fmi_u8 "" UBYTE CnvRule_NumberOneToOne 1 0 0 255 ECU_ADDRESS 0x70017968 /end MEASUREMENT
/begin MEASUREMENT dataJ1939Dm1Failrs_as[66].dtc_as[9].occ_u8 "" UBYTE CnvRule_NumberOneToOne 1 0 0 255 ECU_ADDRESS 0x70017969 /end MEASUREMENT
/begin MEASUREMENT dataJ1939Dm1Failrs_as[66].dtc_as[10].spn_u32 "" ULONG CnvRule_NumberOneToOne 1 0 0 4294967295 ECU_ADDRESS 0x7001796C /end MEASUREMENT
/begin MEASUREMENT dataJ1939Dm1Failrs_as[66].dtc_as[10].fmi_u8 "" UBYTE CnvRule_NumberOneToOne 1 0 0 255 ECU_ADDRESS 0x70017970 /end MEASUREMENT
/begin MEASUREMENT dataJ1939Dm1Failrs_as[66].dtc_as[10].occ_u8 "" UBYTE CnvRule_NumberOneToOne 1 0 0 255 ECU_ADDRESS 0x70017971 /end MEASUREMENT
/begin MEASUREMENT dataJ1939Dm1Failrs_as[66].dtc_as[11].spn_u32 "" ULONG CnvRule_NumberOneToOne 1 0 0 4294967295 ECU_ADDRESS 0x70017974 /end MEASUREMENT
/begin MEASUREMENT dataJ1939Dm1Failrs_as[66].dtc_as[11].fmi_u8 "" UBYTE CnvRule_NumberOneToOne 1 0 0 255 ECU_ADDRESS 0x70017978 /end MEASUREMENT
/begin MEASUREMENT dataJ1939Dm1Failrs_as[66].dtc_as[11].occ_u8 "" UBYTE CnvRule_NumberOneToOne 1 0 0 255 ECU_ADDRESS 0x70017979 /end MEASUREMENT
/begin MEASUREMENT dataJ1939Dm1Failrs_as[66].dtc_as[12].spn_u32 "" ULONG CnvRule_NumberOneToOne 1 0 0 4294967295 ECU_ADDRESS 0x7001797C /end MEASUREMENT
/begin MEASUREMENT dataJ1939Dm1Failrs_as[66].dtc_as[12].fmi_u8 "" UBYTE CnvRule_NumberOneToOne 1 0 0 255 ECU_ADDRESS 0x70017980 /end MEASUREMENT
/begin MEASUREMENT dataJ1939Dm1Failrs_as[66].dtc_as[12].occ_u8 "" UBYTE CnvRule_NumberOneToOne 1 0 0 255 ECU_ADDRESS 0x70017981 /end MEASUREMENT
/begin MEASUREMENT dataJ1939Dm1Failrs_as[66].dtc_as[13].spn_u32 "" ULONG CnvRule_NumberOneToOne 1 0 0 4294967295 ECU_ADDRESS 0x70017984 /end MEASUREMENT
/begin MEASUREMENT dataJ1939Dm1Failrs_as[66].dtc_as[13].fmi_u8 "" UBYTE CnvRule_NumberOneToOne 1 0 0 255 ECU_ADDRESS 0x70017988 /end MEASUREMENT
/begin MEASUREMENT dataJ1939Dm1Failrs_as[66].dtc_as[13].occ_u8 "" UBYTE CnvRule_NumberOneToOne 1 0 0 255 ECU_ADDRESS 0x70017989 /end MEASUREMENT
/begin MEASUREMENT dataJ1939Dm1Failrs_as[66].dtc_as[14].spn_u32 "" ULONG CnvRule_NumberOneToOne 1 0 0 4294967295 ECU_ADDRESS 0x7001798C /end MEASUREMENT
/begin MEASUREMENT dataJ1939Dm1Failrs_as[66].dtc_as[14].fmi_u8 "" UBYTE CnvRule_NumberOneToOne 1 0 0 255 ECU_ADDRESS 0x70017990 /end MEASUREMENT
/begin MEASUREMENT dataJ1939Dm1Failrs_as[66].dtc_as[14].occ_u8 "" UBYTE CnvRule_NumberOneToOne 1 0 0 255 ECU_ADDRESS 0x70017991 /end MEASUREMENT
/begin MEASUREMENT dataJ1939Dm1Failrs_as[66].dtc_as[15].spn_u32 "" ULONG CnvRule_NumberOneToOne 1 0 0 4294967295 ECU_ADDRESS 0x70017994 /end MEASUREMENT
/begin MEASUREMENT dataJ1939Dm1Failrs_as[66].dtc_as[15].fmi_u8 "" UBYTE CnvRule_NumberOneToOne 1 0 0 255 ECU_ADDRESS 0x70017998 /end MEASUREMENT
/begin MEASUREMENT dataJ1939Dm1Failrs_as[66].dtc_as[15].occ_u8 "" UBYTE CnvRule_NumberOneToOne 1 0 0 255 ECU_ADDRESS 0x70017999 /end MEASUREMENT
/begin MEASUREMENT dataJ1939Dm1Failrs_as[66].dtc_as[16].spn_u32 "" ULONG CnvRule_NumberOneToOne 1 0 0 4294967295 ECU_ADDRESS 0x7001799C /end MEASUREMENT
/begin MEASUREMENT dataJ1939Dm1Failrs_as[66].dtc_as[16].fmi_u8 "" UBYTE CnvRule_NumberOneToOne 1 0 0 255 ECU_ADDRESS 0x700179A0 /end MEASUREMENT
/begin MEASUREMENT dataJ1939Dm1Failrs_as[66].dtc_as[16].occ_u8 "" UBYTE CnvRule_NumberOneToOne 1 0 0 255 ECU_ADDRESS 0x700179A1 /end MEASUREMENT
/begin MEASUREMENT dataJ1939Dm1Failrs_as[66].dtc_as[17].spn_u32 "" ULONG CnvRule_NumberOneToOne 1 0 0 4294967295 ECU_ADDRESS 0x700179A4 /end MEASUREMENT
/begin MEASUREMENT dataJ1939Dm1Failrs_as[66].dtc_as[17].fmi_u8 "" UBYTE CnvRule_NumberOneToOne 1 0 0 255 ECU_ADDRESS 0x700179A8 /end MEASUREMENT
/begin MEASUREMENT dataJ1939Dm1Failrs_as[66].dtc_as[17].occ_u8 "" UBYTE CnvRule_NumberOneToOne 1 0 0 255 ECU_ADDRESS 0x700179A9 /end MEASUREMENT
/begin MEASUREMENT dataJ1939Dm1Failrs_as[66].dtc_as[18].spn_u32 "" ULONG CnvRule_NumberOneToOne 1 0 0 4294967295 ECU_ADDRESS 0x700179AC /end MEASUREMENT
/begin MEASUREMENT dataJ1939Dm1Failrs_as[66].dtc_as[18].fmi_u8 "" UBYTE CnvRule_NumberOneToOne 1 0 0 255 ECU_ADDRESS 0x700179B0 /end MEASUREMENT
/begin MEASUREMENT dataJ1939Dm1Failrs_as[66].dtc_as[18].occ_u8 "" UBYTE CnvRule_NumberOneToOne 1 0 0 255 ECU_ADDRESS 0x700179B1 /end MEASUREMENT
/begin MEASUREMENT dataJ1939Dm1Failrs_as[66].dtc_as[19].spn_u32 "" ULONG CnvRule_NumberOneToOne 1 0 0 4294967295 ECU_ADDRESS 0x700179B4 /end MEASUREMENT
/begin MEASUREMENT dataJ1939Dm1Failrs_as[66].dtc_as[19].fmi_u8 "" UBYTE CnvRule_NumberOneToOne 1 0 0 255 ECU_ADDRESS 0x700179B8 /end MEASUREMENT
/begin MEASUREMENT dataJ1939Dm1Failrs_as[66].dtc_as[19].occ_u8 "" UBYTE CnvRule_NumberOneToOne 1 0 0 255 ECU_ADDRESS 0x700179B9 /end MEASUREMENT
/begin MEASUREMENT dataJ1939Dm1Failrs_as[66].dtc_as[20].spn_u32 "" ULONG CnvRule_NumberOneToOne 1 0 0 4294967295 ECU_ADDRESS 0x700179BC /end MEASUREMENT
/begin MEASUREMENT dataJ1939Dm1Failrs_as[66].dtc_as[20].fmi_u8 "" UBYTE CnvRule_NumberOneToOne 1 0 0 255 ECU_ADDRESS 0x700179C0 /end MEASUREMENT
/begin MEASUREMENT dataJ1939Dm1Failrs_as[66].dtc_as[20].occ_u8 "" UBYTE CnvRule_NumberOneToOne 1 0 0 255 ECU_ADDRESS 0x700179C1 /end MEASUREMENT
/begin MEASUREMENT dataJ1939Dm1Failrs_as[66].dtc_as "" UBYTE CnvRule_NumberOneToOne 1 0 0 255 ECU_ADDRESS 0x70017924 ARRAY_SIZE 160 /end MEASUREMENT
/begin MEASUREMENT dataJ1939Dm1Failrs_as[67].dtc_as[1].spn_u32 "" ULONG CnvRule_NumberOneToOne 1 0 0 4294967295 ECU_ADDRESS 0x700179C8 /end MEASUREMENT
/begin MEASUREMENT dataJ1939Dm1Failrs_as[67].dtc_as[1].fmi_u8 "" UBYTE CnvRule_NumberOneToOne 1 0 0 255 ECU_ADDRESS 0x700179CC /end MEASUREMENT
/begin MEASUREMENT dataJ1939Dm1Failrs_as[67].dtc_as[1].occ_u8 "" UBYTE CnvRule_NumberOneToOne 1 0 0 255 ECU_ADDRESS 0x700179CD /end MEASUREMENT
/begin MEASUREMENT dataJ1939Dm1Failrs_as[67].dtc_as[2].spn_u32 "" ULONG CnvRule_NumberOneToOne 1 0 0 4294967295 ECU_ADDRESS 0x700179D0 /end MEASUREMENT
/begin MEASUREMENT dataJ1939Dm1Failrs_as[67].dtc_as[2].fmi_u8 "" UBYTE CnvRule_NumberOneToOne 1 0 0 255 ECU_ADDRESS 0x700179D4 /end MEASUREMENT
/begin MEASUREMENT dataJ1939Dm1Failrs_as[67].dtc_as[2].occ_u8 "" UBYTE CnvRule_NumberOneToOne 1 0 0 255 ECU_ADDRESS 0x700179D5 /end MEASUREMENT
/begin MEASUREMENT dataJ1939Dm1Failrs_as[67].dtc_as[3].spn_u32 "" ULONG CnvRule_NumberOneToOne 1 0 0 4294967295 ECU_ADDRESS 0x700179D8 /end MEASUREMENT
/begin MEASUREMENT dataJ1939Dm1Failrs_as[67].dtc_as[3].fmi_u8 "" UBYTE CnvRule_NumberOneToOne 1 0 0 255 ECU_ADDRESS 0x700179DC /end MEASUREMENT
/begin MEASUREMENT dataJ1939Dm1Failrs_as[67].dtc_as[3].occ_u8 "" UBYTE CnvRule_NumberOneToOne 1 0 0 255 ECU_ADDRESS 0x700179DD /end MEASUREMENT
/begin MEASUREMENT dataJ1939Dm1Failrs_as[67].dtc_as[4].spn_u32 "" ULONG CnvRule_NumberOneToOne 1 0 0 4294967295 ECU_ADDRESS 0x700179E0 /end MEASUREMENT
/begin MEASUREMENT dataJ1939Dm1Failrs_as[67].dtc_as[4].fmi_u8 "" UBYTE CnvRule_NumberOneToOne 1 0 0 255 ECU_ADDRESS 0x700179E4 /end MEASUREMENT
/begin MEASUREMENT dataJ1939Dm1Failrs_as[67].dtc_as[4].occ_u8 "" UBYTE CnvRule_NumberOneToOne 1 0 0 255 ECU_ADDRESS 0x700179E5 /end MEASUREMENT
/begin MEASUREMENT dataJ1939Dm1Failrs_as[67].dtc_as[5].spn_u32 "" ULONG CnvRule_NumberOneToOne 1 0 0 4294967295 ECU_ADDRESS 0x700179E8 /end MEASUREMENT
/begin MEASUREMENT dataJ1939Dm1Failrs_as[67].dtc_as[5].fmi_u8 "" UBYTE CnvRule_NumberOneToOne 1 0 0 255 ECU_ADDRESS 0x700179EC /end MEASUREMENT
/begin MEASUREMENT dataJ1939Dm1Failrs_as[67].dtc_as[5].occ_u8 "" UBYTE CnvRule_NumberOneToOne 1 0 0 255 ECU_ADDRESS 0x700179ED /end MEASUREMENT
/begin MEASUREMENT dataJ1939Dm1Failrs_as[67].dtc_as[6].spn_u32 "" ULONG CnvRule_NumberOneToOne 1 0 0 4294967295 ECU_ADDRESS 0x700179F0 /end MEASUREMENT
/begin MEASUREMENT dataJ1939Dm1Failrs_as[67].dtc_as[6].fmi_u8 "" UBYTE CnvRule_NumberOneToOne 1 0 0 255 ECU_ADDRESS 0x700179F4 /end MEASUREMENT
/begin MEASUREMENT dataJ1939Dm1Failrs_as[67].dtc_as[6].occ_u8 "" UBYTE CnvRule_NumberOneToOne 1 0 0 255 ECU_ADDRESS 0x700179F5 /end MEASUREMENT
/begin MEASUREMENT dataJ1939Dm1Failrs_as[67].dtc_as[7].spn_u32 "" ULONG CnvRule_NumberOneToOne 1 0 0 4294967295 ECU_ADDRESS 0x700179F8 /end MEASUREMENT
/begin MEASUREMENT dataJ1939Dm1Failrs_as[67].dtc_as[7].fmi_u8 "" UBYTE CnvRule_NumberOneToOne 1 0 0 255 ECU_ADDRESS 0x700179FC /end MEASUREMENT
/begin MEASUREMENT dataJ1939Dm1Failrs_as[67].dtc_as[7].occ_u8 "" UBYTE CnvRule_NumberOneToOne 1 0 0 255 ECU_ADDRESS 0x700179FD /end MEASUREMENT
/begin MEASUREMENT dataJ1939Dm1Failrs_as[67].dtc_as[8].spn_u32 "" ULONG CnvRule_NumberOneToOne 1 0 0 4294967295 ECU_ADDRESS 0x70017A00 /end MEASUREMENT
/begin MEASUREMENT dataJ1939Dm1Failrs_as[67].dtc_as[8].fmi_u8 "" UBYTE CnvRule_NumberOneToOne 1 0 0 255 ECU_ADDRESS 0x70017A04 /end MEASUREMENT
/begin MEASUREMENT dataJ1939Dm1Failrs_as[67].dtc_as[8].occ_u8 "" UBYTE CnvRule_NumberOneToOne 1 0 0 255 ECU_ADDRESS 0x70017A05 /end MEASUREMENT
/begin MEASUREMENT dataJ1939Dm1Failrs_as[67].dtc_as[9].spn_u32 "" ULONG CnvRule_NumberOneToOne 1 0 0 4294967295 ECU_ADDRESS 0x70017A08 /end MEASUREMENT
/begin MEASUREMENT dataJ1939Dm1Failrs_as[67].dtc_as[9].fmi_u8 "" UBYTE CnvRule_NumberOneToOne 1 0 0 255 ECU_ADDRESS 0x70017A0C /end MEASUREMENT
/begin MEASUREMENT dataJ1939Dm1Failrs_as[67].dtc_as[9].occ_u8 "" UBYTE CnvRule_NumberOneToOne 1 0 0 255 ECU_ADDRESS 0x70017A0D /end MEASUREMENT
/begin MEASUREMENT dataJ1939Dm1Failrs_as[67].dtc_as[10].spn_u32 "" ULONG CnvRule_NumberOneToOne 1 0 0 4294967295 ECU_ADDRESS 0x70017A10 /end MEASUREMENT
/begin MEASUREMENT dataJ1939Dm1Failrs_as[67].dtc_as[10].fmi_u8 "" UBYTE CnvRule_NumberOneToOne 1 0 0 255 ECU_ADDRESS 0x70017A14 /end MEASUREMENT
/begin MEASUREMENT dataJ1939Dm1Failrs_as[67].dtc_as[10].occ_u8 "" UBYTE CnvRule_NumberOneToOne 1 0 0 255 ECU_ADDRESS 0x70017A15 /end MEASUREMENT
/begin MEASUREMENT dataJ1939Dm1Failrs_as[67].dtc_as[11].spn_u32 "" ULONG CnvRule_NumberOneToOne 1 0 0 4294967295 ECU_ADDRESS 0x70017A18 /end MEASUREMENT
/begin MEASUREMENT dataJ1939Dm1Failrs_as[67].dtc_as[11].fmi_u8 "" UBYTE CnvRule_NumberOneToOne 1 0 0 255 ECU_ADDRESS 0x70017A1C /end MEASUREMENT
/begin MEASUREMENT dataJ1939Dm1Failrs_as[67].dtc_as[11].occ_u8 "" UBYTE CnvRule_NumberOneToOne 1 0 0 255 ECU_ADDRESS 0x70017A1D /end MEASUREMENT
/begin MEASUREMENT dataJ1939Dm1Failrs_as[67].dtc_as[12].spn_u32 "" ULONG CnvRule_NumberOneToOne 1 0 0 4294967295 ECU_ADDRESS 0x70017A20 /end MEASUREMENT
/begin MEASUREMENT dataJ1939Dm1Failrs_as[67].dtc_as[12].fmi_u8 "" UBYTE CnvRule_NumberOneToOne 1 0 0 255 ECU_ADDRESS 0x70017A24 /end MEASUREMENT
/begin MEASUREMENT dataJ1939Dm1Failrs_as[67].dtc_as[12].occ_u8 "" UBYTE CnvRule_NumberOneToOne 1 0 0 255 ECU_ADDRESS 0x70017A25 /end MEASUREMENT
/begin MEASUREMENT dataJ1939Dm1Failrs_as[67].dtc_as[13].spn_u32 "" ULONG CnvRule_NumberOneToOne 1 0 0 4294967295 ECU_ADDRESS 0x70017A28 /end MEASUREMENT
/begin MEASUREMENT dataJ1939Dm1Failrs_as[67].dtc_as[13].fmi_u8 "" UBYTE CnvRule_NumberOneToOne 1 0 0 255 ECU_ADDRESS 0x70017A2C /end MEASUREMENT
/begin MEASUREMENT dataJ1939Dm1Failrs_as[67].dtc_as[13].occ_u8 "" UBYTE CnvRule_NumberOneToOne 1 0 0 255 ECU_ADDRESS 0x70017A2D /end MEASUREMENT
/begin MEASUREMENT dataJ1939Dm1Failrs_as[67].dtc_as[14].spn_u32 "" ULONG CnvRule_NumberOneToOne 1 0 0 4294967295 ECU_ADDRESS 0x70017A30 /end MEASUREMENT
/begin MEASUREMENT dataJ1939Dm1Failrs_as[67].dtc_as[14].fmi_u8 "" UBYTE CnvRule_NumberOneToOne 1 0 0 255 ECU_ADDRESS 0x70017A34 /end MEASUREMENT
/begin MEASUREMENT dataJ1939Dm1Failrs_as[67].dtc_as[14].occ_u8 "" UBYTE CnvRule_NumberOneToOne 1 0 0 255 ECU_ADDRESS 0x70017A35 /end MEASUREMENT
/begin MEASUREMENT dataJ1939Dm1Failrs_as[67].dtc_as[15].spn_u32 "" ULONG CnvRule_NumberOneToOne 1 0 0 4294967295 ECU_ADDRESS 0x70017A38 /end MEASUREMENT
/begin MEASUREMENT dataJ1939Dm1Failrs_as[67].dtc_as[15].fmi_u8 "" UBYTE CnvRule_NumberOneToOne 1 0 0 255 ECU_ADDRESS 0x70017A3C /end MEASUREMENT
/begin MEASUREMENT dataJ1939Dm1Failrs_as[67].dtc_as[15].occ_u8 "" UBYTE CnvRule_NumberOneToOne 1 0 0 255 ECU_ADDRESS 0x70017A3D /end MEASUREMENT
/begin MEASUREMENT dataJ1939Dm1Failrs_as[67].dtc_as[16].spn_u32 "" ULONG CnvRule_NumberOneToOne 1 0 0 4294967295 ECU_ADDRESS 0x70017A40 /end MEASUREMENT
/begin MEASUREMENT dataJ1939Dm1Failrs_as[67].dtc_as[16].fmi_u8 "" UBYTE CnvRule_NumberOneToOne 1 0 0 255 ECU_ADDRESS 0x70017A44 /end MEASUREMENT
/begin MEASUREMENT dataJ1939Dm1Failrs_as[67].dtc_as[16].occ_u8 "" UBYTE CnvRule_NumberOneToOne 1 0 0 255 ECU_ADDRESS 0x70017A45 /end MEASUREMENT
/begin MEASUREMENT dataJ1939Dm1Failrs_as[67].dtc_as[17].spn_u32 "" ULONG CnvRule_NumberOneToOne 1 0 0 4294967295 ECU_ADDRESS 0x70017A48 /end MEASUREMENT
/begin MEASUREMENT dataJ1939Dm1Failrs_as[67].dtc_as[17].fmi_u8 "" UBYTE CnvRule_NumberOneToOne 1 0 0 255 ECU_ADDRESS 0x70017A4C /end MEASUREMENT
/begin MEASUREMENT dataJ1939Dm1Failrs_as[67].dtc_as[17].occ_u8 "" UBYTE CnvRule_NumberOneToOne 1 0 0 255 ECU_ADDRESS 0x70017A4D /end MEASUREMENT
/begin MEASUREMENT dataJ1939Dm1Failrs_as[67].dtc_as[18].spn_u32 "" ULONG CnvRule_NumberOneToOne 1 0 0 4294967295 ECU_ADDRESS 0x70017A50 /end MEASUREMENT
/begin MEASUREMENT dataJ1939Dm1Failrs_as[67].dtc_as[18].fmi_u8 "" UBYTE CnvRule_NumberOneToOne 1 0 0 255 ECU_ADDRESS 0x70017A54 /end MEASUREMENT
/begin MEASUREMENT dataJ1939Dm1Failrs_as[67].dtc_as[18].occ_u8 "" UBYTE CnvRule_NumberOneToOne 1 0 0 255 ECU_ADDRESS 0x70017A55 /end MEASUREMENT
/begin MEASUREMENT dataJ1939Dm1Failrs_as[67].dtc_as[19].spn_u32 "" ULONG CnvRule_NumberOneToOne 1 0 0 4294967295 ECU_ADDRESS 0x70017A58 /end MEASUREMENT
/begin MEASUREMENT dataJ1939Dm1Failrs_as[67].dtc_as[19].fmi_u8 "" UBYTE CnvRule_NumberOneToOne 1 0 0 255 ECU_ADDRESS 0x70017A5C /end MEASUREMENT
/begin MEASUREMENT dataJ1939Dm1Failrs_as[67].dtc_as[19].occ_u8 "" UBYTE CnvRule_NumberOneToOne 1 0 0 255 ECU_ADDRESS 0x70017A5D /end MEASUREMENT
/begin MEASUREMENT dataJ1939Dm1Failrs_as[67].dtc_as[20].spn_u32 "" ULONG CnvRule_NumberOneToOne 1 0 0 4294967295 ECU_ADDRESS 0x70017A60 /end MEASUREMENT
/begin MEASUREMENT dataJ1939Dm1Failrs_as[67].dtc_as[20].fmi_u8 "" UBYTE CnvRule_NumberOneToOne 1 0 0 255 ECU_ADDRESS 0x70017A64 /end MEASUREMENT
/begin MEASUREMENT dataJ1939Dm1Failrs_as[67].dtc_as[20].occ_u8 "" UBYTE CnvRule_NumberOneToOne 1 0 0 255 ECU_ADDRESS 0x70017A65 /end MEASUREMENT
/begin MEASUREMENT dataJ1939Dm1Failrs_as[67].dtc_as "" UBYTE CnvRule_NumberOneToOne 1 0 0 255 ECU_ADDRESS 0x700179C8 ARRAY_SIZE 160 /end MEASUREMENT
/begin MEASUREMENT dataJ1939Dm1Failrs_as[68].dtc_as[1].spn_u32 "" ULONG CnvRule_NumberOneToOne 1 0 0 4294967295 ECU_ADDRESS 0x70017A6C /end MEASUREMENT
/begin MEASUREMENT dataJ1939Dm1Failrs_as[68].dtc_as[1].fmi_u8 "" UBYTE CnvRule_NumberOneToOne 1 0 0 255 ECU_ADDRESS 0x70017A70 /end MEASUREMENT
/begin MEASUREMENT dataJ1939Dm1Failrs_as[68].dtc_as[1].occ_u8 "" UBYTE CnvRule_NumberOneToOne 1 0 0 255 ECU_ADDRESS 0x70017A71 /end MEASUREMENT
/begin MEASUREMENT dataJ1939Dm1Failrs_as[68].dtc_as[2].spn_u32 "" ULONG CnvRule_NumberOneToOne 1 0 0 4294967295 ECU_ADDRESS 0x70017A74 /end MEASUREMENT
/begin MEASUREMENT dataJ1939Dm1Failrs_as[68].dtc_as[2].fmi_u8 "" UBYTE CnvRule_NumberOneToOne 1 0 0 255 ECU_ADDRESS 0x70017A78 /end MEASUREMENT
/begin MEASUREMENT dataJ1939Dm1Failrs_as[68].dtc_as[2].occ_u8 "" UBYTE CnvRule_NumberOneToOne 1 0 0 255 ECU_ADDRESS 0x70017A79 /end MEASUREMENT
/begin MEASUREMENT dataJ1939Dm1Failrs_as[68].dtc_as[3].spn_u32 "" ULONG CnvRule_NumberOneToOne 1 0 0 4294967295 ECU_ADDRESS 0x70017A7C /end MEASUREMENT
/begin MEASUREMENT dataJ1939Dm1Failrs_as[68].dtc_as[3].fmi_u8 "" UBYTE CnvRule_NumberOneToOne 1 0 0 255 ECU_ADDRESS 0x70017A80 /end MEASUREMENT
/begin MEASUREMENT dataJ1939Dm1Failrs_as[68].dtc_as[3].occ_u8 "" UBYTE CnvRule_NumberOneToOne 1 0 0 255 ECU_ADDRESS 0x70017A81 /end MEASUREMENT
/begin MEASUREMENT dataJ1939Dm1Failrs_as[68].dtc_as[4].spn_u32 "" ULONG CnvRule_NumberOneToOne 1 0 0 4294967295 ECU_ADDRESS 0x70017A84 /end MEASUREMENT
/begin MEASUREMENT dataJ1939Dm1Failrs_as[68].dtc_as[4].fmi_u8 "" UBYTE CnvRule_NumberOneToOne 1 0 0 255 ECU_ADDRESS 0x70017A88 /end MEASUREMENT
/begin MEASUREMENT dataJ1939Dm1Failrs_as[68].dtc_as[4].occ_u8 "" UBYTE CnvRule_NumberOneToOne 1 0 0 255 ECU_ADDRESS 0x70017A89 /end MEASUREMENT
/begin MEASUREMENT dataJ1939Dm1Failrs_as[68].dtc_as[5].spn_u32 "" ULONG CnvRule_NumberOneToOne 1 0 0 4294967295 ECU_ADDRESS 0x70017A8C /end MEASUREMENT
/begin MEASUREMENT dataJ1939Dm1Failrs_as[68].dtc_as[5].fmi_u8 "" UBYTE CnvRule_NumberOneToOne 1 0 0 255 ECU_ADDRESS 0x70017A90 /end MEASUREMENT
/begin MEASUREMENT dataJ1939Dm1Failrs_as[68].dtc_as[5].occ_u8 "" UBYTE CnvRule_NumberOneToOne 1 0 0 255 ECU_ADDRESS 0x70017A91 /end MEASUREMENT
/begin MEASUREMENT dataJ1939Dm1Failrs_as[68].dtc_as[6].spn_u32 "" ULONG CnvRule_NumberOneToOne 1 0 0 4294967295 ECU_ADDRESS 0x70017A94 /end MEASUREMENT
/begin MEASUREMENT dataJ1939Dm1Failrs_as[68].dtc_as[6].fmi_u8 "" UBYTE CnvRule_NumberOneToOne 1 0 0 255 ECU_ADDRESS 0x70017A98 /end MEASUREMENT
/begin MEASUREMENT dataJ1939Dm1Failrs_as[68].dtc_as[6].occ_u8 "" UBYTE CnvRule_NumberOneToOne 1 0 0 255 ECU_ADDRESS 0x70017A99 /end MEASUREMENT
/begin MEASUREMENT dataJ1939Dm1Failrs_as[68].dtc_as[7].spn_u32 "" ULONG CnvRule_NumberOneToOne 1 0 0 4294967295 ECU_ADDRESS 0x70017A9C /end MEASUREMENT
/begin MEASUREMENT dataJ1939Dm1Failrs_as[68].dtc_as[7].fmi_u8 "" UBYTE CnvRule_NumberOneToOne 1 0 0 255 ECU_ADDRESS 0x70017AA0 /end MEASUREMENT
/begin MEASUREMENT dataJ1939Dm1Failrs_as[68].dtc_as[7].occ_u8 "" UBYTE CnvRule_NumberOneToOne 1 0 0 255 ECU_ADDRESS 0x70017AA1 /end MEASUREMENT
/begin MEASUREMENT dataJ1939Dm1Failrs_as[68].dtc_as[8].spn_u32 "" ULONG CnvRule_NumberOneToOne 1 0 0 4294967295 ECU_ADDRESS 0x70017AA4 /end MEASUREMENT
/begin MEASUREMENT dataJ1939Dm1Failrs_as[68].dtc_as[8].fmi_u8 "" UBYTE CnvRule_NumberOneToOne 1 0 0 255 ECU_ADDRESS 0x70017AA8 /end MEASUREMENT
/begin MEASUREMENT dataJ1939Dm1Failrs_as[68].dtc_as[8].occ_u8 "" UBYTE CnvRule_NumberOneToOne 1 0 0 255 ECU_ADDRESS 0x70017AA9 /end MEASUREMENT
/begin MEASUREMENT dataJ1939Dm1Failrs_as[68].dtc_as[9].spn_u32 "" ULONG CnvRule_NumberOneToOne 1 0 0 4294967295 ECU_ADDRESS 0x70017AAC /end MEASUREMENT
/begin MEASUREMENT dataJ1939Dm1Failrs_as[68].dtc_as[9].fmi_u8 "" UBYTE CnvRule_NumberOneToOne 1 0 0 255 ECU_ADDRESS 0x70017AB0 /end MEASUREMENT
/begin MEASUREMENT dataJ1939Dm1Failrs_as[68].dtc_as[9].occ_u8 "" UBYTE CnvRule_NumberOneToOne 1 0 0 255 ECU_ADDRESS 0x70017AB1 /end MEASUREMENT
/begin MEASUREMENT dataJ1939Dm1Failrs_as[68].dtc_as[10].spn_u32 "" ULONG CnvRule_NumberOneToOne 1 0 0 4294967295 ECU_ADDRESS 0x70017AB4 /end MEASUREMENT
/begin MEASUREMENT dataJ1939Dm1Failrs_as[68].dtc_as[10].fmi_u8 "" UBYTE CnvRule_NumberOneToOne 1 0 0 255 ECU_ADDRESS 0x70017AB8 /end MEASUREMENT
/begin MEASUREMENT dataJ1939Dm1Failrs_as[68].dtc_as[10].occ_u8 "" UBYTE CnvRule_NumberOneToOne 1 0 0 255 ECU_ADDRESS 0x70017AB9 /end MEASUREMENT
/begin MEASUREMENT dataJ1939Dm1Failrs_as[68].dtc_as[11].spn_u32 "" ULONG CnvRule_NumberOneToOne 1 0 0 4294967295 ECU_ADDRESS 0x70017ABC /end MEASUREMENT
/begin MEASUREMENT dataJ1939Dm1Failrs_as[68].dtc_as[11].fmi_u8 "" UBYTE CnvRule_NumberOneToOne 1 0 0 255 ECU_ADDRESS 0x70017AC0 /end MEASUREMENT
/begin MEASUREMENT dataJ1939Dm1Failrs_as[68].dtc_as[11].occ_u8 "" UBYTE CnvRule_NumberOneToOne 1 0 0 255 ECU_ADDRESS 0x70017AC1 /end MEASUREMENT
/begin MEASUREMENT dataJ1939Dm1Failrs_as[68].dtc_as[12].spn_u32 "" ULONG CnvRule_NumberOneToOne 1 0 0 4294967295 ECU_ADDRESS 0x70017AC4 /end MEASUREMENT
/begin MEASUREMENT dataJ1939Dm1Failrs_as[68].dtc_as[12].fmi_u8 "" UBYTE CnvRule_NumberOneToOne 1 0 0 255 ECU_ADDRESS 0x70017AC8 /end MEASUREMENT
/begin MEASUREMENT dataJ1939Dm1Failrs_as[68].dtc_as[12].occ_u8 "" UBYTE CnvRule_NumberOneToOne 1 0 0 255 ECU_ADDRESS 0x70017AC9 /end MEASUREMENT
/begin MEASUREMENT dataJ1939Dm1Failrs_as[68].dtc_as[13].spn_u32 "" ULONG CnvRule_NumberOneToOne 1 0 0 4294967295 ECU_ADDRESS 0x70017ACC /end MEASUREMENT
/begin MEASUREMENT dataJ1939Dm1Failrs_as[68].dtc_as[13].fmi_u8 "" UBYTE CnvRule_NumberOneToOne 1 0 0 255 ECU_ADDRESS 0x70017AD0 /end MEASUREMENT
/begin MEASUREMENT dataJ1939Dm1Failrs_as[68].dtc_as[13].occ_u8 "" UBYTE CnvRule_NumberOneToOne 1 0 0 255 ECU_ADDRESS 0x70017AD1 /end MEASUREMENT
/begin MEASUREMENT dataJ1939Dm1Failrs_as[68].dtc_as[14].spn_u32 "" ULONG CnvRule_NumberOneToOne 1 0 0 4294967295 ECU_ADDRESS 0x70017AD4 /end MEASUREMENT
/begin MEASUREMENT dataJ1939Dm1Failrs_as[68].dtc_as[14].fmi_u8 "" UBYTE CnvRule_NumberOneToOne 1 0 0 255 ECU_ADDRESS 0x70017AD8 /end MEASUREMENT
/begin MEASUREMENT dataJ1939Dm1Failrs_as[68].dtc_as[14].occ_u8 "" UBYTE CnvRule_NumberOneToOne 1 0 0 255 ECU_ADDRESS 0x70017AD9 /end MEASUREMENT
/begin MEASUREMENT dataJ1939Dm1Failrs_as[68].dtc_as[15].spn_u32 "" ULONG CnvRule_NumberOneToOne 1 0 0 4294967295 ECU_ADDRESS 0x70017ADC /end MEASUREMENT
/begin MEASUREMENT dataJ1939Dm1Failrs_as[68].dtc_as[15].fmi_u8 "" UBYTE CnvRule_NumberOneToOne 1 0 0 255 ECU_ADDRESS 0x70017AE0 /end MEASUREMENT
/begin MEASUREMENT dataJ1939Dm1Failrs_as[68].dtc_as[15].occ_u8 "" UBYTE CnvRule_NumberOneToOne 1 0 0 255 ECU_ADDRESS 0x70017AE1 /end MEASUREMENT
/begin MEASUREMENT dataJ1939Dm1Failrs_as[68].dtc_as[16].spn_u32 "" ULONG CnvRule_NumberOneToOne 1 0 0 4294967295 ECU_ADDRESS 0x70017AE4 /end MEASUREMENT
/begin MEASUREMENT dataJ1939Dm1Failrs_as[68].dtc_as[16].fmi_u8 "" UBYTE CnvRule_NumberOneToOne 1 0 0 255 ECU_ADDRESS 0x70017AE8 /end MEASUREMENT
/begin MEASUREMENT dataJ1939Dm1Failrs_as[68].dtc_as[16].occ_u8 "" UBYTE CnvRule_NumberOneToOne 1 0 0 255 ECU_ADDRESS 0x70017AE9 /end MEASUREMENT
/begin MEASUREMENT dataJ1939Dm1Failrs_as[68].dtc_as[17].spn_u32 "" ULONG CnvRule_NumberOneToOne 1 0 0 4294967295 ECU_ADDRESS 0x70017AEC /end MEASUREMENT
/begin MEASUREMENT dataJ1939Dm1Failrs_as[68].dtc_as[17].fmi_u8 "" UBYTE CnvRule_NumberOneToOne 1 0 0 255 ECU_ADDRESS 0x70017AF0 /end MEASUREMENT
/begin MEASUREMENT dataJ1939Dm1Failrs_as[68].dtc_as[17].occ_u8 "" UBYTE CnvRule_NumberOneToOne 1 0 0 255 ECU_ADDRESS 0x70017AF1 /end MEASUREMENT
/begin MEASUREMENT dataJ1939Dm1Failrs_as[68].dtc_as[18].spn_u32 "" ULONG CnvRule_NumberOneToOne 1 0 0 4294967295 ECU_ADDRESS 0x70017AF4 /end MEASUREMENT
/begin MEASUREMENT dataJ1939Dm1Failrs_as[68].dtc_as[18].fmi_u8 "" UBYTE CnvRule_NumberOneToOne 1 0 0 255 ECU_ADDRESS 0x70017AF8 /end MEASUREMENT
/begin MEASUREMENT dataJ1939Dm1Failrs_as[68].dtc_as[18].occ_u8 "" UBYTE CnvRule_NumberOneToOne 1 0 0 255 ECU_ADDRESS 0x70017AF9 /end MEASUREMENT
/begin MEASUREMENT dataJ1939Dm1Failrs_as[68].dtc_as[19].spn_u32 "" ULONG CnvRule_NumberOneToOne 1 0 0 4294967295 ECU_ADDRESS 0x70017AFC /end MEASUREMENT
/begin MEASUREMENT dataJ1939Dm1Failrs_as[68].dtc_as[19].fmi_u8 "" UBYTE CnvRule_NumberOneToOne 1 0 0 255 ECU_ADDRESS 0x70017B00 /end MEASUREMENT
/begin MEASUREMENT dataJ1939Dm1Failrs_as[68].dtc_as[19].occ_u8 "" UBYTE CnvRule_NumberOneToOne 1 0 0 255 ECU_ADDRESS 0x70017B01 /end MEASUREMENT
/begin MEASUREMENT dataJ1939Dm1Failrs_as[68].dtc_as[20].spn_u32 "" ULONG CnvRule_NumberOneToOne 1 0 0 4294967295 ECU_ADDRESS 0x70017B04 /end MEASUREMENT
/begin MEASUREMENT dataJ1939Dm1Failrs_as[68].dtc_as[20].fmi_u8 "" UBYTE CnvRule_NumberOneToOne 1 0 0 255 ECU_ADDRESS 0x70017B08 /end MEASUREMENT
/begin MEASUREMENT dataJ1939Dm1Failrs_as[68].dtc_as[20].occ_u8 "" UBYTE CnvRule_NumberOneToOne 1 0 0 255 ECU_ADDRESS 0x70017B09 /end MEASUREMENT
/begin MEASUREMENT dataJ1939Dm1Failrs_as[68].dtc_as "" UBYTE CnvRule_NumberOneToOne 1 0 0 255 ECU_ADDRESS 0x70017A6C ARRAY_SIZE 160 /end MEASUREMENT
/begin MEASUREMENT dataJ1939Dm1Failrs_as[69].dtc_as[1].spn_u32 "" ULONG CnvRule_NumberOneToOne 1 0 0 4294967295 ECU_ADDRESS 0x70017B10 /end MEASUREMENT
/begin MEASUREMENT dataJ1939Dm1Failrs_as[69].dtc_as[1].fmi_u8 "" UBYTE CnvRule_NumberOneToOne 1 0 0 255 ECU_ADDRESS 0x70017B14 /end MEASUREMENT
/begin MEASUREMENT dataJ1939Dm1Failrs_as[69].dtc_as[1].occ_u8 "" UBYTE CnvRule_NumberOneToOne 1 0 0 255 ECU_ADDRESS 0x70017B15 /end MEASUREMENT
/begin MEASUREMENT dataJ1939Dm1Failrs_as[69].dtc_as[2].spn_u32 "" ULONG CnvRule_NumberOneToOne 1 0 0 4294967295 ECU_ADDRESS 0x70017B18 /end MEASUREMENT
/begin MEASUREMENT dataJ1939Dm1Failrs_as[69].dtc_as[2].fmi_u8 "" UBYTE CnvRule_NumberOneToOne 1 0 0 255 ECU_ADDRESS 0x70017B1C /end MEASUREMENT
/begin MEASUREMENT dataJ1939Dm1Failrs_as[69].dtc_as[2].occ_u8 "" UBYTE CnvRule_NumberOneToOne 1 0 0 255 ECU_ADDRESS 0x70017B1D /end MEASUREMENT
/begin MEASUREMENT dataJ1939Dm1Failrs_as[69].dtc_as[3].spn_u32 "" ULONG CnvRule_NumberOneToOne 1 0 0 4294967295 ECU_ADDRESS 0x70017B20 /end MEASUREMENT
/begin MEASUREMENT dataJ1939Dm1Failrs_as[69].dtc_as[3].fmi_u8 "" UBYTE CnvRule_NumberOneToOne 1 0 0 255 ECU_ADDRESS 0x70017B24 /end MEASUREMENT
/begin MEASUREMENT dataJ1939Dm1Failrs_as[69].dtc_as[3].occ_u8 "" UBYTE CnvRule_NumberOneToOne 1 0 0 255 ECU_ADDRESS 0x70017B25 /end MEASUREMENT
/begin MEASUREMENT dataJ1939Dm1Failrs_as[69].dtc_as[4].spn_u32 "" ULONG CnvRule_NumberOneToOne 1 0 0 4294967295 ECU_ADDRESS 0x70017B28 /end MEASUREMENT
/begin MEASUREMENT dataJ1939Dm1Failrs_as[69].dtc_as[4].fmi_u8 "" UBYTE CnvRule_NumberOneToOne 1 0 0 255 ECU_ADDRESS 0x70017B2C /end MEASUREMENT
/begin MEASUREMENT dataJ1939Dm1Failrs_as[69].dtc_as[4].occ_u8 "" UBYTE CnvRule_NumberOneToOne 1 0 0 255 ECU_ADDRESS 0x70017B2D /end MEASUREMENT
/begin MEASUREMENT dataJ1939Dm1Failrs_as[69].dtc_as[5].spn_u32 "" ULONG CnvRule_NumberOneToOne 1 0 0 4294967295 ECU_ADDRESS 0x70017B30 /end MEASUREMENT
/begin MEASUREMENT dataJ1939Dm1Failrs_as[69].dtc_as[5].fmi_u8 "" UBYTE CnvRule_NumberOneToOne 1 0 0 255 ECU_ADDRESS 0x70017B34 /end MEASUREMENT
/begin MEASUREMENT dataJ1939Dm1Failrs_as[69].dtc_as[5].occ_u8 "" UBYTE CnvRule_NumberOneToOne 1 0 0 255 ECU_ADDRESS 0x70017B35 /end MEASUREMENT
/begin MEASUREMENT dataJ1939Dm1Failrs_as[69].dtc_as[6].spn_u32 "" ULONG CnvRule_NumberOneToOne 1 0 0 4294967295 ECU_ADDRESS 0x70017B38 /end MEASUREMENT
/begin MEASUREMENT dataJ1939Dm1Failrs_as[69].dtc_as[6].fmi_u8 "" UBYTE CnvRule_NumberOneToOne 1 0 0 255 ECU_ADDRESS 0x70017B3C /end MEASUREMENT
/begin MEASUREMENT dataJ1939Dm1Failrs_as[69].dtc_as[6].occ_u8 "" UBYTE CnvRule_NumberOneToOne 1 0 0 255 ECU_ADDRESS 0x70017B3D /end MEASUREMENT
/begin MEASUREMENT dataJ1939Dm1Failrs_as[69].dtc_as[7].spn_u32 "" ULONG CnvRule_NumberOneToOne 1 0 0 4294967295 ECU_ADDRESS 0x70017B40 /end MEASUREMENT
/begin MEASUREMENT dataJ1939Dm1Failrs_as[69].dtc_as[7].fmi_u8 "" UBYTE CnvRule_NumberOneToOne 1 0 0 255 ECU_ADDRESS 0x70017B44 /end MEASUREMENT
/begin MEASUREMENT dataJ1939Dm1Failrs_as[69].dtc_as[7].occ_u8 "" UBYTE CnvRule_NumberOneToOne 1 0 0 255 ECU_ADDRESS 0x70017B45 /end MEASUREMENT
/begin MEASUREMENT dataJ1939Dm1Failrs_as[69].dtc_as[8].spn_u32 "" ULONG CnvRule_NumberOneToOne 1 0 0 4294967295 ECU_ADDRESS 0x70017B48 /end MEASUREMENT
/begin MEASUREMENT dataJ1939Dm1Failrs_as[69].dtc_as[8].fmi_u8 "" UBYTE CnvRule_NumberOneToOne 1 0 0 255 ECU_ADDRESS 0x70017B4C /end MEASUREMENT
/begin MEASUREMENT dataJ1939Dm1Failrs_as[69].dtc_as[8].occ_u8 "" UBYTE CnvRule_NumberOneToOne 1 0 0 255 ECU_ADDRESS 0x70017B4D /end MEASUREMENT
/begin MEASUREMENT dataJ1939Dm1Failrs_as[69].dtc_as[9].spn_u32 "" ULONG CnvRule_NumberOneToOne 1 0 0 4294967295 ECU_ADDRESS 0x70017B50 /end MEASUREMENT
/begin MEASUREMENT dataJ1939Dm1Failrs_as[69].dtc_as[9].fmi_u8 "" UBYTE CnvRule_NumberOneToOne 1 0 0 255 ECU_ADDRESS 0x70017B54 /end MEASUREMENT
/begin MEASUREMENT dataJ1939Dm1Failrs_as[69].dtc_as[9].occ_u8 "" UBYTE CnvRule_NumberOneToOne 1 0 0 255 ECU_ADDRESS 0x70017B55 /end MEASUREMENT
/begin MEASUREMENT dataJ1939Dm1Failrs_as[69].dtc_as[10].spn_u32 "" ULONG CnvRule_NumberOneToOne 1 0 0 4294967295 ECU_ADDRESS 0x70017B58 /end MEASUREMENT
/begin MEASUREMENT dataJ1939Dm1Failrs_as[69].dtc_as[10].fmi_u8 "" UBYTE CnvRule_NumberOneToOne 1 0 0 255 ECU_ADDRESS 0x70017B5C /end MEASUREMENT
/begin MEASUREMENT dataJ1939Dm1Failrs_as[69].dtc_as[10].occ_u8 "" UBYTE CnvRule_NumberOneToOne 1 0 0 255 ECU_ADDRESS 0x70017B5D /end MEASUREMENT
/begin MEASUREMENT dataJ1939Dm1Failrs_as[69].dtc_as[11].spn_u32 "" ULONG CnvRule_NumberOneToOne 1 0 0 4294967295 ECU_ADDRESS 0x70017B60 /end MEASUREMENT
/begin MEASUREMENT dataJ1939Dm1Failrs_as[69].dtc_as[11].fmi_u8 "" UBYTE CnvRule_NumberOneToOne 1 0 0 255 ECU_ADDRESS 0x70017B64 /end MEASUREMENT
/begin MEASUREMENT dataJ1939Dm1Failrs_as[69].dtc_as[11].occ_u8 "" UBYTE CnvRule_NumberOneToOne 1 0 0 255 ECU_ADDRESS 0x70017B65 /end MEASUREMENT
/begin MEASUREMENT dataJ1939Dm1Failrs_as[69].dtc_as[12].spn_u32 "" ULONG CnvRule_NumberOneToOne 1 0 0 4294967295 ECU_ADDRESS 0x70017B68 /end MEASUREMENT
/begin MEASUREMENT dataJ1939Dm1Failrs_as[69].dtc_as[12].fmi_u8 "" UBYTE CnvRule_NumberOneToOne 1 0 0 255 ECU_ADDRESS 0x70017B6C /end MEASUREMENT
/begin MEASUREMENT dataJ1939Dm1Failrs_as[69].dtc_as[12].occ_u8 "" UBYTE CnvRule_NumberOneToOne 1 0 0 255 ECU_ADDRESS 0x70017B6D /end MEASUREMENT
/begin MEASUREMENT dataJ1939Dm1Failrs_as[69].dtc_as[13].spn_u32 "" ULONG CnvRule_NumberOneToOne 1 0 0 4294967295 ECU_ADDRESS 0x70017B70 /end MEASUREMENT
/begin MEASUREMENT dataJ1939Dm1Failrs_as[69].dtc_as[13].fmi_u8 "" UBYTE CnvRule_NumberOneToOne 1 0 0 255 ECU_ADDRESS 0x70017B74 /end MEASUREMENT
/begin MEASUREMENT dataJ1939Dm1Failrs_as[69].dtc_as[13].occ_u8 "" UBYTE CnvRule_NumberOneToOne 1 0 0 255 ECU_ADDRESS 0x70017B75 /end MEASUREMENT
/begin MEASUREMENT dataJ1939Dm1Failrs_as[69].dtc_as[14].spn_u32 "" ULONG CnvRule_NumberOneToOne 1 0 0 4294967295 ECU_ADDRESS 0x70017B78 /end MEASUREMENT
/begin MEASUREMENT dataJ1939Dm1Failrs_as[69].dtc_as[14].fmi_u8 "" UBYTE CnvRule_NumberOneToOne 1 0 0 255 ECU_ADDRESS 0x70017B7C /end MEASUREMENT
/begin MEASUREMENT dataJ1939Dm1Failrs_as[69].dtc_as[14].occ_u8 "" UBYTE CnvRule_NumberOneToOne 1 0 0 255 ECU_ADDRESS 0x70017B7D /end MEASUREMENT
/begin MEASUREMENT dataJ1939Dm1Failrs_as[69].dtc_as[15].spn_u32 "" ULONG CnvRule_NumberOneToOne 1 0 0 4294967295 ECU_ADDRESS 0x70017B80 /end MEASUREMENT
/begin MEASUREMENT dataJ1939Dm1Failrs_as[69].dtc_as[15].fmi_u8 "" UBYTE CnvRule_NumberOneToOne 1 0 0 255 ECU_ADDRESS 0x70017B84 /end MEASUREMENT
/begin MEASUREMENT dataJ1939Dm1Failrs_as[69].dtc_as[15].occ_u8 "" UBYTE CnvRule_NumberOneToOne 1 0 0 255 ECU_ADDRESS 0x70017B85 /end MEASUREMENT
/begin MEASUREMENT dataJ1939Dm1Failrs_as[69].dtc_as[16].spn_u32 "" ULONG CnvRule_NumberOneToOne 1 0 0 4294967295 ECU_ADDRESS 0x70017B88 /end MEASUREMENT
/begin MEASUREMENT dataJ1939Dm1Failrs_as[69].dtc_as[16].fmi_u8 "" UBYTE CnvRule_NumberOneToOne 1 0 0 255 ECU_ADDRESS 0x70017B8C /end MEASUREMENT
/begin MEASUREMENT dataJ1939Dm1Failrs_as[69].dtc_as[16].occ_u8 "" UBYTE CnvRule_NumberOneToOne 1 0 0 255 ECU_ADDRESS 0x70017B8D /end MEASUREMENT
/begin MEASUREMENT dataJ1939Dm1Failrs_as[69].dtc_as[17].spn_u32 "" ULONG CnvRule_NumberOneToOne 1 0 0 4294967295 ECU_ADDRESS 0x70017B90 /end MEASUREMENT
/begin MEASUREMENT dataJ1939Dm1Failrs_as[69].dtc_as[17].fmi_u8 "" UBYTE CnvRule_NumberOneToOne 1 0 0 255 ECU_ADDRESS 0x70017B94 /end MEASUREMENT
/begin MEASUREMENT dataJ1939Dm1Failrs_as[69].dtc_as[17].occ_u8 "" UBYTE CnvRule_NumberOneToOne 1 0 0 255 ECU_ADDRESS 0x70017B95 /end MEASUREMENT
/begin MEASUREMENT dataJ1939Dm1Failrs_as[69].dtc_as[18].spn_u32 "" ULONG CnvRule_NumberOneToOne 1 0 0 4294967295 ECU_ADDRESS 0x70017B98 /end MEASUREMENT
/begin MEASUREMENT dataJ1939Dm1Failrs_as[69].dtc_as[18].fmi_u8 "" UBYTE CnvRule_NumberOneToOne 1 0 0 255 ECU_ADDRESS 0x70017B9C /end MEASUREMENT
/begin MEASUREMENT dataJ1939Dm1Failrs_as[69].dtc_as[18].occ_u8 "" UBYTE CnvRule_NumberOneToOne 1 0 0 255 ECU_ADDRESS 0x70017B9D /end MEASUREMENT
/begin MEASUREMENT dataJ1939Dm1Failrs_as[69].dtc_as[19].spn_u32 "" ULONG CnvRule_NumberOneToOne 1 0 0 4294967295 ECU_ADDRESS 0x70017BA0 /end MEASUREMENT
/begin MEASUREMENT dataJ1939Dm1Failrs_as[69].dtc_as[19].fmi_u8 "" UBYTE CnvRule_NumberOneToOne 1 0 0 255 ECU_ADDRESS 0x70017BA4 /end MEASUREMENT
/begin MEASUREMENT dataJ1939Dm1Failrs_as[69].dtc_as[19].occ_u8 "" UBYTE CnvRule_NumberOneToOne 1 0 0 255 ECU_ADDRESS 0x70017BA5 /end MEASUREMENT
/begin COMPU_METHOD CnvRule_NumberOneToOne "This is a predefined standard conversion rule for signals representing a number with a 1:1 conversion (*nr*_*)." IDENTICAL "%.0" "-" /end COMPU_METHOD
