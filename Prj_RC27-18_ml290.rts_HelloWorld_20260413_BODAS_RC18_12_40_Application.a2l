/begin MEASUREMENT dataJ1939Dm1Failrs_as[8].dtc_as[20].occ_u8 "" UBYTE CnvRule_NumberOneToOne 1 0 0 255 ECU_ADDRESS 0x70015499 /end MEASUREMENT
/begin MEASUREMENT dataJ1939Dm1Failrs_as[8].dtc_as "" UBYTE CnvRule_NumberOneToOne 1 0 0 255 ECU_ADDRESS 0x700153FC ARRAY_SIZE 160 /end MEASUREMENT
/begin MEASUREMENT dataJ1939Dm1Failrs_as[9].dtc_as[1].spn_u32 "" ULONG CnvRule_NumberOneToOne 1 0 0 4294967295 ECU_ADDRESS 0x700154A0 /end MEASUREMENT
/begin MEASUREMENT dataJ1939Dm1Failrs_as[9].dtc_as[1].fmi_u8 "" UBYTE CnvRule_NumberOneToOne 1 0 0 255 ECU_ADDRESS 0x700154A4 /end MEASUREMENT
/begin MEASUREMENT dataJ1939Dm1Failrs_as[9].dtc_as[1].occ_u8 "" UBYTE CnvRule_NumberOneToOne 1 0 0 255 ECU_ADDRESS 0x700154A5 /end MEASUREMENT
/begin MEASUREMENT dataJ1939Dm1Failrs_as[9].dtc_as[2].spn_u32 "" ULONG CnvRule_NumberOneToOne 1 0 0 4294967295 ECU_ADDRESS 0x700154A8 /end MEASUREMENT
/begin MEASUREMENT dataJ1939Dm1Failrs_as[9].dtc_as[2].fmi_u8 "" UBYTE CnvRule_NumberOneToOne 1 0 0 255 ECU_ADDRESS 0x700154AC /end MEASUREMENT
/begin MEASUREMENT dataJ1939Dm1Failrs_as[9].dtc_as[2].occ_u8 "" UBYTE CnvRule_NumberOneToOne 1 0 0 255 ECU_ADDRESS 0x700154AD /end MEASUREMENT
/begin MEASUREMENT dataJ1939Dm1Failrs_as[9].dtc_as[3].spn_u32 "" ULONG CnvRule_NumberOneToOne 1 0 0 4294967295 ECU_ADDRESS 0x700154B0 /end MEASUREMENT
/begin MEASUREMENT dataJ1939Dm1Failrs_as[9].dtc_as[3].fmi_u8 "" UBYTE CnvRule_NumberOneToOne 1 0 0 255 ECU_ADDRESS 0x700154B4 /end MEASUREMENT
/begin MEASUREMENT dataJ1939Dm1Failrs_as[9].dtc_as[3].occ_u8 "" UBYTE CnvRule_NumberOneToOne 1 0 0 255 ECU_ADDRESS 0x700154B5 /end MEASUREMENT
/begin MEASUREMENT dataJ1939Dm1Failrs_as[9].dtc_as[4].spn_u32 "" ULONG CnvRule_NumberOneToOne 1 0 0 4294967295 ECU_ADDRESS 0x700154B8 /end MEASUREMENT
/begin MEASUREMENT dataJ1939Dm1Failrs_as[9].dtc_as[4].fmi_u8 "" UBYTE CnvRule_NumberOneToOne 1 0 0 255 ECU_ADDRESS 0x700154BC /end MEASUREMENT
/begin MEASUREMENT dataJ1939Dm1Failrs_as[9].dtc_as[4].occ_u8 "" UBYTE CnvRule_NumberOneToOne 1 0 0 255 ECU_ADDRESS 0x700154BD /end MEASUREMENT
/begin MEASUREMENT dataJ1939Dm1Failrs_as[9].dtc_as[5].spn_u32 "" ULONG CnvRule_NumberOneToOne 1 0 0 4294967295 ECU_ADDRESS 0x700154C0 /end MEASUREMENT
/begin MEASUREMENT dataJ1939Dm1Failrs_as[9].dtc_as[5].fmi_u8 "" UBYTE CnvRule_NumberOneToOne 1 0 0 255 ECU_ADDRESS 0x700154C4 /end MEASUREMENT
/begin MEASUREMENT dataJ1939Dm1Failrs_as[9].dtc_as[5].occ_u8 "" UBYTE CnvRule_NumberOneToOne 1 0 0 255 ECU_ADDRESS 0x700154C5 /end MEASUREMENT
/begin MEASUREMENT dataJ1939Dm1Failrs_as[9].dtc_as[6].spn_u32 "" ULONG CnvRule_NumberOneToOne 1 0 0 4294967295 ECU_ADDRESS 0x700154C8 /end MEASUREMENT
/begin MEASUREMENT dataJ1939Dm1Failrs_as[9].dtc_as[6].fmi_u8 "" UBYTE CnvRule_NumberOneToOne 1 0 0 255 ECU_ADDRESS 0x700154CC /end MEASUREMENT
/begin MEASUREMENT dataJ1939Dm1Failrs_as[9].dtc_as[6].occ_u8 "" UBYTE CnvRule_NumberOneToOne 1 0 0 255 ECU_ADDRESS 0x700154CD /end MEASUREMENT
/begin MEASUREMENT dataJ1939Dm1Failrs_as[9].dtc_as[7].spn_u32 "" ULONG CnvRule_NumberOneToOne 1 0 0 4294967295 ECU_ADDRESS 0x700154D0 /end MEASUREMENT
/begin MEASUREMENT dataJ1939Dm1Failrs_as[9].dtc_as[7].fmi_u8 "" UBYTE CnvRule_NumberOneToOne 1 0 0 255 ECU_ADDRESS 0x700154D4 /end MEASUREMENT
/begin MEASUREMENT dataJ1939Dm1Failrs_as[9].dtc_as[7].occ_u8 "" UBYTE CnvRule_NumberOneToOne 1 0 0 255 ECU_ADDRESS 0x700154D5 /end MEASUREMENT
/begin MEASUREMENT dataJ1939Dm1Failrs_as[9].dtc_as[8].spn_u32 "" ULONG CnvRule_NumberOneToOne 1 0 0 4294967295 ECU_ADDRESS 0x700154D8 /end MEASUREMENT
/begin MEASUREMENT dataJ1939Dm1Failrs_as[9].dtc_as[8].fmi_u8 "" UBYTE CnvRule_NumberOneToOne 1 0 0 255 ECU_ADDRESS 0x700154DC /end MEASUREMENT
/begin MEASUREMENT dataJ1939Dm1Failrs_as[9].dtc_as[8].occ_u8 "" UBYTE CnvRule_NumberOneToOne 1 0 0 255 ECU_ADDRESS 0x700154DD /end MEASUREMENT
/begin MEASUREMENT dataJ1939Dm1Failrs_as[9].dtc_as[9].spn_u32 "" ULONG CnvRule_NumberOneToOne 1 0 0 4294967295 ECU_ADDRESS 0x700154E0 /end MEASUREMENT
/begin MEASUREMENT dataJ1939Dm1Failrs_as[9].dtc_as[9].fmi_u8 "" UBYTE CnvRule_NumberOneToOne 1 0 0 255 ECU_ADDRESS 0x700154E4 /end MEASUREMENT
/begin MEASUREMENT dataJ1939Dm1Failrs_as[9].dtc_as[9].occ_u8 "" UBYTE CnvRule_NumberOneToOne 1 0 0 255 ECU_ADDRESS 0x700154E5 /end MEASUREMENT
/begin MEASUREMENT dataJ1939Dm1Failrs_as[9].dtc_as[10].spn_u32 "" ULONG CnvRule_NumberOneToOne 1 0 0 4294967295 ECU_ADDRESS 0x700154E8 /end MEASUREMENT
/begin MEASUREMENT dataJ1939Dm1Failrs_as[9].dtc_as[10].fmi_u8 "" UBYTE CnvRule_NumberOneToOne 1 0 0 255 ECU_ADDRESS 0x700154EC /end MEASUREMENT
/begin MEASUREMENT dataJ1939Dm1Failrs_as[9].dtc_as[10].occ_u8 "" UBYTE CnvRule_NumberOneToOne 1 0 0 255 ECU_ADDRESS 0x700154ED /end MEASUREMENT
/begin MEASUREMENT dataJ1939Dm1Failrs_as[9].dtc_as[11].spn_u32 "" ULONG CnvRule_NumberOneToOne 1 0 0 4294967295 ECU_ADDRESS 0x700154F0 /end MEASUREMENT
/begin MEASUREMENT dataJ1939Dm1Failrs_as[9].dtc_as[11].fmi_u8 "" UBYTE CnvRule_NumberOneToOne 1 0 0 255 ECU_ADDRESS 0x700154F4 /end MEASUREMENT
/begin MEASUREMENT dataJ1939Dm1Failrs_as[9].dtc_as[11].occ_u8 "" UBYTE CnvRule_NumberOneToOne 1 0 0 255 ECU_ADDRESS 0x700154F5 /end MEASUREMENT
/begin MEASUREMENT dataJ1939Dm1Failrs_as[9].dtc_as[12].spn_u32 "" ULONG CnvRule_NumberOneToOne 1 0 0 4294967295 ECU_ADDRESS 0x700154F8 /end MEASUREMENT
/begin MEASUREMENT dataJ1939Dm1Failrs_as[9].dtc_as[12].fmi_u8 "" UBYTE CnvRule_NumberOneToOne 1 0 0 255 ECU_ADDRESS 0x700154FC /end MEASUREMENT
/begin MEASUREMENT dataJ1939Dm1Failrs_as[9].dtc_as[12].occ_u8 "" UBYTE CnvRule_NumberOneToOne 1 0 0 255 ECU_ADDRESS 0x700154FD /end MEASUREMENT
/begin MEASUREMENT dataJ1939Dm1Failrs_as[9].dtc_as[13].spn_u32 "" ULONG CnvRule_NumberOneToOne 1 0 0 4294967295 ECU_ADDRESS 0x70015500 /end MEASUREMENT
/begin MEASUREMENT dataJ1939Dm1Failrs_as[9].dtc_as[13].fmi_u8 "" UBYTE CnvRule_NumberOneToOne 1 0 0 255 ECU_ADDRESS 0x70015504 /end MEASUREMENT
/begin MEASUREMENT dataJ1939Dm1Failrs_as[9].dtc_as[13].occ_u8 "" UBYTE CnvRule_NumberOneToOne 1 0 0 255 ECU_ADDRESS 0x70015505 /end MEASUREMENT
/begin MEASUREMENT dataJ1939Dm1Failrs_as[9].dtc_as[14].spn_u32 "" ULONG CnvRule_NumberOneToOne 1 0 0 4294967295 ECU_ADDRESS 0x70015508 /end MEASUREMENT
/begin MEASUREMENT dataJ1939Dm1Failrs_as[9].dtc_as[14].fmi_u8 "" UBYTE CnvRule_NumberOneToOne 1 0 0 255 ECU_ADDRESS 0x7001550C /end MEASUREMENT
/begin MEASUREMENT dataJ1939Dm1Failrs_as[9].dtc_as[14].occ_u8 "" UBYTE CnvRule_NumberOneToOne 1 0 0 255 ECU_ADDRESS 0x7001550D /end MEASUREMENT
/begin MEASUREMENT dataJ1939Dm1Failrs_as[9].dtc_as[15].spn_u32 "" ULONG CnvRule_NumberOneToOne 1 0 0 4294967295 ECU_ADDRESS 0x70015510 /end MEASUREMENT
/begin MEASUREMENT dataJ1939Dm1Failrs_as[9].dtc_as[15].fmi_u8 "" UBYTE CnvRule_NumberOneToOne 1 0 0 255 ECU_ADDRESS 0x70015514 /end MEASUREMENT
/begin MEASUREMENT dataJ1939Dm1Failrs_as[9].dtc_as[15].occ_u8 "" UBYTE CnvRule_NumberOneToOne 1 0 0 255 ECU_ADDRESS 0x70015515 /end MEASUREMENT
/begin MEASUREMENT dataJ1939Dm1Failrs_as[9].dtc_as[16].spn_u32 "" ULONG CnvRule_NumberOneToOne 1 0 0 4294967295 ECU_ADDRESS 0x70015518 /end MEASUREMENT
/begin MEASUREMENT dataJ1939Dm1Failrs_as[9].dtc_as[16].fmi_u8 "" UBYTE CnvRule_NumberOneToOne 1 0 0 255 ECU_ADDRESS 0x7001551C /end MEASUREMENT
/begin MEASUREMENT dataJ1939Dm1Failrs_as[9].dtc_as[16].occ_u8 "" UBYTE CnvRule_NumberOneToOne 1 0 0 255 ECU_ADDRESS 0x7001551D /end MEASUREMENT
/begin MEASUREMENT dataJ1939Dm1Failrs_as[9].dtc_as[17].spn_u32 "" ULONG CnvRule_NumberOneToOne 1 0 0 4294967295 ECU_ADDRESS 0x70015520 /end MEASUREMENT
/begin MEASUREMENT dataJ1939Dm1Failrs_as[9].dtc_as[17].fmi_u8 "" UBYTE CnvRule_NumberOneToOne 1 0 0 255 ECU_ADDRESS 0x70015524 /end MEASUREMENT
/begin MEASUREMENT dataJ1939Dm1Failrs_as[9].dtc_as[17].occ_u8 "" UBYTE CnvRule_NumberOneToOne 1 0 0 255 ECU_ADDRESS 0x70015525 /end MEASUREMENT
/begin MEASUREMENT dataJ1939Dm1Failrs_as[9].dtc_as[18].spn_u32 "" ULONG CnvRule_NumberOneToOne 1 0 0 4294967295 ECU_ADDRESS 0x70015528 /end MEASUREMENT
/begin MEASUREMENT dataJ1939Dm1Failrs_as[9].dtc_as[18].fmi_u8 "" UBYTE CnvRule_NumberOneToOne 1 0 0 255 ECU_ADDRESS 0x7001552C /end MEASUREMENT
/begin MEASUREMENT dataJ1939Dm1Failrs_as[9].dtc_as[18].occ_u8 "" UBYTE CnvRule_NumberOneToOne 1 0 0 255 ECU_ADDRESS 0x7001552D /end MEASUREMENT
/begin MEASUREMENT dataJ1939Dm1Failrs_as[9].dtc_as[19].spn_u32 "" ULONG CnvRule_NumberOneToOne 1 0 0 4294967295 ECU_ADDRESS 0x70015530 /end MEASUREMENT
/begin MEASUREMENT dataJ1939Dm1Failrs_as[9].dtc_as[19].fmi_u8 "" UBYTE CnvRule_NumberOneToOne 1 0 0 255 ECU_ADDRESS 0x70015534 /end MEASUREMENT
/begin MEASUREMENT dataJ1939Dm1Failrs_as[9].dtc_as[19].occ_u8 "" UBYTE CnvRule_NumberOneToOne 1 0 0 255 ECU_ADDRESS 0x70015535 /end MEASUREMENT
/begin MEASUREMENT dataJ1939Dm1Failrs_as[9].dtc_as[20].spn_u32 "" ULONG CnvRule_NumberOneToOne 1 0 0 4294967295 ECU_ADDRESS 0x70015538 /end MEASUREMENT
/begin MEASUREMENT dataJ1939Dm1Failrs_as[9].dtc_as[20].fmi_u8 "" UBYTE CnvRule_NumberOneToOne 1 0 0 255 ECU_ADDRESS 0x7001553C /end MEASUREMENT
/begin MEASUREMENT dataJ1939Dm1Failrs_as[9].dtc_as[20].occ_u8 "" UBYTE CnvRule_NumberOneToOne 1 0 0 255 ECU_ADDRESS 0x7001553D /end MEASUREMENT
/begin MEASUREMENT dataJ1939Dm1Failrs_as[9].dtc_as "" UBYTE CnvRule_NumberOneToOne 1 0 0 255 ECU_ADDRESS 0x700154A0 ARRAY_SIZE 160 /end MEASUREMENT
/begin MEASUREMENT dataJ1939Dm1Failrs_as[10].dtc_as[1].spn_u32 "" ULONG CnvRule_NumberOneToOne 1 0 0 4294967295 ECU_ADDRESS 0x70015544 /end MEASUREMENT
/begin MEASUREMENT dataJ1939Dm1Failrs_as[10].dtc_as[1].fmi_u8 "" UBYTE CnvRule_NumberOneToOne 1 0 0 255 ECU_ADDRESS 0x70015548 /end MEASUREMENT
/begin MEASUREMENT dataJ1939Dm1Failrs_as[10].dtc_as[1].occ_u8 "" UBYTE CnvRule_NumberOneToOne 1 0 0 255 ECU_ADDRESS 0x70015549 /end MEASUREMENT
/begin MEASUREMENT dataJ1939Dm1Failrs_as[10].dtc_as[2].spn_u32 "" ULONG CnvRule_NumberOneToOne 1 0 0 4294967295 ECU_ADDRESS 0x7001554C /end MEASUREMENT
/begin MEASUREMENT dataJ1939Dm1Failrs_as[10].dtc_as[2].fmi_u8 "" UBYTE CnvRule_NumberOneToOne 1 0 0 255 ECU_ADDRESS 0x70015550 /end MEASUREMENT
/begin MEASUREMENT dataJ1939Dm1Failrs_as[10].dtc_as[2].occ_u8 "" UBYTE CnvRule_NumberOneToOne 1 0 0 255 ECU_ADDRESS 0x70015551 /end MEASUREMENT
/begin MEASUREMENT dataJ1939Dm1Failrs_as[10].dtc_as[3].spn_u32 "" ULONG CnvRule_NumberOneToOne 1 0 0 4294967295 ECU_ADDRESS 0x70015554 /end MEASUREMENT
/begin MEASUREMENT dataJ1939Dm1Failrs_as[10].dtc_as[3].fmi_u8 "" UBYTE CnvRule_NumberOneToOne 1 0 0 255 ECU_ADDRESS 0x70015558 /end MEASUREMENT
/begin MEASUREMENT dataJ1939Dm1Failrs_as[10].dtc_as[3].occ_u8 "" UBYTE CnvRule_NumberOneToOne 1 0 0 255 ECU_ADDRESS 0x70015559 /end MEASUREMENT
/begin MEASUREMENT dataJ1939Dm1Failrs_as[10].dtc_as[4].spn_u32 "" ULONG CnvRule_NumberOneToOne 1 0 0 4294967295 ECU_ADDRESS 0x7001555C /end MEASUREMENT
/begin MEASUREMENT dataJ1939Dm1Failrs_as[10].dtc_as[4].fmi_u8 "" UBYTE CnvRule_NumberOneToOne 1 0 0 255 ECU_ADDRESS 0x70015560 /end MEASUREMENT
/begin MEASUREMENT dataJ1939Dm1Failrs_as[10].dtc_as[4].occ_u8 "" UBYTE CnvRule_NumberOneToOne 1 0 0 255 ECU_ADDRESS 0x70015561 /end MEASUREMENT
/begin MEASUREMENT dataJ1939Dm1Failrs_as[10].dtc_as[5].spn_u32 "" ULONG CnvRule_NumberOneToOne 1 0 0 4294967295 ECU_ADDRESS 0x70015564 /end MEASUREMENT
/begin MEASUREMENT dataJ1939Dm1Failrs_as[10].dtc_as[5].fmi_u8 "" UBYTE CnvRule_NumberOneToOne 1 0 0 255 ECU_ADDRESS 0x70015568 /end MEASUREMENT
/begin MEASUREMENT dataJ1939Dm1Failrs_as[10].dtc_as[5].occ_u8 "" UBYTE CnvRule_NumberOneToOne 1 0 0 255 ECU_ADDRESS 0x70015569 /end MEASUREMENT
/begin MEASUREMENT dataJ1939Dm1Failrs_as[10].dtc_as[6].spn_u32 "" ULONG CnvRule_NumberOneToOne 1 0 0 4294967295 ECU_ADDRESS 0x7001556C /end MEASUREMENT
/begin MEASUREMENT dataJ1939Dm1Failrs_as[10].dtc_as[6].fmi_u8 "" UBYTE CnvRule_NumberOneToOne 1 0 0 255 ECU_ADDRESS 0x70015570 /end MEASUREMENT
/begin MEASUREMENT dataJ1939Dm1Failrs_as[10].dtc_as[6].occ_u8 "" UBYTE CnvRule_NumberOneToOne 1 0 0 255 ECU_ADDRESS 0x70015571 /end MEASUREMENT
/begin MEASUREMENT dataJ1939Dm1Failrs_as[10].dtc_as[7].spn_u32 "" ULONG CnvRule_NumberOneToOne 1 0 0 4294967295 ECU_ADDRESS 0x70015574 /end MEASUREMENT
/begin MEASUREMENT dataJ1939Dm1Failrs_as[10].dtc_as[7].fmi_u8 "" UBYTE CnvRule_NumberOneToOne 1 0 0 255 ECU_ADDRESS 0x70015578 /end MEASUREMENT
/begin MEASUREMENT dataJ1939Dm1Failrs_as[10].dtc_as[7].occ_u8 "" UBYTE CnvRule_NumberOneToOne 1 0 0 255 ECU_ADDRESS 0x70015579 /end MEASUREMENT
/begin MEASUREMENT dataJ1939Dm1Failrs_as[10].dtc_as[8].spn_u32 "" ULONG CnvRule_NumberOneToOne 1 0 0 4294967295 ECU_ADDRESS 0x7001557C /end MEASUREMENT
/begin MEASUREMENT dataJ1939Dm1Failrs_as[10].dtc_as[8].fmi_u8 "" UBYTE CnvRule_NumberOneToOne 1 0 0 255 ECU_ADDRESS 0x70015580 /end MEASUREMENT
/begin MEASUREMENT dataJ1939Dm1Failrs_as[10].dtc_as[8].occ_u8 "" UBYTE CnvRule_NumberOneToOne 1 0 0 255 ECU_ADDRESS 0x70015581 /end MEASUREMENT
/begin MEASUREMENT dataJ1939Dm1Failrs_as[10].dtc_as[9].spn_u32 "" ULONG CnvRule_NumberOneToOne 1 0 0 4294967295 ECU_ADDRESS 0x70015584 /end MEASUREMENT
/begin MEASUREMENT dataJ1939Dm1Failrs_as[10].dtc_as[9].fmi_u8 "" UBYTE CnvRule_NumberOneToOne 1 0 0 255 ECU_ADDRESS 0x70015588 /end MEASUREMENT
/begin MEASUREMENT dataJ1939Dm1Failrs_as[10].dtc_as[9].occ_u8 "" UBYTE CnvRule_NumberOneToOne 1 0 0 255 ECU_ADDRESS 0x70015589 /end MEASUREMENT
/begin MEASUREMENT dataJ1939Dm1Failrs_as[10].dtc_as[10].spn_u32 "" ULONG CnvRule_NumberOneToOne 1 0 0 4294967295 ECU_ADDRESS 0x7001558C /end MEASUREMENT
/begin MEASUREMENT dataJ1939Dm1Failrs_as[10].dtc_as[10].fmi_u8 "" UBYTE CnvRule_NumberOneToOne 1 0 0 255 ECU_ADDRESS 0x70015590 /end MEASUREMENT
/begin MEASUREMENT dataJ1939Dm1Failrs_as[10].dtc_as[10].occ_u8 "" UBYTE CnvRule_NumberOneToOne 1 0 0 255 ECU_ADDRESS 0x70015591 /end MEASUREMENT
/begin MEASUREMENT dataJ1939Dm1Failrs_as[10].dtc_as[11].spn_u32 "" ULONG CnvRule_NumberOneToOne 1 0 0 4294967295 ECU_ADDRESS 0x70015594 /end MEASUREMENT
/begin MEASUREMENT dataJ1939Dm1Failrs_as[10].dtc_as[11].fmi_u8 "" UBYTE CnvRule_NumberOneToOne 1 0 0 255 ECU_ADDRESS 0x70015598 /end MEASUREMENT
/begin MEASUREMENT dataJ1939Dm1Failrs_as[10].dtc_as[11].occ_u8 "" UBYTE CnvRule_NumberOneToOne 1 0 0 255 ECU_ADDRESS 0x70015599 /end MEASUREMENT
/begin MEASUREMENT dataJ1939Dm1Failrs_as[10].dtc_as[12].spn_u32 "" ULONG CnvRule_NumberOneToOne 1 0 0 4294967295 ECU_ADDRESS 0x7001559C /end MEASUREMENT
/begin MEASUREMENT dataJ1939Dm1Failrs_as[10].dtc_as[12].fmi_u8 "" UBYTE CnvRule_NumberOneToOne 1 0 0 255 ECU_ADDRESS 0x700155A0 /end MEASUREMENT
/begin MEASUREMENT dataJ1939Dm1Failrs_as[10].dtc_as[12].occ_u8 "" UBYTE CnvRule_NumberOneToOne 1 0 0 255 ECU_ADDRESS 0x700155A1 /end MEASUREMENT
/begin MEASUREMENT dataJ1939Dm1Failrs_as[10].dtc_as[13].spn_u32 "" ULONG CnvRule_NumberOneToOne 1 0 0 4294967295 ECU_ADDRESS 0x700155A4 /end MEASUREMENT
/begin MEASUREMENT dataJ1939Dm1Failrs_as[10].dtc_as[13].fmi_u8 "" UBYTE CnvRule_NumberOneToOne 1 0 0 255 ECU_ADDRESS 0x700155A8 /end MEASUREMENT
/begin MEASUREMENT dataJ1939Dm1Failrs_as[10].dtc_as[13].occ_u8 "" UBYTE CnvRule_NumberOneToOne 1 0 0 255 ECU_ADDRESS 0x700155A9 /end MEASUREMENT
/begin MEASUREMENT dataJ1939Dm1Failrs_as[10].dtc_as[14].spn_u32 "" ULONG CnvRule_NumberOneToOne 1 0 0 4294967295 ECU_ADDRESS 0x700155AC /end MEASUREMENT
/begin MEASUREMENT dataJ1939Dm1Failrs_as[10].dtc_as[14].fmi_u8 "" UBYTE CnvRule_NumberOneToOne 1 0 0 255 ECU_ADDRESS 0x700155B0 /end MEASUREMENT
/begin MEASUREMENT dataJ1939Dm1Failrs_as[10].dtc_as[14].occ_u8 "" UBYTE CnvRule_NumberOneToOne 1 0 0 255 ECU_ADDRESS 0x700155B1 /end MEASUREMENT
/begin MEASUREMENT dataJ1939Dm1Failrs_as[10].dtc_as[15].spn_u32 "" ULONG CnvRule_NumberOneToOne 1 0 0 4294967295 ECU_ADDRESS 0x700155B4 /end MEASUREMENT
/begin MEASUREMENT dataJ1939Dm1Failrs_as[10].dtc_as[15].fmi_u8 "" UBYTE CnvRule_NumberOneToOne 1 0 0 255 ECU_ADDRESS 0x700155B8 /end MEASUREMENT
/begin MEASUREMENT dataJ1939Dm1Failrs_as[10].dtc_as[15].occ_u8 "" UBYTE CnvRule_NumberOneToOne 1 0 0 255 ECU_ADDRESS 0x700155B9 /end MEASUREMENT
/begin MEASUREMENT dataJ1939Dm1Failrs_as[10].dtc_as[16].spn_u32 "" ULONG CnvRule_NumberOneToOne 1 0 0 4294967295 ECU_ADDRESS 0x700155BC /end MEASUREMENT
/begin MEASUREMENT dataJ1939Dm1Failrs_as[10].dtc_as[16].fmi_u8 "" UBYTE CnvRule_NumberOneToOne 1 0 0 255 ECU_ADDRESS 0x700155C0 /end MEASUREMENT
/begin MEASUREMENT dataJ1939Dm1Failrs_as[10].dtc_as[16].occ_u8 "" UBYTE CnvRule_NumberOneToOne 1 0 0 255 ECU_ADDRESS 0x700155C1 /end MEASUREMENT
/begin MEASUREMENT dataJ1939Dm1Failrs_as[10].dtc_as[17].spn_u32 "" ULONG CnvRule_NumberOneToOne 1 0 0 4294967295 ECU_ADDRESS 0x700155C4 /end MEASUREMENT
/begin MEASUREMENT dataJ1939Dm1Failrs_as[10].dtc_as[17].fmi_u8 "" UBYTE CnvRule_NumberOneToOne 1 0 0 255 ECU_ADDRESS 0x700155C8 /end MEASUREMENT
/begin MEASUREMENT dataJ1939Dm1Failrs_as[10].dtc_as[17].occ_u8 "" UBYTE CnvRule_NumberOneToOne 1 0 0 255 ECU_ADDRESS 0x700155C9 /end MEASUREMENT
/begin MEASUREMENT dataJ1939Dm1Failrs_as[10].dtc_as[18].spn_u32 "" ULONG CnvRule_NumberOneToOne 1 0 0 4294967295 ECU_ADDRESS 0x700155CC /end MEASUREMENT
/begin MEASUREMENT dataJ1939Dm1Failrs_as[10].dtc_as[18].fmi_u8 "" UBYTE CnvRule_NumberOneToOne 1 0 0 255 ECU_ADDRESS 0x700155D0 /end MEASUREMENT
/begin MEASUREMENT dataJ1939Dm1Failrs_as[10].dtc_as[18].occ_u8 "" UBYTE CnvRule_NumberOneToOne 1 0 0 255 ECU_ADDRESS 0x700155D1 /end MEASUREMENT
/begin MEASUREMENT dataJ1939Dm1Failrs_as[10].dtc_as[19].spn_u32 "" ULONG CnvRule_NumberOneToOne 1 0 0 4294967295 ECU_ADDRESS 0x700155D4 /end MEASUREMENT
/begin MEASUREMENT dataJ1939Dm1Failrs_as[10].dtc_as[19].fmi_u8 "" UBYTE CnvRule_NumberOneToOne 1 0 0 255 ECU_ADDRESS 0x700155D8 /end MEASUREMENT
/begin MEASUREMENT dataJ1939Dm1Failrs_as[10].dtc_as[19].occ_u8 "" UBYTE CnvRule_NumberOneToOne 1 0 0 255 ECU_ADDRESS 0x700155D9 /end MEASUREMENT
/begin MEASUREMENT dataJ1939Dm1Failrs_as[10].dtc_as[20].spn_u32 "" ULONG CnvRule_NumberOneToOne 1 0 0 4294967295 ECU_ADDRESS 0x700155DC /end MEASUREMENT
/begin MEASUREMENT dataJ1939Dm1Failrs_as[10].dtc_as[20].fmi_u8 "" UBYTE CnvRule_NumberOneToOne 1 0 0 255 ECU_ADDRESS 0x700155E0 /end MEASUREMENT
/begin MEASUREMENT dataJ1939Dm1Failrs_as[10].dtc_as[20].occ_u8 "" UBYTE CnvRule_NumberOneToOne 1 0 0 255 ECU_ADDRESS 0x700155E1 /end MEASUREMENT
/begin MEASUREMENT dataJ1939Dm1Failrs_as[10].dtc_as "" UBYTE CnvRule_NumberOneToOne 1 0 0 255 ECU_ADDRESS 0x70015544 ARRAY_SIZE 160 /end MEASUREMENT
/begin MEASUREMENT dataJ1939Dm1Failrs_as[11].dtc_as[1].spn_u32 "" ULONG CnvRule_NumberOneToOne 1 0 0 4294967295 ECU_ADDRESS 0x700155E8 /end MEASUREMENT
/begin MEASUREMENT dataJ1939Dm1Failrs_as[11].dtc_as[1].fmi_u8 "" UBYTE CnvRule_NumberOneToOne 1 0 0 255 ECU_ADDRESS 0x700155EC /end MEASUREMENT
/begin MEASUREMENT dataJ1939Dm1Failrs_as[11].dtc_as[1].occ_u8 "" UBYTE CnvRule_NumberOneToOne 1 0 0 255 ECU_ADDRESS 0x700155ED /end MEASUREMENT
/begin MEASUREMENT dataJ1939Dm1Failrs_as[11].dtc_as[2].spn_u32 "" ULONG CnvRule_NumberOneToOne 1 0 0 4294967295 ECU_ADDRESS 0x700155F0 /end MEASUREMENT
/begin MEASUREMENT dataJ1939Dm1Failrs_as[11].dtc_as[2].fmi_u8 "" UBYTE CnvRule_NumberOneToOne 1 0 0 255 ECU_ADDRESS 0x700155F4 /end MEASUREMENT
/begin MEASUREMENT dataJ1939Dm1Failrs_as[11].dtc_as[2].occ_u8 "" UBYTE CnvRule_NumberOneToOne 1 0 0 255 ECU_ADDRESS 0x700155F5 /end MEASUREMENT
/begin MEASUREMENT dataJ1939Dm1Failrs_as[11].dtc_as[3].spn_u32 "" ULONG CnvRule_NumberOneToOne 1 0 0 4294967295 ECU_ADDRESS 0x700155F8 /end MEASUREMENT
/begin MEASUREMENT dataJ1939Dm1Failrs_as[11].dtc_as[3].fmi_u8 "" UBYTE CnvRule_NumberOneToOne 1 0 0 255 ECU_ADDRESS 0x700155FC /end MEASUREMENT
/begin MEASUREMENT dataJ1939Dm1Failrs_as[11].dtc_as[3].occ_u8 "" UBYTE CnvRule_NumberOneToOne 1 0 0 255 ECU_ADDRESS 0x700155FD /end MEASUREMENT
/begin MEASUREMENT dataJ1939Dm1Failrs_as[11].dtc_as[4].spn_u32 "" ULONG CnvRule_NumberOneToOne 1 0 0 4294967295 ECU_ADDRESS 0x70015600 /end MEASUREMENT
/begin MEASUREMENT dataJ1939Dm1Failrs_as[11].dtc_as[4].fmi_u8 "" UBYTE CnvRule_NumberOneToOne 1 0 0 255 ECU_ADDRESS 0x70015604 /end MEASUREMENT
/begin MEASUREMENT dataJ1939Dm1Failrs_as[11].dtc_as[4].occ_u8 "" UBYTE CnvRule_NumberOneToOne 1 0 0 255 ECU_ADDRESS 0x70015605 /end MEASUREMENT
/begin MEASUREMENT dataJ1939Dm1Failrs_as[11].dtc_as[5].spn_u32 "" ULONG CnvRule_NumberOneToOne 1 0 0 4294967295 ECU_ADDRESS 0x70015608 /end MEASUREMENT
/begin MEASUREMENT dataJ1939Dm1Failrs_as[11].dtc_as[5].fmi_u8 "" UBYTE CnvRule_NumberOneToOne 1 0 0 255 ECU_ADDRESS 0x7001560C /end MEASUREMENT
/begin MEASUREMENT dataJ1939Dm1Failrs_as[11].dtc_as[5].occ_u8 "" UBYTE CnvRule_NumberOneToOne 1 0 0 255 ECU_ADDRESS 0x7001560D /end MEASUREMENT
/begin MEASUREMENT dataJ1939Dm1Failrs_as[11].dtc_as[6].spn_u32 "" ULONG CnvRule_NumberOneToOne 1 0 0 4294967295 ECU_ADDRESS 0x70015610 /end MEASUREMENT
/begin MEASUREMENT dataJ1939Dm1Failrs_as[11].dtc_as[6].fmi_u8 "" UBYTE CnvRule_NumberOneToOne 1 0 0 255 ECU_ADDRESS 0x70015614 /end MEASUREMENT
/begin MEASUREMENT dataJ1939Dm1Failrs_as[11].dtc_as[6].occ_u8 "" UBYTE CnvRule_NumberOneToOne 1 0 0 255 ECU_ADDRESS 0x70015615 /end MEASUREMENT
/begin MEASUREMENT dataJ1939Dm1Failrs_as[11].dtc_as[7].spn_u32 "" ULONG CnvRule_NumberOneToOne 1 0 0 4294967295 ECU_ADDRESS 0x70015618 /end MEASUREMENT
/begin MEASUREMENT dataJ1939Dm1Failrs_as[11].dtc_as[7].fmi_u8 "" UBYTE CnvRule_NumberOneToOne 1 0 0 255 ECU_ADDRESS 0x7001561C /end MEASUREMENT
/begin MEASUREMENT dataJ1939Dm1Failrs_as[11].dtc_as[7].occ_u8 "" UBYTE CnvRule_NumberOneToOne 1 0 0 255 ECU_ADDRESS 0x7001561D /end MEASUREMENT
/begin MEASUREMENT dataJ1939Dm1Failrs_as[11].dtc_as[8].spn_u32 "" ULONG CnvRule_NumberOneToOne 1 0 0 4294967295 ECU_ADDRESS 0x70015620 /end MEASUREMENT
/begin MEASUREMENT dataJ1939Dm1Failrs_as[11].dtc_as[8].fmi_u8 "" UBYTE CnvRule_NumberOneToOne 1 0 0 255 ECU_ADDRESS 0x70015624 /end MEASUREMENT
/begin MEASUREMENT dataJ1939Dm1Failrs_as[11].dtc_as[8].occ_u8 "" UBYTE CnvRule_NumberOneToOne 1 0 0 255 ECU_ADDRESS 0x70015625 /end MEASUREMENT
/begin MEASUREMENT dataJ1939Dm1Failrs_as[11].dtc_as[9].spn_u32 "" ULONG CnvRule_NumberOneToOne 1 0 0 4294967295 ECU_ADDRESS 0x70015628 /end MEASUREMENT
/begin MEASUREMENT dataJ1939Dm1Failrs_as[11].dtc_as[9].fmi_u8 "" UBYTE CnvRule_NumberOneToOne 1 0 0 255 ECU_ADDRESS 0x7001562C /end MEASUREMENT
/begin MEASUREMENT dataJ1939Dm1Failrs_as[11].dtc_as[9].occ_u8 "" UBYTE CnvRule_NumberOneToOne 1 0 0 255 ECU_ADDRESS 0x7001562D /end MEASUREMENT
/begin MEASUREMENT dataJ1939Dm1Failrs_as[11].dtc_as[10].spn_u32 "" ULONG CnvRule_NumberOneToOne 1 0 0 4294967295 ECU_ADDRESS 0x70015630 /end MEASUREMENT
/begin MEASUREMENT dataJ1939Dm1Failrs_as[11].dtc_as[10].fmi_u8 "" UBYTE CnvRule_NumberOneToOne 1 0 0 255 ECU_ADDRESS 0x70015634 /end MEASUREMENT
/begin MEASUREMENT dataJ1939Dm1Failrs_as[11].dtc_as[10].occ_u8 "" UBYTE CnvRule_NumberOneToOne 1 0 0 255 ECU_ADDRESS 0x70015635 /end MEASUREMENT
/begin MEASUREMENT dataJ1939Dm1Failrs_as[11].dtc_as[11].spn_u32 "" ULONG CnvRule_NumberOneToOne 1 0 0 4294967295 ECU_ADDRESS 0x70015638 /end MEASUREMENT
/begin MEASUREMENT dataJ1939Dm1Failrs_as[11].dtc_as[11].fmi_u8 "" UBYTE CnvRule_NumberOneToOne 1 0 0 255 ECU_ADDRESS 0x7001563C /end MEASUREMENT
/begin MEASUREMENT dataJ1939Dm1Failrs_as[11].dtc_as[11].occ_u8 "" UBYTE CnvRule_NumberOneToOne 1 0 0 255 ECU_ADDRESS 0x7001563D /end MEASUREMENT
/begin MEASUREMENT dataJ1939Dm1Failrs_as[11].dtc_as[12].spn_u32 "" ULONG CnvRule_NumberOneToOne 1 0 0 4294967295 ECU_ADDRESS 0x70015640 /end MEASUREMENT
/begin MEASUREMENT dataJ1939Dm1Failrs_as[11].dtc_as[12].fmi_u8 "" UBYTE CnvRule_NumberOneToOne 1 0 0 255 ECU_ADDRESS 0x70015644 /end MEASUREMENT
/begin MEASUREMENT dataJ1939Dm1Failrs_as[11].dtc_as[12].occ_u8 "" UBYTE CnvRule_NumberOneToOne 1 0 0 255 ECU_ADDRESS 0x70015645 /end MEASUREMENT
/begin MEASUREMENT dataJ1939Dm1Failrs_as[11].dtc_as[13].spn_u32 "" ULONG CnvRule_NumberOneToOne 1 0 0 4294967295 ECU_ADDRESS 0x70015648 /end MEASUREMENT
/begin MEASUREMENT dataJ1939Dm1Failrs_as[11].dtc_as[13].fmi_u8 "" UBYTE CnvRule_NumberOneToOne 1 0 0 255 ECU_ADDRESS 0x7001564C /end MEASUREMENT
/begin MEASUREMENT dataJ1939Dm1Failrs_as[11].dtc_as[13].occ_u8 "" UBYTE CnvRule_NumberOneToOne 1 0 0 255 ECU_ADDRESS 0x7001564D /end MEASUREMENT
/begin MEASUREMENT dataJ1939Dm1Failrs_as[11].dtc_as[14].spn_u32 "" ULONG CnvRule_NumberOneToOne 1 0 0 4294967295 ECU_ADDRESS 0x70015650 /end MEASUREMENT
/begin MEASUREMENT dataJ1939Dm1Failrs_as[11].dtc_as[14].fmi_u8 "" UBYTE CnvRule_NumberOneToOne 1 0 0 255 ECU_ADDRESS 0x70015654 /end MEASUREMENT
/begin MEASUREMENT dataJ1939Dm1Failrs_as[11].dtc_as[14].occ_u8 "" UBYTE CnvRule_NumberOneToOne 1 0 0 255 ECU_ADDRESS 0x70015655 /end MEASUREMENT
/begin MEASUREMENT dataJ1939Dm1Failrs_as[11].dtc_as[15].spn_u32 "" ULONG CnvRule_NumberOneToOne 1 0 0 4294967295 ECU_ADDRESS 0x70015658 /end MEASUREMENT
/begin MEASUREMENT dataJ1939Dm1Failrs_as[11].dtc_as[15].fmi_u8 "" UBYTE CnvRule_NumberOneToOne 1 0 0 255 ECU_ADDRESS 0x7001565C /end MEASUREMENT
/begin MEASUREMENT dataJ1939Dm1Failrs_as[11].dtc_as[15].occ_u8 "" UBYTE CnvRule_NumberOneToOne 1 0 0 255 ECU_ADDRESS 0x7001565D /end MEASUREMENT
/begin MEASUREMENT dataJ1939Dm1Failrs_as[11].dtc_as[16].spn_u32 "" ULONG CnvRule_NumberOneToOne 1 0 0 4294967295 ECU_ADDRESS 0x70015660 /end MEASUREMENT
/begin MEASUREMENT dataJ1939Dm1Failrs_as[11].dtc_as[16].fmi_u8 "" UBYTE CnvRule_NumberOneToOne 1 0 0 255 ECU_ADDRESS 0x70015664 /end MEASUREMENT
/begin MEASUREMENT dataJ1939Dm1Failrs_as[11].dtc_as[16].occ_u8 "" UBYTE CnvRule_NumberOneToOne 1 0 0 255 ECU_ADDRESS 0x70015665 /end MEASUREMENT
/begin MEASUREMENT dataJ1939Dm1Failrs_as[11].dtc_as[17].spn_u32 "" ULONG CnvRule_NumberOneToOne 1 0 0 4294967295 ECU_ADDRESS 0x70015668 /end MEASUREMENT
/begin MEASUREMENT dataJ1939Dm1Failrs_as[11].dtc_as[17].fmi_u8 "" UBYTE CnvRule_NumberOneToOne 1 0 0 255 ECU_ADDRESS 0x7001566C /end MEASUREMENT
/begin MEASUREMENT dataJ1939Dm1Failrs_as[11].dtc_as[17].occ_u8 "" UBYTE CnvRule_NumberOneToOne 1 0 0 255 ECU_ADDRESS 0x7001566D /end MEASUREMENT
/begin MEASUREMENT dataJ1939Dm1Failrs_as[11].dtc_as[18].spn_u32 "" ULONG CnvRule_NumberOneToOne 1 0 0 4294967295 ECU_ADDRESS 0x70015670 /end MEASUREMENT
/begin MEASUREMENT dataJ1939Dm1Failrs_as[11].dtc_as[18].fmi_u8 "" UBYTE CnvRule_NumberOneToOne 1 0 0 255 ECU_ADDRESS 0x70015674 /end MEASUREMENT
/begin MEASUREMENT dataJ1939Dm1Failrs_as[11].dtc_as[18].occ_u8 "" UBYTE CnvRule_NumberOneToOne 1 0 0 255 ECU_ADDRESS 0x70015675 /end MEASUREMENT
/begin MEASUREMENT dataJ1939Dm1Failrs_as[11].dtc_as[19].spn_u32 "" ULONG CnvRule_NumberOneToOne 1 0 0 4294967295 ECU_ADDRESS 0x70015678 /end MEASUREMENT
/begin MEASUREMENT dataJ1939Dm1Failrs_as[11].dtc_as[19].fmi_u8 "" UBYTE CnvRule_NumberOneToOne 1 0 0 255 ECU_ADDRESS 0x7001567C /end MEASUREMENT
/begin MEASUREMENT dataJ1939Dm1Failrs_as[11].dtc_as[19].occ_u8 "" UBYTE CnvRule_NumberOneToOne 1 0 0 255 ECU_ADDRESS 0x7001567D /end MEASUREMENT
/begin MEASUREMENT dataJ1939Dm1Failrs_as[11].dtc_as[20].spn_u32 "" ULONG CnvRule_NumberOneToOne 1 0 0 4294967295 ECU_ADDRESS 0x70015680 /end MEASUREMENT
/begin MEASUREMENT dataJ1939Dm1Failrs_as[11].dtc_as[20].fmi_u8 "" UBYTE CnvRule_NumberOneToOne 1 0 0 255 ECU_ADDRESS 0x70015684 /end MEASUREMENT
/begin MEASUREMENT dataJ1939Dm1Failrs_as[11].dtc_as[20].occ_u8 "" UBYTE CnvRule_NumberOneToOne 1 0 0 255 ECU_ADDRESS 0x70015685 /end MEASUREMENT
/begin MEASUREMENT dataJ1939Dm1Failrs_as[11].dtc_as "" UBYTE CnvRule_NumberOneToOne 1 0 0 255 ECU_ADDRESS 0x700155E8 ARRAY_SIZE 160 /end MEASUREMENT
/begin MEASUREMENT dataJ1939Dm1Failrs_as[12].dtc_as[1].spn_u32 "" ULONG CnvRule_NumberOneToOne 1 0 0 4294967295 ECU_ADDRESS 0x7001568C /end MEASUREMENT
/begin MEASUREMENT dataJ1939Dm1Failrs_as[12].dtc_as[1].fmi_u8 "" UBYTE CnvRule_NumberOneToOne 1 0 0 255 ECU_ADDRESS 0x70015690 /end MEASUREMENT
/begin MEASUREMENT dataJ1939Dm1Failrs_as[12].dtc_as[1].occ_u8 "" UBYTE CnvRule_NumberOneToOne 1 0 0 255 ECU_ADDRESS 0x70015691 /end MEASUREMENT
/begin MEASUREMENT dataJ1939Dm1Failrs_as[12].dtc_as[2].spn_u32 "" ULONG CnvRule_NumberOneToOne 1 0 0 4294967295 ECU_ADDRESS 0x70015694 /end MEASUREMENT
/begin MEASUREMENT dataJ1939Dm1Failrs_as[12].dtc_as[2].fmi_u8 "" UBYTE CnvRule_NumberOneToOne 1 0 0 255 ECU_ADDRESS 0x70015698 /end MEASUREMENT
/begin MEASUREMENT dataJ1939Dm1Failrs_as[12].dtc_as[2].occ_u8 "" UBYTE CnvRule_NumberOneToOne 1 0 0 255 ECU_ADDRESS 0x70015699 /end MEASUREMENT
/begin MEASUREMENT dataJ1939Dm1Failrs_as[12].dtc_as[3].spn_u32 "" ULONG CnvRule_NumberOneToOne 1 0 0 4294967295 ECU_ADDRESS 0x7001569C /end MEASUREMENT
/begin MEASUREMENT dataJ1939Dm1Failrs_as[12].dtc_as[3].fmi_u8 "" UBYTE CnvRule_NumberOneToOne 1 0 0 255 ECU_ADDRESS 0x700156A0 /end MEASUREMENT
/begin MEASUREMENT dataJ1939Dm1Failrs_as[12].dtc_as[3].occ_u8 "" UBYTE CnvRule_NumberOneToOne 1 0 0 255 ECU_ADDRESS 0x700156A1 /end MEASUREMENT
/begin MEASUREMENT dataJ1939Dm1Failrs_as[12].dtc_as[4].spn_u32 "" ULONG CnvRule_NumberOneToOne 1 0 0 4294967295 ECU_ADDRESS 0x700156A4 /end MEASUREMENT
/begin MEASUREMENT dataJ1939Dm1Failrs_as[12].dtc_as[4].fmi_u8 "" UBYTE CnvRule_NumberOneToOne 1 0 0 255 ECU_ADDRESS 0x700156A8 /end MEASUREMENT
/begin MEASUREMENT dataJ1939Dm1Failrs_as[12].dtc_as[4].occ_u8 "" UBYTE CnvRule_NumberOneToOne 1 0 0 255 ECU_ADDRESS 0x700156A9 /end MEASUREMENT
/begin MEASUREMENT dataJ1939Dm1Failrs_as[12].dtc_as[5].spn_u32 "" ULONG CnvRule_NumberOneToOne 1 0 0 4294967295 ECU_ADDRESS 0x700156AC /end MEASUREMENT
/begin MEASUREMENT dataJ1939Dm1Failrs_as[12].dtc_as[5].fmi_u8 "" UBYTE CnvRule_NumberOneToOne 1 0 0 255 ECU_ADDRESS 0x700156B0 /end MEASUREMENT
/begin MEASUREMENT dataJ1939Dm1Failrs_as[12].dtc_as[5].occ_u8 "" UBYTE CnvRule_NumberOneToOne 1 0 0 255 ECU_ADDRESS 0x700156B1 /end MEASUREMENT
/begin MEASUREMENT dataJ1939Dm1Failrs_as[12].dtc_as[6].spn_u32 "" ULONG CnvRule_NumberOneToOne 1 0 0 4294967295 ECU_ADDRESS 0x700156B4 /end MEASUREMENT
/begin MEASUREMENT dataJ1939Dm1Failrs_as[12].dtc_as[6].fmi_u8 "" UBYTE CnvRule_NumberOneToOne 1 0 0 255 ECU_ADDRESS 0x700156B8 /end MEASUREMENT
/begin MEASUREMENT dataJ1939Dm1Failrs_as[12].dtc_as[6].occ_u8 "" UBYTE CnvRule_NumberOneToOne 1 0 0 255 ECU_ADDRESS 0x700156B9 /end MEASUREMENT
/begin MEASUREMENT dataJ1939Dm1Failrs_as[12].dtc_as[7].spn_u32 "" ULONG CnvRule_NumberOneToOne 1 0 0 4294967295 ECU_ADDRESS 0x700156BC /end MEASUREMENT
/begin MEASUREMENT dataJ1939Dm1Failrs_as[12].dtc_as[7].fmi_u8 "" UBYTE CnvRule_NumberOneToOne 1 0 0 255 ECU_ADDRESS 0x700156C0 /end MEASUREMENT
/begin MEASUREMENT dataJ1939Dm1Failrs_as[12].dtc_as[7].occ_u8 "" UBYTE CnvRule_NumberOneToOne 1 0 0 255 ECU_ADDRESS 0x700156C1 /end MEASUREMENT
/begin MEASUREMENT dataJ1939Dm1Failrs_as[12].dtc_as[8].spn_u32 "" ULONG CnvRule_NumberOneToOne 1 0 0 4294967295 ECU_ADDRESS 0x700156C4 /end MEASUREMENT
/begin MEASUREMENT dataJ1939Dm1Failrs_as[12].dtc_as[8].fmi_u8 "" UBYTE CnvRule_NumberOneToOne 1 0 0 255 ECU_ADDRESS 0x700156C8 /end MEASUREMENT
/begin MEASUREMENT dataJ1939Dm1Failrs_as[12].dtc_as[8].occ_u8 "" UBYTE CnvRule_NumberOneToOne 1 0 0 255 ECU_ADDRESS 0x700156C9 /end MEASUREMENT
/begin MEASUREMENT dataJ1939Dm1Failrs_as[12].dtc_as[9].spn_u32 "" ULONG CnvRule_NumberOneToOne 1 0 0 4294967295 ECU_ADDRESS 0x700156CC /end MEASUREMENT
/begin MEASUREMENT dataJ1939Dm1Failrs_as[12].dtc_as[9].fmi_u8 "" UBYTE CnvRule_NumberOneToOne 1 0 0 255 ECU_ADDRESS 0x700156D0 /end MEASUREMENT
/begin MEASUREMENT dataJ1939Dm1Failrs_as[12].dtc_as[9].occ_u8 "" UBYTE CnvRule_NumberOneToOne 1 0 0 255 ECU_ADDRESS 0x700156D1 /end MEASUREMENT
/begin MEASUREMENT dataJ1939Dm1Failrs_as[12].dtc_as[10].spn_u32 "" ULONG CnvRule_NumberOneToOne 1 0 0 4294967295 ECU_ADDRESS 0x700156D4 /end MEASUREMENT
/begin MEASUREMENT dataJ1939Dm1Failrs_as[12].dtc_as[10].fmi_u8 "" UBYTE CnvRule_NumberOneToOne 1 0 0 255 ECU_ADDRESS 0x700156D8 /end MEASUREMENT
/begin MEASUREMENT dataJ1939Dm1Failrs_as[12].dtc_as[10].occ_u8 "" UBYTE CnvRule_NumberOneToOne 1 0 0 255 ECU_ADDRESS 0x700156D9 /end MEASUREMENT
/begin MEASUREMENT dataJ1939Dm1Failrs_as[12].dtc_as[11].spn_u32 "" ULONG CnvRule_NumberOneToOne 1 0 0 4294967295 ECU_ADDRESS 0x700156DC /end MEASUREMENT
/begin MEASUREMENT dataJ1939Dm1Failrs_as[12].dtc_as[11].fmi_u8 "" UBYTE CnvRule_NumberOneToOne 1 0 0 255 ECU_ADDRESS 0x700156E0 /end MEASUREMENT
/begin MEASUREMENT dataJ1939Dm1Failrs_as[12].dtc_as[11].occ_u8 "" UBYTE CnvRule_NumberOneToOne 1 0 0 255 ECU_ADDRESS 0x700156E1 /end MEASUREMENT
/begin MEASUREMENT dataJ1939Dm1Failrs_as[12].dtc_as[12].spn_u32 "" ULONG CnvRule_NumberOneToOne 1 0 0 4294967295 ECU_ADDRESS 0x700156E4 /end MEASUREMENT
/begin MEASUREMENT dataJ1939Dm1Failrs_as[12].dtc_as[12].fmi_u8 "" UBYTE CnvRule_NumberOneToOne 1 0 0 255 ECU_ADDRESS 0x700156E8 /end MEASUREMENT
/begin MEASUREMENT dataJ1939Dm1Failrs_as[12].dtc_as[12].occ_u8 "" UBYTE CnvRule_NumberOneToOne 1 0 0 255 ECU_ADDRESS 0x700156E9 /end MEASUREMENT
/begin MEASUREMENT dataJ1939Dm1Failrs_as[12].dtc_as[13].spn_u32 "" ULONG CnvRule_NumberOneToOne 1 0 0 4294967295 ECU_ADDRESS 0x700156EC /end MEASUREMENT
/begin MEASUREMENT dataJ1939Dm1Failrs_as[12].dtc_as[13].fmi_u8 "" UBYTE CnvRule_NumberOneToOne 1 0 0 255 ECU_ADDRESS 0x700156F0 /end MEASUREMENT
/begin MEASUREMENT dataJ1939Dm1Failrs_as[12].dtc_as[13].occ_u8 "" UBYTE CnvRule_NumberOneToOne 1 0 0 255 ECU_ADDRESS 0x700156F1 /end MEASUREMENT
/begin MEASUREMENT dataJ1939Dm1Failrs_as[12].dtc_as[14].spn_u32 "" ULONG CnvRule_NumberOneToOne 1 0 0 4294967295 ECU_ADDRESS 0x700156F4 /end MEASUREMENT
/begin MEASUREMENT dataJ1939Dm1Failrs_as[12].dtc_as[14].fmi_u8 "" UBYTE CnvRule_NumberOneToOne 1 0 0 255 ECU_ADDRESS 0x700156F8 /end MEASUREMENT
/begin MEASUREMENT dataJ1939Dm1Failrs_as[12].dtc_as[14].occ_u8 "" UBYTE CnvRule_NumberOneToOne 1 0 0 255 ECU_ADDRESS 0x700156F9 /end MEASUREMENT
/begin MEASUREMENT dataJ1939Dm1Failrs_as[12].dtc_as[15].spn_u32 "" ULONG CnvRule_NumberOneToOne 1 0 0 4294967295 ECU_ADDRESS 0x700156FC /end MEASUREMENT
/begin MEASUREMENT dataJ1939Dm1Failrs_as[12].dtc_as[15].fmi_u8 "" UBYTE CnvRule_NumberOneToOne 1 0 0 255 ECU_ADDRESS 0x70015700 /end MEASUREMENT
/begin MEASUREMENT dataJ1939Dm1Failrs_as[12].dtc_as[15].occ_u8 "" UBYTE CnvRule_NumberOneToOne 1 0 0 255 ECU_ADDRESS 0x70015701 /end MEASUREMENT
/begin MEASUREMENT dataJ1939Dm1Failrs_as[12].dtc_as[16].spn_u32 "" ULONG CnvRule_NumberOneToOne 1 0 0 4294967295 ECU_ADDRESS 0x70015704 /end MEASUREMENT
/begin MEASUREMENT dataJ1939Dm1Failrs_as[12].dtc_as[16].fmi_u8 "" UBYTE CnvRule_NumberOneToOne 1 0 0 255 ECU_ADDRESS 0x70015708 /end MEASUREMENT
/begin MEASUREMENT dataJ1939Dm1Failrs_as[12].dtc_as[16].occ_u8 "" UBYTE CnvRule_NumberOneToOne 1 0 0 255 ECU_ADDRESS 0x70015709 /end MEASUREMENT
/begin MEASUREMENT dataJ1939Dm1Failrs_as[12].dtc_as[17].spn_u32 "" ULONG CnvRule_NumberOneToOne 1 0 0 4294967295 ECU_ADDRESS 0x7001570C /end MEASUREMENT
/begin MEASUREMENT dataJ1939Dm1Failrs_as[12].dtc_as[17].fmi_u8 "" UBYTE CnvRule_NumberOneToOne 1 0 0 255 ECU_ADDRESS 0x70015710 /end MEASUREMENT
/begin MEASUREMENT dataJ1939Dm1Failrs_as[12].dtc_as[17].occ_u8 "" UBYTE CnvRule_NumberOneToOne 1 0 0 255 ECU_ADDRESS 0x70015711 /end MEASUREMENT
/begin MEASUREMENT dataJ1939Dm1Failrs_as[12].dtc_as[18].spn_u32 "" ULONG CnvRule_NumberOneToOne 1 0 0 4294967295 ECU_ADDRESS 0x70015714 /end MEASUREMENT
/begin MEASUREMENT dataJ1939Dm1Failrs_as[12].dtc_as[18].fmi_u8 "" UBYTE CnvRule_NumberOneToOne 1 0 0 255 ECU_ADDRESS 0x70015718 /end MEASUREMENT
/begin MEASUREMENT dataJ1939Dm1Failrs_as[12].dtc_as[18].occ_u8 "" UBYTE CnvRule_NumberOneToOne 1 0 0 255 ECU_ADDRESS 0x70015719 /end MEASUREMENT
/begin MEASUREMENT dataJ1939Dm1Failrs_as[12].dtc_as[19].spn_u32 "" ULONG CnvRule_NumberOneToOne 1 0 0 4294967295 ECU_ADDRESS 0x7001571C /end MEASUREMENT
/begin MEASUREMENT dataJ1939Dm1Failrs_as[12].dtc_as[19].fmi_u8 "" UBYTE CnvRule_NumberOneToOne 1 0 0 255 ECU_ADDRESS 0x70015720 /end MEASUREMENT
/begin MEASUREMENT dataJ1939Dm1Failrs_as[12].dtc_as[19].occ_u8 "" UBYTE CnvRule_NumberOneToOne 1 0 0 255 ECU_ADDRESS 0x70015721 /end MEASUREMENT
/begin MEASUREMENT dataJ1939Dm1Failrs_as[12].dtc_as[20].spn_u32 "" ULONG CnvRule_NumberOneToOne 1 0 0 4294967295 ECU_ADDRESS 0x70015724 /end MEASUREMENT
/begin MEASUREMENT dataJ1939Dm1Failrs_as[12].dtc_as[20].fmi_u8 "" UBYTE CnvRule_NumberOneToOne 1 0 0 255 ECU_ADDRESS 0x70015728 /end MEASUREMENT
/begin MEASUREMENT dataJ1939Dm1Failrs_as[12].dtc_as[20].occ_u8 "" UBYTE CnvRule_NumberOneToOne 1 0 0 255 ECU_ADDRESS 0x70015729 /end MEASUREMENT
/begin MEASUREMENT dataJ1939Dm1Failrs_as[12].dtc_as "" UBYTE CnvRule_NumberOneToOne 1 0 0 255 ECU_ADDRESS 0x7001568C ARRAY_SIZE 160 /end MEASUREMENT
/begin MEASUREMENT dataJ1939Dm1Failrs_as[13].dtc_as[1].spn_u32 "" ULONG CnvRule_NumberOneToOne 1 0 0 4294967295 ECU_ADDRESS 0x70015730 /end MEASUREMENT
/begin MEASUREMENT dataJ1939Dm1Failrs_as[13].dtc_as[1].fmi_u8 "" UBYTE CnvRule_NumberOneToOne 1 0 0 255 ECU_ADDRESS 0x70015734 /end MEASUREMENT
/begin MEASUREMENT dataJ1939Dm1Failrs_as[13].dtc_as[1].occ_u8 "" UBYTE CnvRule_NumberOneToOne 1 0 0 255 ECU_ADDRESS 0x70015735 /end MEASUREMENT
/begin MEASUREMENT dataJ1939Dm1Failrs_as[13].dtc_as[2].spn_u32 "" ULONG CnvRule_NumberOneToOne 1 0 0 4294967295 ECU_ADDRESS 0x70015738 /end MEASUREMENT
/begin MEASUREMENT dataJ1939Dm1Failrs_as[13].dtc_as[2].fmi_u8 "" UBYTE CnvRule_NumberOneToOne 1 0 0 255 ECU_ADDRESS 0x7001573C /end MEASUREMENT
/begin MEASUREMENT dataJ1939Dm1Failrs_as[13].dtc_as[2].occ_u8 "" UBYTE CnvRule_NumberOneToOne 1 0 0 255 ECU_ADDRESS 0x7001573D /end MEASUREMENT
/begin MEASUREMENT dataJ1939Dm1Failrs_as[13].dtc_as[3].spn_u32 "" ULONG CnvRule_NumberOneToOne 1 0 0 4294967295 ECU_ADDRESS 0x70015740 /end MEASUREMENT
/begin MEASUREMENT dataJ1939Dm1Failrs_as[13].dtc_as[3].fmi_u8 "" UBYTE CnvRule_NumberOneToOne 1 0 0 255 ECU_ADDRESS 0x70015744 /end MEASUREMENT
/begin MEASUREMENT dataJ1939Dm1Failrs_as[13].dtc_as[3].occ_u8 "" UBYTE CnvRule_NumberOneToOne 1 0 0 255 ECU_ADDRESS 0x70015745 /end MEASUREMENT
/begin MEASUREMENT dataJ1939Dm1Failrs_as[13].dtc_as[4].spn_u32 "" ULONG CnvRule_NumberOneToOne 1 0 0 4294967295 ECU_ADDRESS 0x70015748 /end MEASUREMENT
/begin MEASUREMENT dataJ1939Dm1Failrs_as[13].dtc_as[4].fmi_u8 "" UBYTE CnvRule_NumberOneToOne 1 0 0 255 ECU_ADDRESS 0x7001574C /end MEASUREMENT
/begin MEASUREMENT dataJ1939Dm1Failrs_as[13].dtc_as[4].occ_u8 "" UBYTE CnvRule_NumberOneToOne 1 0 0 255 ECU_ADDRESS 0x7001574D /end MEASUREMENT
/begin MEASUREMENT dataJ1939Dm1Failrs_as[13].dtc_as[5].spn_u32 "" ULONG CnvRule_NumberOneToOne 1 0 0 4294967295 ECU_ADDRESS 0x70015750 /end MEASUREMENT
/begin MEASUREMENT dataJ1939Dm1Failrs_as[13].dtc_as[5].fmi_u8 "" UBYTE CnvRule_NumberOneToOne 1 0 0 255 ECU_ADDRESS 0x70015754 /end MEASUREMENT
/begin MEASUREMENT dataJ1939Dm1Failrs_as[13].dtc_as[5].occ_u8 "" UBYTE CnvRule_NumberOneToOne 1 0 0 255 ECU_ADDRESS 0x70015755 /end MEASUREMENT
/begin MEASUREMENT dataJ1939Dm1Failrs_as[13].dtc_as[6].spn_u32 "" ULONG CnvRule_NumberOneToOne 1 0 0 4294967295 ECU_ADDRESS 0x70015758 /end MEASUREMENT
/begin MEASUREMENT dataJ1939Dm1Failrs_as[13].dtc_as[6].fmi_u8 "" UBYTE CnvRule_NumberOneToOne 1 0 0 255 ECU_ADDRESS 0x7001575C /end MEASUREMENT
/begin MEASUREMENT dataJ1939Dm1Failrs_as[13].dtc_as[6].occ_u8 "" UBYTE CnvRule_NumberOneToOne 1 0 0 255 ECU_ADDRESS 0x7001575D /end MEASUREMENT
/begin MEASUREMENT dataJ1939Dm1Failrs_as[13].dtc_as[7].spn_u32 "" ULONG CnvRule_NumberOneToOne 1 0 0 4294967295 ECU_ADDRESS 0x70015760 /end MEASUREMENT
/begin MEASUREMENT dataJ1939Dm1Failrs_as[13].dtc_as[7].fmi_u8 "" UBYTE CnvRule_NumberOneToOne 1 0 0 255 ECU_ADDRESS 0x70015764 /end MEASUREMENT
/begin MEASUREMENT dataJ1939Dm1Failrs_as[13].dtc_as[7].occ_u8 "" UBYTE CnvRule_NumberOneToOne 1 0 0 255 ECU_ADDRESS 0x70015765 /end MEASUREMENT
/begin MEASUREMENT dataJ1939Dm1Failrs_as[13].dtc_as[8].spn_u32 "" ULONG CnvRule_NumberOneToOne 1 0 0 4294967295 ECU_ADDRESS 0x70015768 /end MEASUREMENT
/begin MEASUREMENT dataJ1939Dm1Failrs_as[13].dtc_as[8].fmi_u8 "" UBYTE CnvRule_NumberOneToOne 1 0 0 255 ECU_ADDRESS 0x7001576C /end MEASUREMENT
/begin MEASUREMENT dataJ1939Dm1Failrs_as[13].dtc_as[8].occ_u8 "" UBYTE CnvRule_NumberOneToOne 1 0 0 255 ECU_ADDRESS 0x7001576D /end MEASUREMENT
/begin MEASUREMENT dataJ1939Dm1Failrs_as[13].dtc_as[9].spn_u32 "" ULONG CnvRule_NumberOneToOne 1 0 0 4294967295 ECU_ADDRESS 0x70015770 /end MEASUREMENT
/begin MEASUREMENT dataJ1939Dm1Failrs_as[13].dtc_as[9].fmi_u8 "" UBYTE CnvRule_NumberOneToOne 1 0 0 255 ECU_ADDRESS 0x70015774 /end MEASUREMENT
/begin MEASUREMENT dataJ1939Dm1Failrs_as[13].dtc_as[9].occ_u8 "" UBYTE CnvRule_NumberOneToOne 1 0 0 255 ECU_ADDRESS 0x70015775 /end MEASUREMENT
/begin MEASUREMENT dataJ1939Dm1Failrs_as[13].dtc_as[10].spn_u32 "" ULONG CnvRule_NumberOneToOne 1 0 0 4294967295 ECU_ADDRESS 0x70015778 /end MEASUREMENT
/begin MEASUREMENT dataJ1939Dm1Failrs_as[13].dtc_as[10].fmi_u8 "" UBYTE CnvRule_NumberOneToOne 1 0 0 255 ECU_ADDRESS 0x7001577C /end MEASUREMENT
/begin MEASUREMENT dataJ1939Dm1Failrs_as[13].dtc_as[10].occ_u8 "" UBYTE CnvRule_NumberOneToOne 1 0 0 255 ECU_ADDRESS 0x7001577D /end MEASUREMENT
/begin MEASUREMENT dataJ1939Dm1Failrs_as[13].dtc_as[11].spn_u32 "" ULONG CnvRule_NumberOneToOne 1 0 0 4294967295 ECU_ADDRESS 0x70015780 /end MEASUREMENT
/begin MEASUREMENT dataJ1939Dm1Failrs_as[13].dtc_as[11].fmi_u8 "" UBYTE CnvRule_NumberOneToOne 1 0 0 255 ECU_ADDRESS 0x70015784 /end MEASUREMENT
/begin MEASUREMENT dataJ1939Dm1Failrs_as[13].dtc_as[11].occ_u8 "" UBYTE CnvRule_NumberOneToOne 1 0 0 255 ECU_ADDRESS 0x70015785 /end MEASUREMENT
/begin MEASUREMENT dataJ1939Dm1Failrs_as[13].dtc_as[12].spn_u32 "" ULONG CnvRule_NumberOneToOne 1 0 0 4294967295 ECU_ADDRESS 0x70015788 /end MEASUREMENT
/begin MEASUREMENT dataJ1939Dm1Failrs_as[13].dtc_as[12].fmi_u8 "" UBYTE CnvRule_NumberOneToOne 1 0 0 255 ECU_ADDRESS 0x7001578C /end MEASUREMENT
/begin MEASUREMENT dataJ1939Dm1Failrs_as[13].dtc_as[12].occ_u8 "" UBYTE CnvRule_NumberOneToOne 1 0 0 255 ECU_ADDRESS 0x7001578D /end MEASUREMENT
/begin MEASUREMENT dataJ1939Dm1Failrs_as[13].dtc_as[13].spn_u32 "" ULONG CnvRule_NumberOneToOne 1 0 0 4294967295 ECU_ADDRESS 0x70015790 /end MEASUREMENT
/begin MEASUREMENT dataJ1939Dm1Failrs_as[13].dtc_as[13].fmi_u8 "" UBYTE CnvRule_NumberOneToOne 1 0 0 255 ECU_ADDRESS 0x70015794 /end MEASUREMENT
/begin MEASUREMENT dataJ1939Dm1Failrs_as[13].dtc_as[13].occ_u8 "" UBYTE CnvRule_NumberOneToOne 1 0 0 255 ECU_ADDRESS 0x70015795 /end MEASUREMENT
/begin MEASUREMENT dataJ1939Dm1Failrs_as[13].dtc_as[14].spn_u32 "" ULONG CnvRule_NumberOneToOne 1 0 0 4294967295 ECU_ADDRESS 0x70015798 /end MEASUREMENT
/begin MEASUREMENT dataJ1939Dm1Failrs_as[13].dtc_as[14].fmi_u8 "" UBYTE CnvRule_NumberOneToOne 1 0 0 255 ECU_ADDRESS 0x7001579C /end MEASUREMENT
/begin MEASUREMENT dataJ1939Dm1Failrs_as[13].dtc_as[14].occ_u8 "" UBYTE CnvRule_NumberOneToOne 1 0 0 255 ECU_ADDRESS 0x7001579D /end MEASUREMENT
/begin MEASUREMENT dataJ1939Dm1Failrs_as[13].dtc_as[15].spn_u32 "" ULONG CnvRule_NumberOneToOne 1 0 0 4294967295 ECU_ADDRESS 0x700157A0 /end MEASUREMENT
/begin MEASUREMENT dataJ1939Dm1Failrs_as[13].dtc_as[15].fmi_u8 "" UBYTE CnvRule_NumberOneToOne 1 0 0 255 ECU_ADDRESS 0x700157A4 /end MEASUREMENT
/begin MEASUREMENT dataJ1939Dm1Failrs_as[13].dtc_as[15].occ_u8 "" UBYTE CnvRule_NumberOneToOne 1 0 0 255 ECU_ADDRESS 0x700157A5 /end MEASUREMENT
/begin MEASUREMENT dataJ1939Dm1Failrs_as[13].dtc_as[16].spn_u32 "" ULONG CnvRule_NumberOneToOne 1 0 0 4294967295 ECU_ADDRESS 0x700157A8 /end MEASUREMENT
/begin MEASUREMENT dataJ1939Dm1Failrs_as[13].dtc_as[16].fmi_u8 "" UBYTE CnvRule_NumberOneToOne 1 0 0 255 ECU_ADDRESS 0x700157AC /end MEASUREMENT
/begin MEASUREMENT dataJ1939Dm1Failrs_as[13].dtc_as[16].occ_u8 "" UBYTE CnvRule_NumberOneToOne 1 0 0 255 ECU_ADDRESS 0x700157AD /end MEASUREMENT
/begin MEASUREMENT dataJ1939Dm1Failrs_as[13].dtc_as[17].spn_u32 "" ULONG CnvRule_NumberOneToOne 1 0 0 4294967295 ECU_ADDRESS 0x700157B0 /end MEASUREMENT
/begin MEASUREMENT dataJ1939Dm1Failrs_as[13].dtc_as[17].fmi_u8 "" UBYTE CnvRule_NumberOneToOne 1 0 0 255 ECU_ADDRESS 0x700157B4 /end MEASUREMENT
/begin MEASUREMENT dataJ1939Dm1Failrs_as[13].dtc_as[17].occ_u8 "" UBYTE CnvRule_NumberOneToOne 1 0 0 255 ECU_ADDRESS 0x700157B5 /end MEASUREMENT
/begin MEASUREMENT dataJ1939Dm1Failrs_as[13].dtc_as[18].spn_u32 "" ULONG CnvRule_NumberOneToOne 1 0 0 4294967295 ECU_ADDRESS 0x700157B8 /end MEASUREMENT
/begin MEASUREMENT dataJ1939Dm1Failrs_as[13].dtc_as[18].fmi_u8 "" UBYTE CnvRule_NumberOneToOne 1 0 0 255 ECU_ADDRESS 0x700157BC /end MEASUREMENT
/begin MEASUREMENT dataJ1939Dm1Failrs_as[13].dtc_as[18].occ_u8 "" UBYTE CnvRule_NumberOneToOne 1 0 0 255 ECU_ADDRESS 0x700157BD /end MEASUREMENT
/begin MEASUREMENT dataJ1939Dm1Failrs_as[13].dtc_as[19].spn_u32 "" ULONG CnvRule_NumberOneToOne 1 0 0 4294967295 ECU_ADDRESS 0x700157C0 /end MEASUREMENT
/begin MEASUREMENT dataJ1939Dm1Failrs_as[13].dtc_as[19].fmi_u8 "" UBYTE CnvRule_NumberOneToOne 1 0 0 255 ECU_ADDRESS 0x700157C4 /end MEASUREMENT
/begin MEASUREMENT dataJ1939Dm1Failrs_as[13].dtc_as[19].occ_u8 "" UBYTE CnvRule_NumberOneToOne 1 0 0 255 ECU_ADDRESS 0x700157C5 /end MEASUREMENT
/begin MEASUREMENT dataJ1939Dm1Failrs_as[13].dtc_as[20].spn_u32 "" ULONG CnvRule_NumberOneToOne 1 0 0 4294967295 ECU_ADDRESS 0x700157C8 /end MEASUREMENT
/begin MEASUREMENT dataJ1939Dm1Failrs_as[13].dtc_as[20].fmi_u8 "" UBYTE CnvRule_NumberOneToOne 1 0 0 255 ECU_ADDRESS 0x700157CC /end MEASUREMENT
/begin MEASUREMENT dataJ1939Dm1Failrs_as[13].dtc_as[20].occ_u8 "" UBYTE CnvRule_NumberOneToOne 1 0 0 255 ECU_ADDRESS 0x700157CD /end MEASUREMENT
/begin MEASUREMENT dataJ1939Dm1Failrs_as[13].dtc_as "" UBYTE CnvRule_NumberOneToOne 1 0 0 255 ECU_ADDRESS 0x70015730 ARRAY_SIZE 160 /end MEASUREMENT
/begin MEASUREMENT dataJ1939Dm1Failrs_as[14].dtc_as[1].spn_u32 "" ULONG CnvRule_NumberOneToOne 1 0 0 4294967295 ECU_ADDRESS 0x700157D4 /end MEASUREMENT
/begin MEASUREMENT dataJ1939Dm1Failrs_as[14].dtc_as[1].fmi_u8 "" UBYTE CnvRule_NumberOneToOne 1 0 0 255 ECU_ADDRESS 0x700157D8 /end MEASUREMENT
/begin MEASUREMENT dataJ1939Dm1Failrs_as[14].dtc_as[1].occ_u8 "" UBYTE CnvRule_NumberOneToOne 1 0 0 255 ECU_ADDRESS 0x700157D9 /end MEASUREMENT
/begin MEASUREMENT dataJ1939Dm1Failrs_as[14].dtc_as[2].spn_u32 "" ULONG CnvRule_NumberOneToOne 1 0 0 4294967295 ECU_ADDRESS 0x700157DC /end MEASUREMENT
/begin MEASUREMENT dataJ1939Dm1Failrs_as[14].dtc_as[2].fmi_u8 "" UBYTE CnvRule_NumberOneToOne 1 0 0 255 ECU_ADDRESS 0x700157E0 /end MEASUREMENT
/begin MEASUREMENT dataJ1939Dm1Failrs_as[14].dtc_as[2].occ_u8 "" UBYTE CnvRule_NumberOneToOne 1 0 0 255 ECU_ADDRESS 0x700157E1 /end MEASUREMENT
/begin MEASUREMENT dataJ1939Dm1Failrs_as[14].dtc_as[3].spn_u32 "" ULONG CnvRule_NumberOneToOne 1 0 0 4294967295 ECU_ADDRESS 0x700157E4 /end MEASUREMENT
/begin MEASUREMENT dataJ1939Dm1Failrs_as[14].dtc_as[3].fmi_u8 "" UBYTE CnvRule_NumberOneToOne 1 0 0 255 ECU_ADDRESS 0x700157E8 /end MEASUREMENT
/begin MEASUREMENT dataJ1939Dm1Failrs_as[14].dtc_as[3].occ_u8 "" UBYTE CnvRule_NumberOneToOne 1 0 0 255 ECU_ADDRESS 0x700157E9 /end MEASUREMENT
/begin MEASUREMENT dataJ1939Dm1Failrs_as[14].dtc_as[4].spn_u32 "" ULONG CnvRule_NumberOneToOne 1 0 0 4294967295 ECU_ADDRESS 0x700157EC /end MEASUREMENT
/begin MEASUREMENT dataJ1939Dm1Failrs_as[14].dtc_as[4].fmi_u8 "" UBYTE CnvRule_NumberOneToOne 1 0 0 255 ECU_ADDRESS 0x700157F0 /end MEASUREMENT
/begin MEASUREMENT dataJ1939Dm1Failrs_as[14].dtc_as[4].occ_u8 "" UBYTE CnvRule_NumberOneToOne 1 0 0 255 ECU_ADDRESS 0x700157F1 /end MEASUREMENT
/begin MEASUREMENT dataJ1939Dm1Failrs_as[14].dtc_as[5].spn_u32 "" ULONG CnvRule_NumberOneToOne 1 0 0 4294967295 ECU_ADDRESS 0x700157F4 /end MEASUREMENT
/begin MEASUREMENT dataJ1939Dm1Failrs_as[14].dtc_as[5].fmi_u8 "" UBYTE CnvRule_NumberOneToOne 1 0 0 255 ECU_ADDRESS 0x700157F8 /end MEASUREMENT
/begin MEASUREMENT dataJ1939Dm1Failrs_as[14].dtc_as[5].occ_u8 "" UBYTE CnvRule_NumberOneToOne 1 0 0 255 ECU_ADDRESS 0x700157F9 /end MEASUREMENT
/begin MEASUREMENT dataJ1939Dm1Failrs_as[14].dtc_as[6].spn_u32 "" ULONG CnvRule_NumberOneToOne 1 0 0 4294967295 ECU_ADDRESS 0x700157FC /end MEASUREMENT
/begin MEASUREMENT dataJ1939Dm1Failrs_as[14].dtc_as[6].fmi_u8 "" UBYTE CnvRule_NumberOneToOne 1 0 0 255 ECU_ADDRESS 0x70015800 /end MEASUREMENT
/begin MEASUREMENT dataJ1939Dm1Failrs_as[14].dtc_as[6].occ_u8 "" UBYTE CnvRule_NumberOneToOne 1 0 0 255 ECU_ADDRESS 0x70015801 /end MEASUREMENT
/begin MEASUREMENT dataJ1939Dm1Failrs_as[14].dtc_as[7].spn_u32 "" ULONG CnvRule_NumberOneToOne 1 0 0 4294967295 ECU_ADDRESS 0x70015804 /end MEASUREMENT
/begin MEASUREMENT dataJ1939Dm1Failrs_as[14].dtc_as[7].fmi_u8 "" UBYTE CnvRule_NumberOneToOne 1 0 0 255 ECU_ADDRESS 0x70015808 /end MEASUREMENT
/begin MEASUREMENT dataJ1939Dm1Failrs_as[14].dtc_as[7].occ_u8 "" UBYTE CnvRule_NumberOneToOne 1 0 0 255 ECU_ADDRESS 0x70015809 /end MEASUREMENT
/begin MEASUREMENT dataJ1939Dm1Failrs_as[14].dtc_as[8].spn_u32 "" ULONG CnvRule_NumberOneToOne 1 0 0 4294967295 ECU_ADDRESS 0x7001580C /end MEASUREMENT
/begin MEASUREMENT dataJ1939Dm1Failrs_as[14].dtc_as[8].fmi_u8 "" UBYTE CnvRule_NumberOneToOne 1 0 0 255 ECU_ADDRESS 0x70015810 /end MEASUREMENT
/begin MEASUREMENT dataJ1939Dm1Failrs_as[14].dtc_as[8].occ_u8 "" UBYTE CnvRule_NumberOneToOne 1 0 0 255 ECU_ADDRESS 0x70015811 /end MEASUREMENT
/begin MEASUREMENT dataJ1939Dm1Failrs_as[14].dtc_as[9].spn_u32 "" ULONG CnvRule_NumberOneToOne 1 0 0 4294967295 ECU_ADDRESS 0x70015814 /end MEASUREMENT
/begin MEASUREMENT dataJ1939Dm1Failrs_as[14].dtc_as[9].fmi_u8 "" UBYTE CnvRule_NumberOneToOne 1 0 0 255 ECU_ADDRESS 0x70015818 /end MEASUREMENT
/begin MEASUREMENT dataJ1939Dm1Failrs_as[14].dtc_as[9].occ_u8 "" UBYTE CnvRule_NumberOneToOne 1 0 0 255 ECU_ADDRESS 0x70015819 /end MEASUREMENT
/begin MEASUREMENT dataJ1939Dm1Failrs_as[14].dtc_as[10].spn_u32 "" ULONG CnvRule_NumberOneToOne 1 0 0 4294967295 ECU_ADDRESS 0x7001581C /end MEASUREMENT
/begin MEASUREMENT dataJ1939Dm1Failrs_as[14].dtc_as[10].fmi_u8 "" UBYTE CnvRule_NumberOneToOne 1 0 0 255 ECU_ADDRESS 0x70015820 /end MEASUREMENT
/begin MEASUREMENT dataJ1939Dm1Failrs_as[14].dtc_as[10].occ_u8 "" UBYTE CnvRule_NumberOneToOne 1 0 0 255 ECU_ADDRESS 0x70015821 /end MEASUREMENT
/begin MEASUREMENT dataJ1939Dm1Failrs_as[14].dtc_as[11].spn_u32 "" ULONG CnvRule_NumberOneToOne 1 0 0 4294967295 ECU_ADDRESS 0x70015824 /end MEASUREMENT
/begin MEASUREMENT dataJ1939Dm1Failrs_as[14].dtc_as[11].fmi_u8 "" UBYTE CnvRule_NumberOneToOne 1 0 0 255 ECU_ADDRESS 0x70015828 /end MEASUREMENT
/begin MEASUREMENT dataJ1939Dm1Failrs_as[14].dtc_as[11].occ_u8 "" UBYTE CnvRule_NumberOneToOne 1 0 0 255 ECU_ADDRESS 0x70015829 /end MEASUREMENT
/begin MEASUREMENT dataJ1939Dm1Failrs_as[14].dtc_as[12].spn_u32 "" ULONG CnvRule_NumberOneToOne 1 0 0 4294967295 ECU_ADDRESS 0x7001582C /end MEASUREMENT
/begin MEASUREMENT dataJ1939Dm1Failrs_as[14].dtc_as[12].fmi_u8 "" UBYTE CnvRule_NumberOneToOne 1 0 0 255 ECU_ADDRESS 0x70015830 /end MEASUREMENT
/begin MEASUREMENT dataJ1939Dm1Failrs_as[14].dtc_as[12].occ_u8 "" UBYTE CnvRule_NumberOneToOne 1 0 0 255 ECU_ADDRESS 0x70015831 /end MEASUREMENT
/begin MEASUREMENT dataJ1939Dm1Failrs_as[14].dtc_as[13].spn_u32 "" ULONG CnvRule_NumberOneToOne 1 0 0 4294967295 ECU_ADDRESS 0x70015834 /end MEASUREMENT
/begin MEASUREMENT dataJ1939Dm1Failrs_as[14].dtc_as[13].fmi_u8 "" UBYTE CnvRule_NumberOneToOne 1 0 0 255 ECU_ADDRESS 0x70015838 /end MEASUREMENT
/begin MEASUREMENT dataJ1939Dm1Failrs_as[14].dtc_as[13].occ_u8 "" UBYTE CnvRule_NumberOneToOne 1 0 0 255 ECU_ADDRESS 0x70015839 /end MEASUREMENT
/begin MEASUREMENT dataJ1939Dm1Failrs_as[14].dtc_as[14].spn_u32 "" ULONG CnvRule_NumberOneToOne 1 0 0 4294967295 ECU_ADDRESS 0x7001583C /end MEASUREMENT
/begin MEASUREMENT dataJ1939Dm1Failrs_as[14].dtc_as[14].fmi_u8 "" UBYTE CnvRule_NumberOneToOne 1 0 0 255 ECU_ADDRESS 0x70015840 /end MEASUREMENT
/begin MEASUREMENT dataJ1939Dm1Failrs_as[14].dtc_as[14].occ_u8 "" UBYTE CnvRule_NumberOneToOne 1 0 0 255 ECU_ADDRESS 0x70015841 /end MEASUREMENT
/begin MEASUREMENT dataJ1939Dm1Failrs_as[14].dtc_as[15].spn_u32 "" ULONG CnvRule_NumberOneToOne 1 0 0 4294967295 ECU_ADDRESS 0x70015844 /end MEASUREMENT
/begin MEASUREMENT dataJ1939Dm1Failrs_as[14].dtc_as[15].fmi_u8 "" UBYTE CnvRule_NumberOneToOne 1 0 0 255 ECU_ADDRESS 0x70015848 /end MEASUREMENT
/begin MEASUREMENT dataJ1939Dm1Failrs_as[14].dtc_as[15].occ_u8 "" UBYTE CnvRule_NumberOneToOne 1 0 0 255 ECU_ADDRESS 0x70015849 /end MEASUREMENT
/begin MEASUREMENT dataJ1939Dm1Failrs_as[14].dtc_as[16].spn_u32 "" ULONG CnvRule_NumberOneToOne 1 0 0 4294967295 ECU_ADDRESS 0x7001584C /end MEASUREMENT
/begin MEASUREMENT dataJ1939Dm1Failrs_as[14].dtc_as[16].fmi_u8 "" UBYTE CnvRule_NumberOneToOne 1 0 0 255 ECU_ADDRESS 0x70015850 /end MEASUREMENT
/begin MEASUREMENT dataJ1939Dm1Failrs_as[14].dtc_as[16].occ_u8 "" UBYTE CnvRule_NumberOneToOne 1 0 0 255 ECU_ADDRESS 0x70015851 /end MEASUREMENT
/begin MEASUREMENT dataJ1939Dm1Failrs_as[14].dtc_as[17].spn_u32 "" ULONG CnvRule_NumberOneToOne 1 0 0 4294967295 ECU_ADDRESS 0x70015854 /end MEASUREMENT
/begin MEASUREMENT dataJ1939Dm1Failrs_as[14].dtc_as[17].fmi_u8 "" UBYTE CnvRule_NumberOneToOne 1 0 0 255 ECU_ADDRESS 0x70015858 /end MEASUREMENT
/begin MEASUREMENT dataJ1939Dm1Failrs_as[14].dtc_as[17].occ_u8 "" UBYTE CnvRule_NumberOneToOne 1 0 0 255 ECU_ADDRESS 0x70015859 /end MEASUREMENT
/begin MEASUREMENT dataJ1939Dm1Failrs_as[14].dtc_as[18].spn_u32 "" ULONG CnvRule_NumberOneToOne 1 0 0 4294967295 ECU_ADDRESS 0x7001585C /end MEASUREMENT
/begin MEASUREMENT dataJ1939Dm1Failrs_as[14].dtc_as[18].fmi_u8 "" UBYTE CnvRule_NumberOneToOne 1 0 0 255 ECU_ADDRESS 0x70015860 /end MEASUREMENT
/begin MEASUREMENT dataJ1939Dm1Failrs_as[14].dtc_as[18].occ_u8 "" UBYTE CnvRule_NumberOneToOne 1 0 0 255 ECU_ADDRESS 0x70015861 /end MEASUREMENT
/begin MEASUREMENT dataJ1939Dm1Failrs_as[14].dtc_as[19].spn_u32 "" ULONG CnvRule_NumberOneToOne 1 0 0 4294967295 ECU_ADDRESS 0x70015864 /end MEASUREMENT
/begin MEASUREMENT dataJ1939Dm1Failrs_as[14].dtc_as[19].fmi_u8 "" UBYTE CnvRule_NumberOneToOne 1 0 0 255 ECU_ADDRESS 0x70015868 /end MEASUREMENT
/begin MEASUREMENT dataJ1939Dm1Failrs_as[14].dtc_as[19].occ_u8 "" UBYTE CnvRule_NumberOneToOne 1 0 0 255 ECU_ADDRESS 0x70015869 /end MEASUREMENT
/begin MEASUREMENT dataJ1939Dm1Failrs_as[14].dtc_as[20].spn_u32 "" ULONG CnvRule_NumberOneToOne 1 0 0 4294967295 ECU_ADDRESS 0x7001586C /end MEASUREMENT
/begin MEASUREMENT dataJ1939Dm1Failrs_as[14].dtc_as[20].fmi_u8 "" UBYTE CnvRule_NumberOneToOne 1 0 0 255 ECU_ADDRESS 0x70015870 /end MEASUREMENT
/begin MEASUREMENT dataJ1939Dm1Failrs_as[14].dtc_as[20].occ_u8 "" UBYTE CnvRule_NumberOneToOne 1 0 0 255 ECU_ADDRESS 0x70015871 /end MEASUREMENT
/begin MEASUREMENT dataJ1939Dm1Failrs_as[14].dtc_as "" UBYTE CnvRule_NumberOneToOne 1 0 0 255 ECU_ADDRESS 0x700157D4 ARRAY_SIZE 160 /end MEASUREMENT
/begin MEASUREMENT dataJ1939Dm1Failrs_as[15].dtc_as[1].spn_u32 "" ULONG CnvRule_NumberOneToOne 1 0 0 4294967295 ECU_ADDRESS 0x70015878 /end MEASUREMENT
/begin MEASUREMENT dataJ1939Dm1Failrs_as[15].dtc_as[1].fmi_u8 "" UBYTE CnvRule_NumberOneToOne 1 0 0 255 ECU_ADDRESS 0x7001587C /end MEASUREMENT
/begin MEASUREMENT dataJ1939Dm1Failrs_as[15].dtc_as[1].occ_u8 "" UBYTE CnvRule_NumberOneToOne 1 0 0 255 ECU_ADDRESS 0x7001587D /end MEASUREMENT
/begin MEASUREMENT dataJ1939Dm1Failrs_as[15].dtc_as[2].spn_u32 "" ULONG CnvRule_NumberOneToOne 1 0 0 4294967295 ECU_ADDRESS 0x70015880 /end MEASUREMENT
/begin MEASUREMENT dataJ1939Dm1Failrs_as[15].dtc_as[2].fmi_u8 "" UBYTE CnvRule_NumberOneToOne 1 0 0 255 ECU_ADDRESS 0x70015884 /end MEASUREMENT
/begin MEASUREMENT dataJ1939Dm1Failrs_as[15].dtc_as[2].occ_u8 "" UBYTE CnvRule_NumberOneToOne 1 0 0 255 ECU_ADDRESS 0x70015885 /end MEASUREMENT
/begin MEASUREMENT dataJ1939Dm1Failrs_as[15].dtc_as[3].spn_u32 "" ULONG CnvRule_NumberOneToOne 1 0 0 4294967295 ECU_ADDRESS 0x70015888 /end MEASUREMENT
/begin MEASUREMENT dataJ1939Dm1Failrs_as[15].dtc_as[3].fmi_u8 "" UBYTE CnvRule_NumberOneToOne 1 0 0 255 ECU_ADDRESS 0x7001588C /end MEASUREMENT
/begin MEASUREMENT dataJ1939Dm1Failrs_as[15].dtc_as[3].occ_u8 "" UBYTE CnvRule_NumberOneToOne 1 0 0 255 ECU_ADDRESS 0x7001588D /end MEASUREMENT
/begin MEASUREMENT dataJ1939Dm1Failrs_as[15].dtc_as[4].spn_u32 "" ULONG CnvRule_NumberOneToOne 1 0 0 4294967295 ECU_ADDRESS 0x70015890 /end MEASUREMENT
/begin MEASUREMENT dataJ1939Dm1Failrs_as[15].dtc_as[4].fmi_u8 "" UBYTE CnvRule_NumberOneToOne 1 0 0 255 ECU_ADDRESS 0x70015894 /end MEASUREMENT
/begin MEASUREMENT dataJ1939Dm1Failrs_as[15].dtc_as[4].occ_u8 "" UBYTE CnvRule_NumberOneToOne 1 0 0 255 ECU_ADDRESS 0x70015895 /end MEASUREMENT
/begin MEASUREMENT dataJ1939Dm1Failrs_as[15].dtc_as[5].spn_u32 "" ULONG CnvRule_NumberOneToOne 1 0 0 4294967295 ECU_ADDRESS 0x70015898 /end MEASUREMENT
/begin MEASUREMENT dataJ1939Dm1Failrs_as[15].dtc_as[5].fmi_u8 "" UBYTE CnvRule_NumberOneToOne 1 0 0 255 ECU_ADDRESS 0x7001589C /end MEASUREMENT
/begin MEASUREMENT dataJ1939Dm1Failrs_as[15].dtc_as[5].occ_u8 "" UBYTE CnvRule_NumberOneToOne 1 0 0 255 ECU_ADDRESS 0x7001589D /end MEASUREMENT
/begin MEASUREMENT dataJ1939Dm1Failrs_as[15].dtc_as[6].spn_u32 "" ULONG CnvRule_NumberOneToOne 1 0 0 4294967295 ECU_ADDRESS 0x700158A0 /end MEASUREMENT
/begin MEASUREMENT dataJ1939Dm1Failrs_as[15].dtc_as[6].fmi_u8 "" UBYTE CnvRule_NumberOneToOne 1 0 0 255 ECU_ADDRESS 0x700158A4 /end MEASUREMENT
/begin MEASUREMENT dataJ1939Dm1Failrs_as[15].dtc_as[6].occ_u8 "" UBYTE CnvRule_NumberOneToOne 1 0 0 255 ECU_ADDRESS 0x700158A5 /end MEASUREMENT
/begin MEASUREMENT dataJ1939Dm1Failrs_as[15].dtc_as[7].spn_u32 "" ULONG CnvRule_NumberOneToOne 1 0 0 4294967295 ECU_ADDRESS 0x700158A8 /end MEASUREMENT
/begin MEASUREMENT dataJ1939Dm1Failrs_as[15].dtc_as[7].fmi_u8 "" UBYTE CnvRule_NumberOneToOne 1 0 0 255 ECU_ADDRESS 0x700158AC /end MEASUREMENT
/begin MEASUREMENT dataJ1939Dm1Failrs_as[15].dtc_as[7].occ_u8 "" UBYTE CnvRule_NumberOneToOne 1 0 0 255 ECU_ADDRESS 0x700158AD /end MEASUREMENT
/begin MEASUREMENT dataJ1939Dm1Failrs_as[15].dtc_as[8].spn_u32 "" ULONG CnvRule_NumberOneToOne 1 0 0 4294967295 ECU_ADDRESS 0x700158B0 /end MEASUREMENT
/begin MEASUREMENT dataJ1939Dm1Failrs_as[15].dtc_as[8].fmi_u8 "" UBYTE CnvRule_NumberOneToOne 1 0 0 255 ECU_ADDRESS 0x700158B4 /end MEASUREMENT
/begin MEASUREMENT dataJ1939Dm1Failrs_as[15].dtc_as[8].occ_u8 "" UBYTE CnvRule_NumberOneToOne 1 0 0 255 ECU_ADDRESS 0x700158B5 /end MEASUREMENT
/begin MEASUREMENT dataJ1939Dm1Failrs_as[15].dtc_as[9].spn_u32 "" ULONG CnvRule_NumberOneToOne 1 0 0 4294967295 ECU_ADDRESS 0x700158B8 /end MEASUREMENT
/begin MEASUREMENT dataJ1939Dm1Failrs_as[15].dtc_as[9].fmi_u8 "" UBYTE CnvRule_NumberOneToOne 1 0 0 255 ECU_ADDRESS 0x700158BC /end MEASUREMENT
/begin MEASUREMENT dataJ1939Dm1Failrs_as[15].dtc_as[9].occ_u8 "" UBYTE CnvRule_NumberOneToOne 1 0 0 255 ECU_ADDRESS 0x700158BD /end MEASUREMENT
/begin MEASUREMENT dataJ1939Dm1Failrs_as[15].dtc_as[10].spn_u32 "" ULONG CnvRule_NumberOneToOne 1 0 0 4294967295 ECU_ADDRESS 0x700158C0 /end MEASUREMENT
/begin MEASUREMENT dataJ1939Dm1Failrs_as[15].dtc_as[10].fmi_u8 "" UBYTE CnvRule_NumberOneToOne 1 0 0 255 ECU_ADDRESS 0x700158C4 /end MEASUREMENT
/begin MEASUREMENT dataJ1939Dm1Failrs_as[15].dtc_as[10].occ_u8 "" UBYTE CnvRule_NumberOneToOne 1 0 0 255 ECU_ADDRESS 0x700158C5 /end MEASUREMENT
/begin MEASUREMENT dataJ1939Dm1Failrs_as[15].dtc_as[11].spn_u32 "" ULONG CnvRule_NumberOneToOne 1 0 0 4294967295 ECU_ADDRESS 0x700158C8 /end MEASUREMENT
/begin MEASUREMENT dataJ1939Dm1Failrs_as[15].dtc_as[11].fmi_u8 "" UBYTE CnvRule_NumberOneToOne 1 0 0 255 ECU_ADDRESS 0x700158CC /end MEASUREMENT
/begin MEASUREMENT dataJ1939Dm1Failrs_as[15].dtc_as[11].occ_u8 "" UBYTE CnvRule_NumberOneToOne 1 0 0 255 ECU_ADDRESS 0x700158CD /end MEASUREMENT
/begin MEASUREMENT dataJ1939Dm1Failrs_as[15].dtc_as[12].spn_u32 "" ULONG CnvRule_NumberOneToOne 1 0 0 4294967295 ECU_ADDRESS 0x700158D0 /end MEASUREMENT
/begin MEASUREMENT dataJ1939Dm1Failrs_as[15].dtc_as[12].fmi_u8 "" UBYTE CnvRule_NumberOneToOne 1 0 0 255 ECU_ADDRESS 0x700158D4 /end MEASUREMENT
/begin MEASUREMENT dataJ1939Dm1Failrs_as[15].dtc_as[12].occ_u8 "" UBYTE CnvRule_NumberOneToOne 1 0 0 255 ECU_ADDRESS 0x700158D5 /end MEASUREMENT
/begin MEASUREMENT dataJ1939Dm1Failrs_as[15].dtc_as[13].spn_u32 "" ULONG CnvRule_NumberOneToOne 1 0 0 4294967295 ECU_ADDRESS 0x700158D8 /end MEASUREMENT
/begin MEASUREMENT dataJ1939Dm1Failrs_as[15].dtc_as[13].fmi_u8 "" UBYTE CnvRule_NumberOneToOne 1 0 0 255 ECU_ADDRESS 0x700158DC /end MEASUREMENT
/begin MEASUREMENT dataJ1939Dm1Failrs_as[15].dtc_as[13].occ_u8 "" UBYTE CnvRule_NumberOneToOne 1 0 0 255 ECU_ADDRESS 0x700158DD /end MEASUREMENT
/begin MEASUREMENT dataJ1939Dm1Failrs_as[15].dtc_as[14].spn_u32 "" ULONG CnvRule_NumberOneToOne 1 0 0 4294967295 ECU_ADDRESS 0x700158E0 /end MEASUREMENT
/begin MEASUREMENT dataJ1939Dm1Failrs_as[15].dtc_as[14].fmi_u8 "" UBYTE CnvRule_NumberOneToOne 1 0 0 255 ECU_ADDRESS 0x700158E4 /end MEASUREMENT
/begin MEASUREMENT dataJ1939Dm1Failrs_as[15].dtc_as[14].occ_u8 "" UBYTE CnvRule_NumberOneToOne 1 0 0 255 ECU_ADDRESS 0x700158E5 /end MEASUREMENT
/begin MEASUREMENT dataJ1939Dm1Failrs_as[15].dtc_as[15].spn_u32 "" ULONG CnvRule_NumberOneToOne 1 0 0 4294967295 ECU_ADDRESS 0x700158E8 /end MEASUREMENT
/begin MEASUREMENT dataJ1939Dm1Failrs_as[15].dtc_as[15].fmi_u8 "" UBYTE CnvRule_NumberOneToOne 1 0 0 255 ECU_ADDRESS 0x700158EC /end MEASUREMENT
/begin MEASUREMENT dataJ1939Dm1Failrs_as[15].dtc_as[15].occ_u8 "" UBYTE CnvRule_NumberOneToOne 1 0 0 255 ECU_ADDRESS 0x700158ED /end MEASUREMENT
/begin MEASUREMENT dataJ1939Dm1Failrs_as[15].dtc_as[16].spn_u32 "" ULONG CnvRule_NumberOneToOne 1 0 0 4294967295 ECU_ADDRESS 0x700158F0 /end MEASUREMENT
/begin MEASUREMENT dataJ1939Dm1Failrs_as[15].dtc_as[16].fmi_u8 "" UBYTE CnvRule_NumberOneToOne 1 0 0 255 ECU_ADDRESS 0x700158F4 /end MEASUREMENT
/begin MEASUREMENT dataJ1939Dm1Failrs_as[15].dtc_as[16].occ_u8 "" UBYTE CnvRule_NumberOneToOne 1 0 0 255 ECU_ADDRESS 0x700158F5 /end MEASUREMENT
/begin MEASUREMENT dataJ1939Dm1Failrs_as[15].dtc_as[17].spn_u32 "" ULONG CnvRule_NumberOneToOne 1 0 0 4294967295 ECU_ADDRESS 0x700158F8 /end MEASUREMENT
/begin MEASUREMENT dataJ1939Dm1Failrs_as[15].dtc_as[17].fmi_u8 "" UBYTE CnvRule_NumberOneToOne 1 0 0 255 ECU_ADDRESS 0x700158FC /end MEASUREMENT
/begin MEASUREMENT dataJ1939Dm1Failrs_as[15].dtc_as[17].occ_u8 "" UBYTE CnvRule_NumberOneToOne 1 0 0 255 ECU_ADDRESS 0x700158FD /end MEASUREMENT
/begin MEASUREMENT dataJ1939Dm1Failrs_as[15].dtc_as[18].spn_u32 "" ULONG CnvRule_NumberOneToOne 1 0 0 4294967295 ECU_ADDRESS 0x70015900 /end MEASUREMENT
/begin MEASUREMENT dataJ1939Dm1Failrs_as[15].dtc_as[18].fmi_u8 "" UBYTE CnvRule_NumberOneToOne 1 0 0 255 ECU_ADDRESS 0x70015904 /end MEASUREMENT
/begin MEASUREMENT dataJ1939Dm1Failrs_as[15].dtc_as[18].occ_u8 "" UBYTE CnvRule_NumberOneToOne 1 0 0 255 ECU_ADDRESS 0x70015905 /end MEASUREMENT
/begin MEASUREMENT dataJ1939Dm1Failrs_as[15].dtc_as[19].spn_u32 "" ULONG CnvRule_NumberOneToOne 1 0 0 4294967295 ECU_ADDRESS 0x70015908 /end MEASUREMENT
/begin MEASUREMENT dataJ1939Dm1Failrs_as[15].dtc_as[19].fmi_u8 "" UBYTE CnvRule_NumberOneToOne 1 0 0 255 ECU_ADDRESS 0x7001590C /end MEASUREMENT
/begin MEASUREMENT dataJ1939Dm1Failrs_as[15].dtc_as[19].occ_u8 "" UBYTE CnvRule_NumberOneToOne 1 0 0 255 ECU_ADDRESS 0x7001590D /end MEASUREMENT
/begin MEASUREMENT dataJ1939Dm1Failrs_as[15].dtc_as[20].spn_u32 "" ULONG CnvRule_NumberOneToOne 1 0 0 4294967295 ECU_ADDRESS 0x70015910 /end MEASUREMENT
/begin MEASUREMENT dataJ1939Dm1Failrs_as[15].dtc_as[20].fmi_u8 "" UBYTE CnvRule_NumberOneToOne 1 0 0 255 ECU_ADDRESS 0x70015914 /end MEASUREMENT
/begin MEASUREMENT dataJ1939Dm1Failrs_as[15].dtc_as[20].occ_u8 "" UBYTE CnvRule_NumberOneToOne 1 0 0 255 ECU_ADDRESS 0x70015915 /end MEASUREMENT
/begin MEASUREMENT dataJ1939Dm1Failrs_as[15].dtc_as "" UBYTE CnvRule_NumberOneToOne 1 0 0 255 ECU_ADDRESS 0x70015878 ARRAY_SIZE 160 /end MEASUREMENT
/begin MEASUREMENT dataJ1939Dm1Failrs_as[16].dtc_as[1].spn_u32 "" ULONG CnvRule_NumberOneToOne 1 0 0 4294967295 ECU_ADDRESS 0x7001591C /end MEASUREMENT
/begin MEASUREMENT dataJ1939Dm1Failrs_as[16].dtc_as[1].fmi_u8 "" UBYTE CnvRule_NumberOneToOne 1 0 0 255 ECU_ADDRESS 0x70015920 /end MEASUREMENT
/begin MEASUREMENT dataJ1939Dm1Failrs_as[16].dtc_as[1].occ_u8 "" UBYTE CnvRule_NumberOneToOne 1 0 0 255 ECU_ADDRESS 0x70015921 /end MEASUREMENT
/begin MEASUREMENT dataJ1939Dm1Failrs_as[16].dtc_as[2].spn_u32 "" ULONG CnvRule_NumberOneToOne 1 0 0 4294967295 ECU_ADDRESS 0x70015924 /end MEASUREMENT
/begin MEASUREMENT dataJ1939Dm1Failrs_as[16].dtc_as[2].fmi_u8 "" UBYTE CnvRule_NumberOneToOne 1 0 0 255 ECU_ADDRESS 0x70015928 /end MEASUREMENT
/begin MEASUREMENT dataJ1939Dm1Failrs_as[16].dtc_as[2].occ_u8 "" UBYTE CnvRule_NumberOneToOne 1 0 0 255 ECU_ADDRESS 0x70015929 /end MEASUREMENT
/begin MEASUREMENT dataJ1939Dm1Failrs_as[16].dtc_as[3].spn_u32 "" ULONG CnvRule_NumberOneToOne 1 0 0 4294967295 ECU_ADDRESS 0x7001592C /end MEASUREMENT
/begin MEASUREMENT dataJ1939Dm1Failrs_as[16].dtc_as[3].fmi_u8 "" UBYTE CnvRule_NumberOneToOne 1 0 0 255 ECU_ADDRESS 0x70015930 /end MEASUREMENT
/begin MEASUREMENT dataJ1939Dm1Failrs_as[16].dtc_as[3].occ_u8 "" UBYTE CnvRule_NumberOneToOne 1 0 0 255 ECU_ADDRESS 0x70015931 /end MEASUREMENT
/begin MEASUREMENT dataJ1939Dm1Failrs_as[16].dtc_as[4].spn_u32 "" ULONG CnvRule_NumberOneToOne 1 0 0 4294967295 ECU_ADDRESS 0x70015934 /end MEASUREMENT
/begin MEASUREMENT dataJ1939Dm1Failrs_as[16].dtc_as[4].fmi_u8 "" UBYTE CnvRule_NumberOneToOne 1 0 0 255 ECU_ADDRESS 0x70015938 /end MEASUREMENT
/begin MEASUREMENT dataJ1939Dm1Failrs_as[16].dtc_as[4].occ_u8 "" UBYTE CnvRule_NumberOneToOne 1 0 0 255 ECU_ADDRESS 0x70015939 /end MEASUREMENT
/begin MEASUREMENT dataJ1939Dm1Failrs_as[16].dtc_as[5].spn_u32 "" ULONG CnvRule_NumberOneToOne 1 0 0 4294967295 ECU_ADDRESS 0x7001593C /end MEASUREMENT
/begin MEASUREMENT dataJ1939Dm1Failrs_as[16].dtc_as[5].fmi_u8 "" UBYTE CnvRule_NumberOneToOne 1 0 0 255 ECU_ADDRESS 0x70015940 /end MEASUREMENT
/begin MEASUREMENT dataJ1939Dm1Failrs_as[16].dtc_as[5].occ_u8 "" UBYTE CnvRule_NumberOneToOne 1 0 0 255 ECU_ADDRESS 0x70015941 /end MEASUREMENT
/begin MEASUREMENT dataJ1939Dm1Failrs_as[16].dtc_as[6].spn_u32 "" ULONG CnvRule_NumberOneToOne 1 0 0 4294967295 ECU_ADDRESS 0x70015944 /end MEASUREMENT
/begin MEASUREMENT dataJ1939Dm1Failrs_as[16].dtc_as[6].fmi_u8 "" UBYTE CnvRule_NumberOneToOne 1 0 0 255 ECU_ADDRESS 0x70015948 /end MEASUREMENT
/begin MEASUREMENT dataJ1939Dm1Failrs_as[16].dtc_as[6].occ_u8 "" UBYTE CnvRule_NumberOneToOne 1 0 0 255 ECU_ADDRESS 0x70015949 /end MEASUREMENT
/begin MEASUREMENT dataJ1939Dm1Failrs_as[16].dtc_as[7].spn_u32 "" ULONG CnvRule_NumberOneToOne 1 0 0 4294967295 ECU_ADDRESS 0x7001594C /end MEASUREMENT
/begin MEASUREMENT dataJ1939Dm1Failrs_as[16].dtc_as[7].fmi_u8 "" UBYTE CnvRule_NumberOneToOne 1 0 0 255 ECU_ADDRESS 0x70015950 /end MEASUREMENT
/begin MEASUREMENT dataJ1939Dm1Failrs_as[16].dtc_as[7].occ_u8 "" UBYTE CnvRule_NumberOneToOne 1 0 0 255 ECU_ADDRESS 0x70015951 /end MEASUREMENT
/begin MEASUREMENT dataJ1939Dm1Failrs_as[16].dtc_as[8].spn_u32 "" ULONG CnvRule_NumberOneToOne 1 0 0 4294967295 ECU_ADDRESS 0x70015954 /end MEASUREMENT
/begin MEASUREMENT dataJ1939Dm1Failrs_as[16].dtc_as[8].fmi_u8 "" UBYTE CnvRule_NumberOneToOne 1 0 0 255 ECU_ADDRESS 0x70015958 /end MEASUREMENT
/begin MEASUREMENT dataJ1939Dm1Failrs_as[16].dtc_as[8].occ_u8 "" UBYTE CnvRule_NumberOneToOne 1 0 0 255 ECU_ADDRESS 0x70015959 /end MEASUREMENT
/begin MEASUREMENT dataJ1939Dm1Failrs_as[16].dtc_as[9].spn_u32 "" ULONG CnvRule_NumberOneToOne 1 0 0 4294967295 ECU_ADDRESS 0x7001595C /end MEASUREMENT
/begin MEASUREMENT dataJ1939Dm1Failrs_as[16].dtc_as[9].fmi_u8 "" UBYTE CnvRule_NumberOneToOne 1 0 0 255 ECU_ADDRESS 0x70015960 /end MEASUREMENT
/begin MEASUREMENT dataJ1939Dm1Failrs_as[16].dtc_as[9].occ_u8 "" UBYTE CnvRule_NumberOneToOne 1 0 0 255 ECU_ADDRESS 0x70015961 /end MEASUREMENT
/begin MEASUREMENT dataJ1939Dm1Failrs_as[16].dtc_as[10].spn_u32 "" ULONG CnvRule_NumberOneToOne 1 0 0 4294967295 ECU_ADDRESS 0x70015964 /end MEASUREMENT
/begin MEASUREMENT dataJ1939Dm1Failrs_as[16].dtc_as[10].fmi_u8 "" UBYTE CnvRule_NumberOneToOne 1 0 0 255 ECU_ADDRESS 0x70015968 /end MEASUREMENT
/begin MEASUREMENT dataJ1939Dm1Failrs_as[16].dtc_as[10].occ_u8 "" UBYTE CnvRule_NumberOneToOne 1 0 0 255 ECU_ADDRESS 0x70015969 /end MEASUREMENT
/begin MEASUREMENT dataJ1939Dm1Failrs_as[16].dtc_as[11].spn_u32 "" ULONG CnvRule_NumberOneToOne 1 0 0 4294967295 ECU_ADDRESS 0x7001596C /end MEASUREMENT
/begin MEASUREMENT dataJ1939Dm1Failrs_as[16].dtc_as[11].fmi_u8 "" UBYTE CnvRule_NumberOneToOne 1 0 0 255 ECU_ADDRESS 0x70015970 /end MEASUREMENT
/begin MEASUREMENT dataJ1939Dm1Failrs_as[16].dtc_as[11].occ_u8 "" UBYTE CnvRule_NumberOneToOne 1 0 0 255 ECU_ADDRESS 0x70015971 /end MEASUREMENT
/begin MEASUREMENT dataJ1939Dm1Failrs_as[16].dtc_as[12].spn_u32 "" ULONG CnvRule_NumberOneToOne 1 0 0 4294967295 ECU_ADDRESS 0x70015974 /end MEASUREMENT
/begin MEASUREMENT dataJ1939Dm1Failrs_as[16].dtc_as[12].fmi_u8 "" UBYTE CnvRule_NumberOneToOne 1 0 0 255 ECU_ADDRESS 0x70015978 /end MEASUREMENT
/begin MEASUREMENT dataJ1939Dm1Failrs_as[16].dtc_as[12].occ_u8 "" UBYTE CnvRule_NumberOneToOne 1 0 0 255 ECU_ADDRESS 0x70015979 /end MEASUREMENT
/begin MEASUREMENT dataJ1939Dm1Failrs_as[16].dtc_as[13].spn_u32 "" ULONG CnvRule_NumberOneToOne 1 0 0 4294967295 ECU_ADDRESS 0x7001597C /end MEASUREMENT
/begin MEASUREMENT dataJ1939Dm1Failrs_as[16].dtc_as[13].fmi_u8 "" UBYTE CnvRule_NumberOneToOne 1 0 0 255 ECU_ADDRESS 0x70015980 /end MEASUREMENT
/begin MEASUREMENT dataJ1939Dm1Failrs_as[16].dtc_as[13].occ_u8 "" UBYTE CnvRule_NumberOneToOne 1 0 0 255 ECU_ADDRESS 0x70015981 /end MEASUREMENT
/begin MEASUREMENT dataJ1939Dm1Failrs_as[16].dtc_as[14].spn_u32 "" ULONG CnvRule_NumberOneToOne 1 0 0 4294967295 ECU_ADDRESS 0x70015984 /end MEASUREMENT
/begin MEASUREMENT dataJ1939Dm1Failrs_as[16].dtc_as[14].fmi_u8 "" UBYTE CnvRule_NumberOneToOne 1 0 0 255 ECU_ADDRESS 0x70015988 /end MEASUREMENT
/begin MEASUREMENT dataJ1939Dm1Failrs_as[16].dtc_as[14].occ_u8 "" UBYTE CnvRule_NumberOneToOne 1 0 0 255 ECU_ADDRESS 0x70015989 /end MEASUREMENT
/begin MEASUREMENT dataJ1939Dm1Failrs_as[16].dtc_as[15].spn_u32 "" ULONG CnvRule_NumberOneToOne 1 0 0 4294967295 ECU_ADDRESS 0x7001598C /end MEASUREMENT
/begin MEASUREMENT dataJ1939Dm1Failrs_as[16].dtc_as[15].fmi_u8 "" UBYTE CnvRule_NumberOneToOne 1 0 0 255 ECU_ADDRESS 0x70015990 /end MEASUREMENT
/begin MEASUREMENT dataJ1939Dm1Failrs_as[16].dtc_as[15].occ_u8 "" UBYTE CnvRule_NumberOneToOne 1 0 0 255 ECU_ADDRESS 0x70015991 /end MEASUREMENT
/begin MEASUREMENT dataJ1939Dm1Failrs_as[16].dtc_as[16].spn_u32 "" ULONG CnvRule_NumberOneToOne 1 0 0 4294967295 ECU_ADDRESS 0x70015994 /end MEASUREMENT
/begin MEASUREMENT dataJ1939Dm1Failrs_as[16].dtc_as[16].fmi_u8 "" UBYTE CnvRule_NumberOneToOne 1 0 0 255 ECU_ADDRESS 0x70015998 /end MEASUREMENT
/begin MEASUREMENT dataJ1939Dm1Failrs_as[16].dtc_as[16].occ_u8 "" UBYTE CnvRule_NumberOneToOne 1 0 0 255 ECU_ADDRESS 0x70015999 /end MEASUREMENT
/begin MEASUREMENT dataJ1939Dm1Failrs_as[16].dtc_as[17].spn_u32 "" ULONG CnvRule_NumberOneToOne 1 0 0 4294967295 ECU_ADDRESS 0x7001599C /end MEASUREMENT
/begin MEASUREMENT dataJ1939Dm1Failrs_as[16].dtc_as[17].fmi_u8 "" UBYTE CnvRule_NumberOneToOne 1 0 0 255 ECU_ADDRESS 0x700159A0 /end MEASUREMENT
/begin MEASUREMENT dataJ1939Dm1Failrs_as[16].dtc_as[17].occ_u8 "" UBYTE CnvRule_NumberOneToOne 1 0 0 255 ECU_ADDRESS 0x700159A1 /end MEASUREMENT
/begin MEASUREMENT dataJ1939Dm1Failrs_as[16].dtc_as[18].spn_u32 "" ULONG CnvRule_NumberOneToOne 1 0 0 4294967295 ECU_ADDRESS 0x700159A4 /end MEASUREMENT
/begin MEASUREMENT dataJ1939Dm1Failrs_as[16].dtc_as[18].fmi_u8 "" UBYTE CnvRule_NumberOneToOne 1 0 0 255 ECU_ADDRESS 0x700159A8 /end MEASUREMENT
/begin MEASUREMENT dataJ1939Dm1Failrs_as[16].dtc_as[18].occ_u8 "" UBYTE CnvRule_NumberOneToOne 1 0 0 255 ECU_ADDRESS 0x700159A9 /end MEASUREMENT
/begin MEASUREMENT dataJ1939Dm1Failrs_as[16].dtc_as[19].spn_u32 "" ULONG CnvRule_NumberOneToOne 1 0 0 4294967295 ECU_ADDRESS 0x700159AC /end MEASUREMENT
/begin MEASUREMENT dataJ1939Dm1Failrs_as[16].dtc_as[19].fmi_u8 "" UBYTE CnvRule_NumberOneToOne 1 0 0 255 ECU_ADDRESS 0x700159B0 /end MEASUREMENT
/begin MEASUREMENT dataJ1939Dm1Failrs_as[16].dtc_as[19].occ_u8 "" UBYTE CnvRule_NumberOneToOne 1 0 0 255 ECU_ADDRESS 0x700159B1 /end MEASUREMENT
/begin MEASUREMENT dataJ1939Dm1Failrs_as[16].dtc_as[20].spn_u32 "" ULONG CnvRule_NumberOneToOne 1 0 0 4294967295 ECU_ADDRESS 0x700159B4 /end MEASUREMENT
/begin MEASUREMENT dataJ1939Dm1Failrs_as[16].dtc_as[20].fmi_u8 "" UBYTE CnvRule_NumberOneToOne 1 0 0 255 ECU_ADDRESS 0x700159B8 /end MEASUREMENT
/begin MEASUREMENT dataJ1939Dm1Failrs_as[16].dtc_as[20].occ_u8 "" UBYTE CnvRule_NumberOneToOne 1 0 0 255 ECU_ADDRESS 0x700159B9 /end MEASUREMENT
/begin MEASUREMENT dataJ1939Dm1Failrs_as[16].dtc_as "" UBYTE CnvRule_NumberOneToOne 1 0 0 255 ECU_ADDRESS 0x7001591C ARRAY_SIZE 160 /end MEASUREMENT
/begin MEASUREMENT dataJ1939Dm1Failrs_as[17].dtc_as[1].spn_u32 "" ULONG CnvRule_NumberOneToOne 1 0 0 4294967295 ECU_ADDRESS 0x700159C0 /end MEASUREMENT
/begin MEASUREMENT dataJ1939Dm1Failrs_as[17].dtc_as[1].fmi_u8 "" UBYTE CnvRule_NumberOneToOne 1 0 0 255 ECU_ADDRESS 0x700159C4 /end MEASUREMENT
/begin MEASUREMENT dataJ1939Dm1Failrs_as[17].dtc_as[1].occ_u8 "" UBYTE CnvRule_NumberOneToOne 1 0 0 255 ECU_ADDRESS 0x700159C5 /end MEASUREMENT
/begin MEASUREMENT dataJ1939Dm1Failrs_as[17].dtc_as[2].spn_u32 "" ULONG CnvRule_NumberOneToOne 1 0 0 4294967295 ECU_ADDRESS 0x700159C8 /end MEASUREMENT
/begin MEASUREMENT dataJ1939Dm1Failrs_as[17].dtc_as[2].fmi_u8 "" UBYTE CnvRule_NumberOneToOne 1 0 0 255 ECU_ADDRESS 0x700159CC /end MEASUREMENT
/begin MEASUREMENT dataJ1939Dm1Failrs_as[17].dtc_as[2].occ_u8 "" UBYTE CnvRule_NumberOneToOne 1 0 0 255 ECU_ADDRESS 0x700159CD /end MEASUREMENT
/begin MEASUREMENT dataJ1939Dm1Failrs_as[17].dtc_as[3].spn_u32 "" ULONG CnvRule_NumberOneToOne 1 0 0 4294967295 ECU_ADDRESS 0x700159D0 /end MEASUREMENT
/begin MEASUREMENT dataJ1939Dm1Failrs_as[17].dtc_as[3].fmi_u8 "" UBYTE CnvRule_NumberOneToOne 1 0 0 255 ECU_ADDRESS 0x700159D4 /end MEASUREMENT
/begin MEASUREMENT dataJ1939Dm1Failrs_as[17].dtc_as[3].occ_u8 "" UBYTE CnvRule_NumberOneToOne 1 0 0 255 ECU_ADDRESS 0x700159D5 /end MEASUREMENT
/begin MEASUREMENT dataJ1939Dm1Failrs_as[17].dtc_as[4].spn_u32 "" ULONG CnvRule_NumberOneToOne 1 0 0 4294967295 ECU_ADDRESS 0x700159D8 /end MEASUREMENT
/begin MEASUREMENT dataJ1939Dm1Failrs_as[17].dtc_as[4].fmi_u8 "" UBYTE CnvRule_NumberOneToOne 1 0 0 255 ECU_ADDRESS 0x700159DC /end MEASUREMENT
/begin MEASUREMENT dataJ1939Dm1Failrs_as[17].dtc_as[4].occ_u8 "" UBYTE CnvRule_NumberOneToOne 1 0 0 255 ECU_ADDRESS 0x700159DD /end MEASUREMENT
/begin MEASUREMENT dataJ1939Dm1Failrs_as[17].dtc_as[5].spn_u32 "" ULONG CnvRule_NumberOneToOne 1 0 0 4294967295 ECU_ADDRESS 0x700159E0 /end MEASUREMENT
/begin MEASUREMENT dataJ1939Dm1Failrs_as[17].dtc_as[5].fmi_u8 "" UBYTE CnvRule_NumberOneToOne 1 0 0 255 ECU_ADDRESS 0x700159E4 /end MEASUREMENT
/begin MEASUREMENT dataJ1939Dm1Failrs_as[17].dtc_as[5].occ_u8 "" UBYTE CnvRule_NumberOneToOne 1 0 0 255 ECU_ADDRESS 0x700159E5 /end MEASUREMENT
/begin MEASUREMENT dataJ1939Dm1Failrs_as[17].dtc_as[6].spn_u32 "" ULONG CnvRule_NumberOneToOne 1 0 0 4294967295 ECU_ADDRESS 0x700159E8 /end MEASUREMENT
/begin MEASUREMENT dataJ1939Dm1Failrs_as[17].dtc_as[6].fmi_u8 "" UBYTE CnvRule_NumberOneToOne 1 0 0 255 ECU_ADDRESS 0x700159EC /end MEASUREMENT
/begin MEASUREMENT dataJ1939Dm1Failrs_as[17].dtc_as[6].occ_u8 "" UBYTE CnvRule_NumberOneToOne 1 0 0 255 ECU_ADDRESS 0x700159ED /end MEASUREMENT
/begin MEASUREMENT dataJ1939Dm1Failrs_as[17].dtc_as[7].spn_u32 "" ULONG CnvRule_NumberOneToOne 1 0 0 4294967295 ECU_ADDRESS 0x700159F0 /end MEASUREMENT
/begin MEASUREMENT dataJ1939Dm1Failrs_as[17].dtc_as[7].fmi_u8 "" UBYTE CnvRule_NumberOneToOne 1 0 0 255 ECU_ADDRESS 0x700159F4 /end MEASUREMENT
/begin MEASUREMENT dataJ1939Dm1Failrs_as[17].dtc_as[7].occ_u8 "" UBYTE CnvRule_NumberOneToOne 1 0 0 255 ECU_ADDRESS 0x700159F5 /end MEASUREMENT
/begin MEASUREMENT dataJ1939Dm1Failrs_as[17].dtc_as[8].spn_u32 "" ULONG CnvRule_NumberOneToOne 1 0 0 4294967295 ECU_ADDRESS 0x700159F8 /end MEASUREMENT
/begin MEASUREMENT dataJ1939Dm1Failrs_as[17].dtc_as[8].fmi_u8 "" UBYTE CnvRule_NumberOneToOne 1 0 0 255 ECU_ADDRESS 0x700159FC /end MEASUREMENT
/begin MEASUREMENT dataJ1939Dm1Failrs_as[17].dtc_as[8].occ_u8 "" UBYTE CnvRule_NumberOneToOne 1 0 0 255 ECU_ADDRESS 0x700159FD /end MEASUREMENT
/begin MEASUREMENT dataJ1939Dm1Failrs_as[17].dtc_as[9].spn_u32 "" ULONG CnvRule_NumberOneToOne 1 0 0 4294967295 ECU_ADDRESS 0x70015A00 /end MEASUREMENT
/begin MEASUREMENT dataJ1939Dm1Failrs_as[17].dtc_as[9].fmi_u8 "" UBYTE CnvRule_NumberOneToOne 1 0 0 255 ECU_ADDRESS 0x70015A04 /end MEASUREMENT
/begin MEASUREMENT dataJ1939Dm1Failrs_as[17].dtc_as[9].occ_u8 "" UBYTE CnvRule_NumberOneToOne 1 0 0 255 ECU_ADDRESS 0x70015A05 /end MEASUREMENT
/begin MEASUREMENT dataJ1939Dm1Failrs_as[17].dtc_as[10].spn_u32 "" ULONG CnvRule_NumberOneToOne 1 0 0 4294967295 ECU_ADDRESS 0x70015A08 /end MEASUREMENT
/begin MEASUREMENT dataJ1939Dm1Failrs_as[17].dtc_as[10].fmi_u8 "" UBYTE CnvRule_NumberOneToOne 1 0 0 255 ECU_ADDRESS 0x70015A0C /end MEASUREMENT
/begin MEASUREMENT dataJ1939Dm1Failrs_as[17].dtc_as[10].occ_u8 "" UBYTE CnvRule_NumberOneToOne 1 0 0 255 ECU_ADDRESS 0x70015A0D /end MEASUREMENT
/begin MEASUREMENT dataJ1939Dm1Failrs_as[17].dtc_as[11].spn_u32 "" ULONG CnvRule_NumberOneToOne 1 0 0 4294967295 ECU_ADDRESS 0x70015A10 /end MEASUREMENT
/begin MEASUREMENT dataJ1939Dm1Failrs_as[17].dtc_as[11].fmi_u8 "" UBYTE CnvRule_NumberOneToOne 1 0 0 255 ECU_ADDRESS 0x70015A14 /end MEASUREMENT
/begin MEASUREMENT dataJ1939Dm1Failrs_as[17].dtc_as[11].occ_u8 "" UBYTE CnvRule_NumberOneToOne 1 0 0 255 ECU_ADDRESS 0x70015A15 /end MEASUREMENT
/begin MEASUREMENT dataJ1939Dm1Failrs_as[17].dtc_as[12].spn_u32 "" ULONG CnvRule_NumberOneToOne 1 0 0 4294967295 ECU_ADDRESS 0x70015A18 /end MEASUREMENT
/begin MEASUREMENT dataJ1939Dm1Failrs_as[17].dtc_as[12].fmi_u8 "" UBYTE CnvRule_NumberOneToOne 1 0 0 255 ECU_ADDRESS 0x70015A1C /end MEASUREMENT
/begin MEASUREMENT dataJ1939Dm1Failrs_as[17].dtc_as[12].occ_u8 "" UBYTE CnvRule_NumberOneToOne 1 0 0 255 ECU_ADDRESS 0x70015A1D /end MEASUREMENT
/begin MEASUREMENT dataJ1939Dm1Failrs_as[17].dtc_as[13].spn_u32 "" ULONG CnvRule_NumberOneToOne 1 0 0 4294967295 ECU_ADDRESS 0x70015A20 /end MEASUREMENT
/begin MEASUREMENT dataJ1939Dm1Failrs_as[17].dtc_as[13].fmi_u8 "" UBYTE CnvRule_NumberOneToOne 1 0 0 255 ECU_ADDRESS 0x70015A24 /end MEASUREMENT
/begin MEASUREMENT dataJ1939Dm1Failrs_as[17].dtc_as[13].occ_u8 "" UBYTE CnvRule_NumberOneToOne 1 0 0 255 ECU_ADDRESS 0x70015A25 /end MEASUREMENT
/begin MEASUREMENT dataJ1939Dm1Failrs_as[17].dtc_as[14].spn_u32 "" ULONG CnvRule_NumberOneToOne 1 0 0 4294967295 ECU_ADDRESS 0x70015A28 /end MEASUREMENT
/begin MEASUREMENT dataJ1939Dm1Failrs_as[17].dtc_as[14].fmi_u8 "" UBYTE CnvRule_NumberOneToOne 1 0 0 255 ECU_ADDRESS 0x70015A2C /end MEASUREMENT
/begin MEASUREMENT dataJ1939Dm1Failrs_as[17].dtc_as[14].occ_u8 "" UBYTE CnvRule_NumberOneToOne 1 0 0 255 ECU_ADDRESS 0x70015A2D /end MEASUREMENT
/begin MEASUREMENT dataJ1939Dm1Failrs_as[17].dtc_as[15].spn_u32 "" ULONG CnvRule_NumberOneToOne 1 0 0 4294967295 ECU_ADDRESS 0x70015A30 /end MEASUREMENT
/begin MEASUREMENT dataJ1939Dm1Failrs_as[17].dtc_as[15].fmi_u8 "" UBYTE CnvRule_NumberOneToOne 1 0 0 255 ECU_ADDRESS 0x70015A34 /end MEASUREMENT
/begin MEASUREMENT dataJ1939Dm1Failrs_as[17].dtc_as[15].occ_u8 "" UBYTE CnvRule_NumberOneToOne 1 0 0 255 ECU_ADDRESS 0x70015A35 /end MEASUREMENT
/begin MEASUREMENT dataJ1939Dm1Failrs_as[17].dtc_as[16].spn_u32 "" ULONG CnvRule_NumberOneToOne 1 0 0 4294967295 ECU_ADDRESS 0x70015A38 /end MEASUREMENT
/begin MEASUREMENT dataJ1939Dm1Failrs_as[17].dtc_as[16].fmi_u8 "" UBYTE CnvRule_NumberOneToOne 1 0 0 255 ECU_ADDRESS 0x70015A3C /end MEASUREMENT
/begin MEASUREMENT dataJ1939Dm1Failrs_as[17].dtc_as[16].occ_u8 "" UBYTE CnvRule_NumberOneToOne 1 0 0 255 ECU_ADDRESS 0x70015A3D /end MEASUREMENT
/begin MEASUREMENT dataJ1939Dm1Failrs_as[17].dtc_as[17].spn_u32 "" ULONG CnvRule_NumberOneToOne 1 0 0 4294967295 ECU_ADDRESS 0x70015A40 /end MEASUREMENT
/begin MEASUREMENT dataJ1939Dm1Failrs_as[17].dtc_as[17].fmi_u8 "" UBYTE CnvRule_NumberOneToOne 1 0 0 255 ECU_ADDRESS 0x70015A44 /end MEASUREMENT
/begin MEASUREMENT dataJ1939Dm1Failrs_as[17].dtc_as[17].occ_u8 "" UBYTE CnvRule_NumberOneToOne 1 0 0 255 ECU_ADDRESS 0x70015A45 /end MEASUREMENT
/begin MEASUREMENT dataJ1939Dm1Failrs_as[17].dtc_as[18].spn_u32 "" ULONG CnvRule_NumberOneToOne 1 0 0 4294967295 ECU_ADDRESS 0x70015A48 /end MEASUREMENT
/begin MEASUREMENT dataJ1939Dm1Failrs_as[17].dtc_as[18].fmi_u8 "" UBYTE CnvRule_NumberOneToOne 1 0 0 255 ECU_ADDRESS 0x70015A4C /end MEASUREMENT
/begin MEASUREMENT dataJ1939Dm1Failrs_as[17].dtc_as[18].occ_u8 "" UBYTE CnvRule_NumberOneToOne 1 0 0 255 ECU_ADDRESS 0x70015A4D /end MEASUREMENT
/begin MEASUREMENT dataJ1939Dm1Failrs_as[17].dtc_as[19].spn_u32 "" ULONG CnvRule_NumberOneToOne 1 0 0 4294967295 ECU_ADDRESS 0x70015A50 /end MEASUREMENT
/begin MEASUREMENT dataJ1939Dm1Failrs_as[17].dtc_as[19].fmi_u8 "" UBYTE CnvRule_NumberOneToOne 1 0 0 255 ECU_ADDRESS 0x70015A54 /end MEASUREMENT
/begin MEASUREMENT dataJ1939Dm1Failrs_as[17].dtc_as[19].occ_u8 "" UBYTE CnvRule_NumberOneToOne 1 0 0 255 ECU_ADDRESS 0x70015A55 /end MEASUREMENT
/begin MEASUREMENT dataJ1939Dm1Failrs_as[17].dtc_as[20].spn_u32 "" ULONG CnvRule_NumberOneToOne 1 0 0 4294967295 ECU_ADDRESS 0x70015A58 /end MEASUREMENT
/begin MEASUREMENT dataJ1939Dm1Failrs_as[17].dtc_as[20].fmi_u8 "" UBYTE CnvRule_NumberOneToOne 1 0 0 255 ECU_ADDRESS 0x70015A5C /end MEASUREMENT
/begin MEASUREMENT dataJ1939Dm1Failrs_as[17].dtc_as[20].occ_u8 "" UBYTE CnvRule_NumberOneToOne 1 0 0 255 ECU_ADDRESS 0x70015A5D /end MEASUREMENT
/begin MEASUREMENT dataJ1939Dm1Failrs_as[17].dtc_as "" UBYTE CnvRule_NumberOneToOne 1 0 0 255 ECU_ADDRESS 0x700159C0 ARRAY_SIZE 160 /end MEASUREMENT
/begin MEASUREMENT dataJ1939Dm1Failrs_as[18].dtc_as[1].spn_u32 "" ULONG CnvRule_NumberOneToOne 1 0 0 4294967295 ECU_ADDRESS 0x70015A64 /end MEASUREMENT
/begin MEASUREMENT dataJ1939Dm1Failrs_as[18].dtc_as[1].fmi_u8 "" UBYTE CnvRule_NumberOneToOne 1 0 0 255 ECU_ADDRESS 0x70015A68 /end MEASUREMENT
/begin MEASUREMENT dataJ1939Dm1Failrs_as[18].dtc_as[1].occ_u8 "" UBYTE CnvRule_NumberOneToOne 1 0 0 255 ECU_ADDRESS 0x70015A69 /end MEASUREMENT
/begin MEASUREMENT dataJ1939Dm1Failrs_as[18].dtc_as[2].spn_u32 "" ULONG CnvRule_NumberOneToOne 1 0 0 4294967295 ECU_ADDRESS 0x70015A6C /end MEASUREMENT
/begin MEASUREMENT dataJ1939Dm1Failrs_as[18].dtc_as[2].fmi_u8 "" UBYTE CnvRule_NumberOneToOne 1 0 0 255 ECU_ADDRESS 0x70015A70 /end MEASUREMENT
/begin MEASUREMENT dataJ1939Dm1Failrs_as[18].dtc_as[2].occ_u8 "" UBYTE CnvRule_NumberOneToOne 1 0 0 255 ECU_ADDRESS 0x70015A71 /end MEASUREMENT
/begin MEASUREMENT dataJ1939Dm1Failrs_as[18].dtc_as[3].spn_u32 "" ULONG CnvRule_NumberOneToOne 1 0 0 4294967295 ECU_ADDRESS 0x70015A74 /end MEASUREMENT
/begin MEASUREMENT dataJ1939Dm1Failrs_as[18].dtc_as[3].fmi_u8 "" UBYTE CnvRule_NumberOneToOne 1 0 0 255 ECU_ADDRESS 0x70015A78 /end MEASUREMENT
/begin MEASUREMENT dataJ1939Dm1Failrs_as[18].dtc_as[3].occ_u8 "" UBYTE CnvRule_NumberOneToOne 1 0 0 255 ECU_ADDRESS 0x70015A79 /end MEASUREMENT
/begin MEASUREMENT dataJ1939Dm1Failrs_as[18].dtc_as[4].spn_u32 "" ULONG CnvRule_NumberOneToOne 1 0 0 4294967295 ECU_ADDRESS 0x70015A7C /end MEASUREMENT
/begin MEASUREMENT dataJ1939Dm1Failrs_as[18].dtc_as[4].fmi_u8 "" UBYTE CnvRule_NumberOneToOne 1 0 0 255 ECU_ADDRESS 0x70015A80 /end MEASUREMENT
/begin MEASUREMENT dataJ1939Dm1Failrs_as[18].dtc_as[4].occ_u8 "" UBYTE CnvRule_NumberOneToOne 1 0 0 255 ECU_ADDRESS 0x70015A81 /end MEASUREMENT
/begin MEASUREMENT dataJ1939Dm1Failrs_as[18].dtc_as[5].spn_u32 "" ULONG CnvRule_NumberOneToOne 1 0 0 4294967295 ECU_ADDRESS 0x70015A84 /end MEASUREMENT
/begin MEASUREMENT dataJ1939Dm1Failrs_as[18].dtc_as[5].fmi_u8 "" UBYTE CnvRule_NumberOneToOne 1 0 0 255 ECU_ADDRESS 0x70015A88 /end MEASUREMENT
/begin MEASUREMENT dataJ1939Dm1Failrs_as[18].dtc_as[5].occ_u8 "" UBYTE CnvRule_NumberOneToOne 1 0 0 255 ECU_ADDRESS 0x70015A89 /end MEASUREMENT
/begin MEASUREMENT dataJ1939Dm1Failrs_as[18].dtc_as[6].spn_u32 "" ULONG CnvRule_NumberOneToOne 1 0 0 4294967295 ECU_ADDRESS 0x70015A8C /end MEASUREMENT
/begin MEASUREMENT dataJ1939Dm1Failrs_as[18].dtc_as[6].fmi_u8 "" UBYTE CnvRule_NumberOneToOne 1 0 0 255 ECU_ADDRESS 0x70015A90 /end MEASUREMENT
/begin MEASUREMENT dataJ1939Dm1Failrs_as[18].dtc_as[6].occ_u8 "" UBYTE CnvRule_NumberOneToOne 1 0 0 255 ECU_ADDRESS 0x70015A91 /end MEASUREMENT
/begin MEASUREMENT dataJ1939Dm1Failrs_as[18].dtc_as[7].spn_u32 "" ULONG CnvRule_NumberOneToOne 1 0 0 4294967295 ECU_ADDRESS 0x70015A94 /end MEASUREMENT
/begin MEASUREMENT dataJ1939Dm1Failrs_as[18].dtc_as[7].fmi_u8 "" UBYTE CnvRule_NumberOneToOne 1 0 0 255 ECU_ADDRESS 0x70015A98 /end MEASUREMENT
/begin MEASUREMENT dataJ1939Dm1Failrs_as[18].dtc_as[7].occ_u8 "" UBYTE CnvRule_NumberOneToOne 1 0 0 255 ECU_ADDRESS 0x70015A99 /end MEASUREMENT
/begin MEASUREMENT dataJ1939Dm1Failrs_as[18].dtc_as[8].spn_u32 "" ULONG CnvRule_NumberOneToOne 1 0 0 4294967295 ECU_ADDRESS 0x70015A9C /end MEASUREMENT
/begin MEASUREMENT dataJ1939Dm1Failrs_as[18].dtc_as[8].fmi_u8 "" UBYTE CnvRule_NumberOneToOne 1 0 0 255 ECU_ADDRESS 0x70015AA0 /end MEASUREMENT
/begin MEASUREMENT dataJ1939Dm1Failrs_as[18].dtc_as[8].occ_u8 "" UBYTE CnvRule_NumberOneToOne 1 0 0 255 ECU_ADDRESS 0x70015AA1 /end MEASUREMENT
/begin MEASUREMENT dataJ1939Dm1Failrs_as[18].dtc_as[9].spn_u32 "" ULONG CnvRule_NumberOneToOne 1 0 0 4294967295 ECU_ADDRESS 0x70015AA4 /end MEASUREMENT
/begin MEASUREMENT dataJ1939Dm1Failrs_as[18].dtc_as[9].fmi_u8 "" UBYTE CnvRule_NumberOneToOne 1 0 0 255 ECU_ADDRESS 0x70015AA8 /end MEASUREMENT
/begin MEASUREMENT dataJ1939Dm1Failrs_as[18].dtc_as[9].occ_u8 "" UBYTE CnvRule_NumberOneToOne 1 0 0 255 ECU_ADDRESS 0x70015AA9 /end MEASUREMENT
/begin MEASUREMENT dataJ1939Dm1Failrs_as[18].dtc_as[10].spn_u32 "" ULONG CnvRule_NumberOneToOne 1 0 0 4294967295 ECU_ADDRESS 0x70015AAC /end MEASUREMENT
/begin MEASUREMENT dataJ1939Dm1Failrs_as[18].dtc_as[10].fmi_u8 "" UBYTE CnvRule_NumberOneToOne 1 0 0 255 ECU_ADDRESS 0x70015AB0 /end MEASUREMENT
/begin MEASUREMENT dataJ1939Dm1Failrs_as[18].dtc_as[10].occ_u8 "" UBYTE CnvRule_NumberOneToOne 1 0 0 255 ECU_ADDRESS 0x70015AB1 /end MEASUREMENT
/begin MEASUREMENT dataJ1939Dm1Failrs_as[18].dtc_as[11].spn_u32 "" ULONG CnvRule_NumberOneToOne 1 0 0 4294967295 ECU_ADDRESS 0x70015AB4 /end MEASUREMENT
/begin MEASUREMENT dataJ1939Dm1Failrs_as[18].dtc_as[11].fmi_u8 "" UBYTE CnvRule_NumberOneToOne 1 0 0 255 ECU_ADDRESS 0x70015AB8 /end MEASUREMENT
/begin MEASUREMENT dataJ1939Dm1Failrs_as[18].dtc_as[11].occ_u8 "" UBYTE CnvRule_NumberOneToOne 1 0 0 255 ECU_ADDRESS 0x70015AB9 /end MEASUREMENT
/begin MEASUREMENT dataJ1939Dm1Failrs_as[18].dtc_as[12].spn_u32 "" ULONG CnvRule_NumberOneToOne 1 0 0 4294967295 ECU_ADDRESS 0x70015ABC /end MEASUREMENT
/begin MEASUREMENT dataJ1939Dm1Failrs_as[18].dtc_as[12].fmi_u8 "" UBYTE CnvRule_NumberOneToOne 1 0 0 255 ECU_ADDRESS 0x70015AC0 /end MEASUREMENT
/begin MEASUREMENT dataJ1939Dm1Failrs_as[18].dtc_as[12].occ_u8 "" UBYTE CnvRule_NumberOneToOne 1 0 0 255 ECU_ADDRESS 0x70015AC1 /end MEASUREMENT
/begin MEASUREMENT dataJ1939Dm1Failrs_as[18].dtc_as[13].spn_u32 "" ULONG CnvRule_NumberOneToOne 1 0 0 4294967295 ECU_ADDRESS 0x70015AC4 /end MEASUREMENT
/begin MEASUREMENT dataJ1939Dm1Failrs_as[18].dtc_as[13].fmi_u8 "" UBYTE CnvRule_NumberOneToOne 1 0 0 255 ECU_ADDRESS 0x70015AC8 /end MEASUREMENT
/begin MEASUREMENT dataJ1939Dm1Failrs_as[18].dtc_as[13].occ_u8 "" UBYTE CnvRule_NumberOneToOne 1 0 0 255 ECU_ADDRESS 0x70015AC9 /end MEASUREMENT
/begin MEASUREMENT dataJ1939Dm1Failrs_as[18].dtc_as[14].spn_u32 "" ULONG CnvRule_NumberOneToOne 1 0 0 4294967295 ECU_ADDRESS 0x70015ACC /end MEASUREMENT
/begin MEASUREMENT dataJ1939Dm1Failrs_as[18].dtc_as[14].fmi_u8 "" UBYTE CnvRule_NumberOneToOne 1 0 0 255 ECU_ADDRESS 0x70015AD0 /end MEASUREMENT
/begin MEASUREMENT dataJ1939Dm1Failrs_as[18].dtc_as[14].occ_u8 "" UBYTE CnvRule_NumberOneToOne 1 0 0 255 ECU_ADDRESS 0x70015AD1 /end MEASUREMENT
/begin MEASUREMENT dataJ1939Dm1Failrs_as[18].dtc_as[15].spn_u32 "" ULONG CnvRule_NumberOneToOne 1 0 0 4294967295 ECU_ADDRESS 0x70015AD4 /end MEASUREMENT
/begin MEASUREMENT dataJ1939Dm1Failrs_as[18].dtc_as[15].fmi_u8 "" UBYTE CnvRule_NumberOneToOne 1 0 0 255 ECU_ADDRESS 0x70015AD8 /end MEASUREMENT
/begin MEASUREMENT dataJ1939Dm1Failrs_as[18].dtc_as[15].occ_u8 "" UBYTE CnvRule_NumberOneToOne 1 0 0 255 ECU_ADDRESS 0x70015AD9 /end MEASUREMENT
/begin MEASUREMENT dataJ1939Dm1Failrs_as[18].dtc_as[16].spn_u32 "" ULONG CnvRule_NumberOneToOne 1 0 0 4294967295 ECU_ADDRESS 0x70015ADC /end MEASUREMENT
/begin MEASUREMENT dataJ1939Dm1Failrs_as[18].dtc_as[16].fmi_u8 "" UBYTE CnvRule_NumberOneToOne 1 0 0 255 ECU_ADDRESS 0x70015AE0 /end MEASUREMENT
/begin MEASUREMENT dataJ1939Dm1Failrs_as[18].dtc_as[16].occ_u8 "" UBYTE CnvRule_NumberOneToOne 1 0 0 255 ECU_ADDRESS 0x70015AE1 /end MEASUREMENT
/begin MEASUREMENT dataJ1939Dm1Failrs_as[18].dtc_as[17].spn_u32 "" ULONG CnvRule_NumberOneToOne 1 0 0 4294967295 ECU_ADDRESS 0x70015AE4 /end MEASUREMENT
/begin MEASUREMENT dataJ1939Dm1Failrs_as[18].dtc_as[17].fmi_u8 "" UBYTE CnvRule_NumberOneToOne 1 0 0 255 ECU_ADDRESS 0x70015AE8 /end MEASUREMENT
/begin MEASUREMENT dataJ1939Dm1Failrs_as[18].dtc_as[17].occ_u8 "" UBYTE CnvRule_NumberOneToOne 1 0 0 255 ECU_ADDRESS 0x70015AE9 /end MEASUREMENT
/begin MEASUREMENT dataJ1939Dm1Failrs_as[18].dtc_as[18].spn_u32 "" ULONG CnvRule_NumberOneToOne 1 0 0 4294967295 ECU_ADDRESS 0x70015AEC /end MEASUREMENT
/begin MEASUREMENT dataJ1939Dm1Failrs_as[18].dtc_as[18].fmi_u8 "" UBYTE CnvRule_NumberOneToOne 1 0 0 255 ECU_ADDRESS 0x70015AF0 /end MEASUREMENT
/begin MEASUREMENT dataJ1939Dm1Failrs_as[18].dtc_as[18].occ_u8 "" UBYTE CnvRule_NumberOneToOne 1 0 0 255 ECU_ADDRESS 0x70015AF1 /end MEASUREMENT
/begin MEASUREMENT dataJ1939Dm1Failrs_as[18].dtc_as[19].spn_u32 "" ULONG CnvRule_NumberOneToOne 1 0 0 4294967295 ECU_ADDRESS 0x70015AF4 /end MEASUREMENT
/begin MEASUREMENT dataJ1939Dm1Failrs_as[18].dtc_as[19].fmi_u8 "" UBYTE CnvRule_NumberOneToOne 1 0 0 255 ECU_ADDRESS 0x70015AF8 /end MEASUREMENT
/begin MEASUREMENT dataJ1939Dm1Failrs_as[18].dtc_as[19].occ_u8 "" UBYTE CnvRule_NumberOneToOne 1 0 0 255 ECU_ADDRESS 0x70015AF9 /end MEASUREMENT
/begin MEASUREMENT dataJ1939Dm1Failrs_as[18].dtc_as[20].spn_u32 "" ULONG CnvRule_NumberOneToOne 1 0 0 4294967295 ECU_ADDRESS 0x70015AFC /end MEASUREMENT
/begin MEASUREMENT dataJ1939Dm1Failrs_as[18].dtc_as[20].fmi_u8 "" UBYTE CnvRule_NumberOneToOne 1 0 0 255 ECU_ADDRESS 0x70015B00 /end MEASUREMENT
/begin MEASUREMENT dataJ1939Dm1Failrs_as[18].dtc_as[20].occ_u8 "" UBYTE CnvRule_NumberOneToOne 1 0 0 255 ECU_ADDRESS 0x70015B01 /end MEASUREMENT
/begin MEASUREMENT dataJ1939Dm1Failrs_as[18].dtc_as "" UBYTE CnvRule_NumberOneToOne 1 0 0 255 ECU_ADDRESS 0x70015A64 ARRAY_SIZE 160 /end MEASUREMENT
/begin MEASUREMENT dataJ1939Dm1Failrs_as[19].dtc_as[1].spn_u32 "" ULONG CnvRule_NumberOneToOne 1 0 0 4294967295 ECU_ADDRESS 0x70015B08 /end MEASUREMENT
/begin MEASUREMENT dataJ1939Dm1Failrs_as[19].dtc_as[1].fmi_u8 "" UBYTE CnvRule_NumberOneToOne 1 0 0 255 ECU_ADDRESS 0x70015B0C /end MEASUREMENT
/begin MEASUREMENT dataJ1939Dm1Failrs_as[19].dtc_as[1].occ_u8 "" UBYTE CnvRule_NumberOneToOne 1 0 0 255 ECU_ADDRESS 0x70015B0D /end MEASUREMENT
/begin MEASUREMENT dataJ1939Dm1Failrs_as[19].dtc_as[2].spn_u32 "" ULONG CnvRule_NumberOneToOne 1 0 0 4294967295 ECU_ADDRESS 0x70015B10 /end MEASUREMENT
/begin MEASUREMENT dataJ1939Dm1Failrs_as[19].dtc_as[2].fmi_u8 "" UBYTE CnvRule_NumberOneToOne 1 0 0 255 ECU_ADDRESS 0x70015B14 /end MEASUREMENT
/begin MEASUREMENT dataJ1939Dm1Failrs_as[19].dtc_as[2].occ_u8 "" UBYTE CnvRule_NumberOneToOne 1 0 0 255 ECU_ADDRESS 0x70015B15 /end MEASUREMENT
/begin MEASUREMENT dataJ1939Dm1Failrs_as[19].dtc_as[3].spn_u32 "" ULONG CnvRule_NumberOneToOne 1 0 0 4294967295 ECU_ADDRESS 0x70015B18 /end MEASUREMENT
/begin MEASUREMENT dataJ1939Dm1Failrs_as[19].dtc_as[3].fmi_u8 "" UBYTE CnvRule_NumberOneToOne 1 0 0 255 ECU_ADDRESS 0x70015B1C /end MEASUREMENT
/begin MEASUREMENT dataJ1939Dm1Failrs_as[19].dtc_as[3].occ_u8 "" UBYTE CnvRule_NumberOneToOne 1 0 0 255 ECU_ADDRESS 0x70015B1D /end MEASUREMENT
/begin MEASUREMENT dataJ1939Dm1Failrs_as[19].dtc_as[4].spn_u32 "" ULONG CnvRule_NumberOneToOne 1 0 0 4294967295 ECU_ADDRESS 0x70015B20 /end MEASUREMENT
/begin MEASUREMENT dataJ1939Dm1Failrs_as[19].dtc_as[4].fmi_u8 "" UBYTE CnvRule_NumberOneToOne 1 0 0 255 ECU_ADDRESS 0x70015B24 /end MEASUREMENT
/begin MEASUREMENT dataJ1939Dm1Failrs_as[19].dtc_as[4].occ_u8 "" UBYTE CnvRule_NumberOneToOne 1 0 0 255 ECU_ADDRESS 0x70015B25 /end MEASUREMENT
/begin MEASUREMENT dataJ1939Dm1Failrs_as[19].dtc_as[5].spn_u32 "" ULONG CnvRule_NumberOneToOne 1 0 0 4294967295 ECU_ADDRESS 0x70015B28 /end MEASUREMENT
/begin MEASUREMENT dataJ1939Dm1Failrs_as[19].dtc_as[5].fmi_u8 "" UBYTE CnvRule_NumberOneToOne 1 0 0 255 ECU_ADDRESS 0x70015B2C /end MEASUREMENT
/begin MEASUREMENT dataJ1939Dm1Failrs_as[19].dtc_as[5].occ_u8 "" UBYTE CnvRule_NumberOneToOne 1 0 0 255 ECU_ADDRESS 0x70015B2D /end MEASUREMENT
/begin MEASUREMENT dataJ1939Dm1Failrs_as[19].dtc_as[6].spn_u32 "" ULONG CnvRule_NumberOneToOne 1 0 0 4294967295 ECU_ADDRESS 0x70015B30 /end MEASUREMENT
/begin MEASUREMENT dataJ1939Dm1Failrs_as[19].dtc_as[6].fmi_u8 "" UBYTE CnvRule_NumberOneToOne 1 0 0 255 ECU_ADDRESS 0x70015B34 /end MEASUREMENT
/begin MEASUREMENT dataJ1939Dm1Failrs_as[19].dtc_as[6].occ_u8 "" UBYTE CnvRule_NumberOneToOne 1 0 0 255 ECU_ADDRESS 0x70015B35 /end MEASUREMENT
/begin MEASUREMENT dataJ1939Dm1Failrs_as[19].dtc_as[7].spn_u32 "" ULONG CnvRule_NumberOneToOne 1 0 0 4294967295 ECU_ADDRESS 0x70015B38 /end MEASUREMENT
/begin MEASUREMENT dataJ1939Dm1Failrs_as[19].dtc_as[7].fmi_u8 "" UBYTE CnvRule_NumberOneToOne 1 0 0 255 ECU_ADDRESS 0x70015B3C /end MEASUREMENT
/begin MEASUREMENT dataJ1939Dm1Failrs_as[19].dtc_as[7].occ_u8 "" UBYTE CnvRule_NumberOneToOne 1 0 0 255 ECU_ADDRESS 0x70015B3D /end MEASUREMENT
/begin MEASUREMENT dataJ1939Dm1Failrs_as[19].dtc_as[8].spn_u32 "" ULONG CnvRule_NumberOneToOne 1 0 0 4294967295 ECU_ADDRESS 0x70015B40 /end MEASUREMENT
/begin MEASUREMENT dataJ1939Dm1Failrs_as[19].dtc_as[8].fmi_u8 "" UBYTE CnvRule_NumberOneToOne 1 0 0 255 ECU_ADDRESS 0x70015B44 /end MEASUREMENT
/begin MEASUREMENT dataJ1939Dm1Failrs_as[19].dtc_as[8].occ_u8 "" UBYTE CnvRule_NumberOneToOne 1 0 0 255 ECU_ADDRESS 0x70015B45 /end MEASUREMENT
/begin MEASUREMENT dataJ1939Dm1Failrs_as[19].dtc_as[9].spn_u32 "" ULONG CnvRule_NumberOneToOne 1 0 0 4294967295 ECU_ADDRESS 0x70015B48 /end MEASUREMENT
/begin MEASUREMENT dataJ1939Dm1Failrs_as[19].dtc_as[9].fmi_u8 "" UBYTE CnvRule_NumberOneToOne 1 0 0 255 ECU_ADDRESS 0x70015B4C /end MEASUREMENT
/begin MEASUREMENT dataJ1939Dm1Failrs_as[19].dtc_as[9].occ_u8 "" UBYTE CnvRule_NumberOneToOne 1 0 0 255 ECU_ADDRESS 0x70015B4D /end MEASUREMENT
/begin MEASUREMENT dataJ1939Dm1Failrs_as[19].dtc_as[10].spn_u32 "" ULONG CnvRule_NumberOneToOne 1 0 0 4294967295 ECU_ADDRESS 0x70015B50 /end MEASUREMENT
/begin MEASUREMENT dataJ1939Dm1Failrs_as[19].dtc_as[10].fmi_u8 "" UBYTE CnvRule_NumberOneToOne 1 0 0 255 ECU_ADDRESS 0x70015B54 /end MEASUREMENT
/begin MEASUREMENT dataJ1939Dm1Failrs_as[19].dtc_as[10].occ_u8 "" UBYTE CnvRule_NumberOneToOne 1 0 0 255 ECU_ADDRESS 0x70015B55 /end MEASUREMENT
/begin MEASUREMENT dataJ1939Dm1Failrs_as[19].dtc_as[11].spn_u32 "" ULONG CnvRule_NumberOneToOne 1 0 0 4294967295 ECU_ADDRESS 0x70015B58 /end MEASUREMENT
/begin MEASUREMENT dataJ1939Dm1Failrs_as[19].dtc_as[11].fmi_u8 "" UBYTE CnvRule_NumberOneToOne 1 0 0 255 ECU_ADDRESS 0x70015B5C /end MEASUREMENT
/begin MEASUREMENT dataJ1939Dm1Failrs_as[19].dtc_as[11].occ_u8 "" UBYTE CnvRule_NumberOneToOne 1 0 0 255 ECU_ADDRESS 0x70015B5D /end MEASUREMENT
/begin MEASUREMENT dataJ1939Dm1Failrs_as[19].dtc_as[12].spn_u32 "" ULONG CnvRule_NumberOneToOne 1 0 0 4294967295 ECU_ADDRESS 0x70015B60 /end MEASUREMENT
/begin MEASUREMENT dataJ1939Dm1Failrs_as[19].dtc_as[12].fmi_u8 "" UBYTE CnvRule_NumberOneToOne 1 0 0 255 ECU_ADDRESS 0x70015B64 /end MEASUREMENT
/begin MEASUREMENT dataJ1939Dm1Failrs_as[19].dtc_as[12].occ_u8 "" UBYTE CnvRule_NumberOneToOne 1 0 0 255 ECU_ADDRESS 0x70015B65 /end MEASUREMENT
/begin MEASUREMENT dataJ1939Dm1Failrs_as[19].dtc_as[13].spn_u32 "" ULONG CnvRule_NumberOneToOne 1 0 0 4294967295 ECU_ADDRESS 0x70015B68 /end MEASUREMENT
/begin MEASUREMENT dataJ1939Dm1Failrs_as[19].dtc_as[13].fmi_u8 "" UBYTE CnvRule_NumberOneToOne 1 0 0 255 ECU_ADDRESS 0x70015B6C /end MEASUREMENT
/begin MEASUREMENT dataJ1939Dm1Failrs_as[19].dtc_as[13].occ_u8 "" UBYTE CnvRule_NumberOneToOne 1 0 0 255 ECU_ADDRESS 0x70015B6D /end MEASUREMENT
/begin MEASUREMENT dataJ1939Dm1Failrs_as[19].dtc_as[14].spn_u32 "" ULONG CnvRule_NumberOneToOne 1 0 0 4294967295 ECU_ADDRESS 0x70015B70 /end MEASUREMENT
/begin MEASUREMENT dataJ1939Dm1Failrs_as[19].dtc_as[14].fmi_u8 "" UBYTE CnvRule_NumberOneToOne 1 0 0 255 ECU_ADDRESS 0x70015B74 /end MEASUREMENT
/begin MEASUREMENT dataJ1939Dm1Failrs_as[19].dtc_as[14].occ_u8 "" UBYTE CnvRule_NumberOneToOne 1 0 0 255 ECU_ADDRESS 0x70015B75 /end MEASUREMENT
/begin MEASUREMENT dataJ1939Dm1Failrs_as[19].dtc_as[15].spn_u32 "" ULONG CnvRule_NumberOneToOne 1 0 0 4294967295 ECU_ADDRESS 0x70015B78 /end MEASUREMENT
/begin MEASUREMENT dataJ1939Dm1Failrs_as[19].dtc_as[15].fmi_u8 "" UBYTE CnvRule_NumberOneToOne 1 0 0 255 ECU_ADDRESS 0x70015B7C /end MEASUREMENT
/begin MEASUREMENT dataJ1939Dm1Failrs_as[19].dtc_as[15].occ_u8 "" UBYTE CnvRule_NumberOneToOne 1 0 0 255 ECU_ADDRESS 0x70015B7D /end MEASUREMENT
/begin MEASUREMENT dataJ1939Dm1Failrs_as[19].dtc_as[16].spn_u32 "" ULONG CnvRule_NumberOneToOne 1 0 0 4294967295 ECU_ADDRESS 0x70015B80 /end MEASUREMENT
/begin MEASUREMENT dataJ1939Dm1Failrs_as[19].dtc_as[16].fmi_u8 "" UBYTE CnvRule_NumberOneToOne 1 0 0 255 ECU_ADDRESS 0x70015B84 /end MEASUREMENT
/begin MEASUREMENT dataJ1939Dm1Failrs_as[19].dtc_as[16].occ_u8 "" UBYTE CnvRule_NumberOneToOne 1 0 0 255 ECU_ADDRESS 0x70015B85 /end MEASUREMENT
/begin MEASUREMENT dataJ1939Dm1Failrs_as[19].dtc_as[17].spn_u32 "" ULONG CnvRule_NumberOneToOne 1 0 0 4294967295 ECU_ADDRESS 0x70015B88 /end MEASUREMENT
/begin MEASUREMENT dataJ1939Dm1Failrs_as[19].dtc_as[17].fmi_u8 "" UBYTE CnvRule_NumberOneToOne 1 0 0 255 ECU_ADDRESS 0x70015B8C /end MEASUREMENT
/begin MEASUREMENT dataJ1939Dm1Failrs_as[19].dtc_as[17].occ_u8 "" UBYTE CnvRule_NumberOneToOne 1 0 0 255 ECU_ADDRESS 0x70015B8D /end MEASUREMENT
/begin MEASUREMENT dataJ1939Dm1Failrs_as[19].dtc_as[18].spn_u32 "" ULONG CnvRule_NumberOneToOne 1 0 0 4294967295 ECU_ADDRESS 0x70015B90 /end MEASUREMENT
/begin MEASUREMENT dataJ1939Dm1Failrs_as[19].dtc_as[18].fmi_u8 "" UBYTE CnvRule_NumberOneToOne 1 0 0 255 ECU_ADDRESS 0x70015B94 /end MEASUREMENT
/begin MEASUREMENT dataJ1939Dm1Failrs_as[19].dtc_as[18].occ_u8 "" UBYTE CnvRule_NumberOneToOne 1 0 0 255 ECU_ADDRESS 0x70015B95 /end MEASUREMENT
/begin MEASUREMENT dataJ1939Dm1Failrs_as[19].dtc_as[19].spn_u32 "" ULONG CnvRule_NumberOneToOne 1 0 0 4294967295 ECU_ADDRESS 0x70015B98 /end MEASUREMENT
/begin MEASUREMENT dataJ1939Dm1Failrs_as[19].dtc_as[19].fmi_u8 "" UBYTE CnvRule_NumberOneToOne 1 0 0 255 ECU_ADDRESS 0x70015B9C /end MEASUREMENT
/begin MEASUREMENT dataJ1939Dm1Failrs_as[19].dtc_as[19].occ_u8 "" UBYTE CnvRule_NumberOneToOne 1 0 0 255 ECU_ADDRESS 0x70015B9D /end MEASUREMENT
/begin MEASUREMENT dataJ1939Dm1Failrs_as[19].dtc_as[20].spn_u32 "" ULONG CnvRule_NumberOneToOne 1 0 0 4294967295 ECU_ADDRESS 0x70015BA0 /end MEASUREMENT
/begin MEASUREMENT dataJ1939Dm1Failrs_as[19].dtc_as[20].fmi_u8 "" UBYTE CnvRule_NumberOneToOne 1 0 0 255 ECU_ADDRESS 0x70015BA4 /end MEASUREMENT
/begin MEASUREMENT dataJ1939Dm1Failrs_as[19].dtc_as[20].occ_u8 "" UBYTE CnvRule_NumberOneToOne 1 0 0 255 ECU_ADDRESS 0x70015BA5 /end MEASUREMENT
/begin MEASUREMENT dataJ1939Dm1Failrs_as[19].dtc_as "" UBYTE CnvRule_NumberOneToOne 1 0 0 255 ECU_ADDRESS 0x70015B08 ARRAY_SIZE 160 /end MEASUREMENT
/begin MEASUREMENT dataJ1939Dm1Failrs_as[20].dtc_as[1].spn_u32 "" ULONG CnvRule_NumberOneToOne 1 0 0 4294967295 ECU_ADDRESS 0x70015BAC /end MEASUREMENT
/begin MEASUREMENT dataJ1939Dm1Failrs_as[20].dtc_as[1].fmi_u8 "" UBYTE CnvRule_NumberOneToOne 1 0 0 255 ECU_ADDRESS 0x70015BB0 /end MEASUREMENT
/begin MEASUREMENT dataJ1939Dm1Failrs_as[20].dtc_as[1].occ_u8 "" UBYTE CnvRule_NumberOneToOne 1 0 0 255 ECU_ADDRESS 0x70015BB1 /end MEASUREMENT
/begin MEASUREMENT dataJ1939Dm1Failrs_as[20].dtc_as[2].spn_u32 "" ULONG CnvRule_NumberOneToOne 1 0 0 4294967295 ECU_ADDRESS 0x70015BB4 /end MEASUREMENT
/begin MEASUREMENT dataJ1939Dm1Failrs_as[20].dtc_as[2].fmi_u8 "" UBYTE CnvRule_NumberOneToOne 1 0 0 255 ECU_ADDRESS 0x70015BB8 /end MEASUREMENT
/begin MEASUREMENT dataJ1939Dm1Failrs_as[20].dtc_as[2].occ_u8 "" UBYTE CnvRule_NumberOneToOne 1 0 0 255 ECU_ADDRESS 0x70015BB9 /end MEASUREMENT
/begin MEASUREMENT dataJ1939Dm1Failrs_as[20].dtc_as[3].spn_u32 "" ULONG CnvRule_NumberOneToOne 1 0 0 4294967295 ECU_ADDRESS 0x70015BBC /end MEASUREMENT
/begin MEASUREMENT dataJ1939Dm1Failrs_as[20].dtc_as[3].fmi_u8 "" UBYTE CnvRule_NumberOneToOne 1 0 0 255 ECU_ADDRESS 0x70015BC0 /end MEASUREMENT
/begin MEASUREMENT dataJ1939Dm1Failrs_as[20].dtc_as[3].occ_u8 "" UBYTE CnvRule_NumberOneToOne 1 0 0 255 ECU_ADDRESS 0x70015BC1 /end MEASUREMENT
/begin MEASUREMENT dataJ1939Dm1Failrs_as[20].dtc_as[4].spn_u32 "" ULONG CnvRule_NumberOneToOne 1 0 0 4294967295 ECU_ADDRESS 0x70015BC4 /end MEASUREMENT
/begin MEASUREMENT dataJ1939Dm1Failrs_as[20].dtc_as[4].fmi_u8 "" UBYTE CnvRule_NumberOneToOne 1 0 0 255 ECU_ADDRESS 0x70015BC8 /end MEASUREMENT
/begin MEASUREMENT dataJ1939Dm1Failrs_as[20].dtc_as[4].occ_u8 "" UBYTE CnvRule_NumberOneToOne 1 0 0 255 ECU_ADDRESS 0x70015BC9 /end MEASUREMENT
/begin MEASUREMENT dataJ1939Dm1Failrs_as[20].dtc_as[5].spn_u32 "" ULONG CnvRule_NumberOneToOne 1 0 0 4294967295 ECU_ADDRESS 0x70015BCC /end MEASUREMENT
/begin MEASUREMENT dataJ1939Dm1Failrs_as[20].dtc_as[5].fmi_u8 "" UBYTE CnvRule_NumberOneToOne 1 0 0 255 ECU_ADDRESS 0x70015BD0 /end MEASUREMENT
/begin MEASUREMENT dataJ1939Dm1Failrs_as[20].dtc_as[5].occ_u8 "" UBYTE CnvRule_NumberOneToOne 1 0 0 255 ECU_ADDRESS 0x70015BD1 /end MEASUREMENT
/begin MEASUREMENT dataJ1939Dm1Failrs_as[20].dtc_as[6].spn_u32 "" ULONG CnvRule_NumberOneToOne 1 0 0 4294967295 ECU_ADDRESS 0x70015BD4 /end MEASUREMENT
/begin MEASUREMENT dataJ1939Dm1Failrs_as[20].dtc_as[6].fmi_u8 "" UBYTE CnvRule_NumberOneToOne 1 0 0 255 ECU_ADDRESS 0x70015BD8 /end MEASUREMENT
/begin MEASUREMENT dataJ1939Dm1Failrs_as[20].dtc_as[6].occ_u8 "" UBYTE CnvRule_NumberOneToOne 1 0 0 255 ECU_ADDRESS 0x70015BD9 /end MEASUREMENT
/begin MEASUREMENT dataJ1939Dm1Failrs_as[20].dtc_as[7].spn_u32 "" ULONG CnvRule_NumberOneToOne 1 0 0 4294967295 ECU_ADDRESS 0x70015BDC /end MEASUREMENT
/begin MEASUREMENT dataJ1939Dm1Failrs_as[20].dtc_as[7].fmi_u8 "" UBYTE CnvRule_NumberOneToOne 1 0 0 255 ECU_ADDRESS 0x70015BE0 /end MEASUREMENT
/begin MEASUREMENT dataJ1939Dm1Failrs_as[20].dtc_as[7].occ_u8 "" UBYTE CnvRule_NumberOneToOne 1 0 0 255 ECU_ADDRESS 0x70015BE1 /end MEASUREMENT
/begin MEASUREMENT dataJ1939Dm1Failrs_as[20].dtc_as[8].spn_u32 "" ULONG CnvRule_NumberOneToOne 1 0 0 4294967295 ECU_ADDRESS 0x70015BE4 /end MEASUREMENT
/begin MEASUREMENT dataJ1939Dm1Failrs_as[20].dtc_as[8].fmi_u8 "" UBYTE CnvRule_NumberOneToOne 1 0 0 255 ECU_ADDRESS 0x70015BE8 /end MEASUREMENT
/begin MEASUREMENT dataJ1939Dm1Failrs_as[20].dtc_as[8].occ_u8 "" UBYTE CnvRule_NumberOneToOne 1 0 0 255 ECU_ADDRESS 0x70015BE9 /end MEASUREMENT
/begin MEASUREMENT dataJ1939Dm1Failrs_as[20].dtc_as[9].spn_u32 "" ULONG CnvRule_NumberOneToOne 1 0 0 4294967295 ECU_ADDRESS 0x70015BEC /end MEASUREMENT
/begin MEASUREMENT dataJ1939Dm1Failrs_as[20].dtc_as[9].fmi_u8 "" UBYTE CnvRule_NumberOneToOne 1 0 0 255 ECU_ADDRESS 0x70015BF0 /end MEASUREMENT
/begin MEASUREMENT dataJ1939Dm1Failrs_as[20].dtc_as[9].occ_u8 "" UBYTE CnvRule_NumberOneToOne 1 0 0 255 ECU_ADDRESS 0x70015BF1 /end MEASUREMENT
/begin MEASUREMENT dataJ1939Dm1Failrs_as[20].dtc_as[10].spn_u32 "" ULONG CnvRule_NumberOneToOne 1 0 0 4294967295 ECU_ADDRESS 0x70015BF4 /end MEASUREMENT
/begin MEASUREMENT dataJ1939Dm1Failrs_as[20].dtc_as[10].fmi_u8 "" UBYTE CnvRule_NumberOneToOne 1 0 0 255 ECU_ADDRESS 0x70015BF8 /end MEASUREMENT
/begin MEASUREMENT dataJ1939Dm1Failrs_as[20].dtc_as[10].occ_u8 "" UBYTE CnvRule_NumberOneToOne 1 0 0 255 ECU_ADDRESS 0x70015BF9 /end MEASUREMENT
/begin MEASUREMENT dataJ1939Dm1Failrs_as[20].dtc_as[11].spn_u32 "" ULONG CnvRule_NumberOneToOne 1 0 0 4294967295 ECU_ADDRESS 0x70015BFC /end MEASUREMENT
/begin MEASUREMENT dataJ1939Dm1Failrs_as[20].dtc_as[11].fmi_u8 "" UBYTE CnvRule_NumberOneToOne 1 0 0 255 ECU_ADDRESS 0x70015C00 /end MEASUREMENT
/begin MEASUREMENT dataJ1939Dm1Failrs_as[20].dtc_as[11].occ_u8 "" UBYTE CnvRule_NumberOneToOne 1 0 0 255 ECU_ADDRESS 0x70015C01 /end MEASUREMENT
/begin MEASUREMENT dataJ1939Dm1Failrs_as[20].dtc_as[12].spn_u32 "" ULONG CnvRule_NumberOneToOne 1 0 0 4294967295 ECU_ADDRESS 0x70015C04 /end MEASUREMENT
/begin MEASUREMENT dataJ1939Dm1Failrs_as[20].dtc_as[12].fmi_u8 "" UBYTE CnvRule_NumberOneToOne 1 0 0 255 ECU_ADDRESS 0x70015C08 /end MEASUREMENT
/begin MEASUREMENT dataJ1939Dm1Failrs_as[20].dtc_as[12].occ_u8 "" UBYTE CnvRule_NumberOneToOne 1 0 0 255 ECU_ADDRESS 0x70015C09 /end MEASUREMENT
/begin MEASUREMENT dataJ1939Dm1Failrs_as[20].dtc_as[13].spn_u32 "" ULONG CnvRule_NumberOneToOne 1 0 0 4294967295 ECU_ADDRESS 0x70015C0C /end MEASUREMENT
/begin MEASUREMENT dataJ1939Dm1Failrs_as[20].dtc_as[13].fmi_u8 "" UBYTE CnvRule_NumberOneToOne 1 0 0 255 ECU_ADDRESS 0x70015C10 /end MEASUREMENT
/begin MEASUREMENT dataJ1939Dm1Failrs_as[20].dtc_as[13].occ_u8 "" UBYTE CnvRule_NumberOneToOne 1 0 0 255 ECU_ADDRESS 0x70015C11 /end MEASUREMENT
/begin MEASUREMENT dataJ1939Dm1Failrs_as[20].dtc_as[14].spn_u32 "" ULONG CnvRule_NumberOneToOne 1 0 0 4294967295 ECU_ADDRESS 0x70015C14 /end MEASUREMENT
/begin MEASUREMENT dataJ1939Dm1Failrs_as[20].dtc_as[14].fmi_u8 "" UBYTE CnvRule_NumberOneToOne 1 0 0 255 ECU_ADDRESS 0x70015C18 /end MEASUREMENT
/begin MEASUREMENT dataJ1939Dm1Failrs_as[20].dtc_as[14].occ_u8 "" UBYTE CnvRule_NumberOneToOne 1 0 0 255 ECU_ADDRESS 0x70015C19 /end MEASUREMENT
/begin MEASUREMENT dataJ1939Dm1Failrs_as[20].dtc_as[15].spn_u32 "" ULONG CnvRule_NumberOneToOne 1 0 0 4294967295 ECU_ADDRESS 0x70015C1C /end MEASUREMENT
/begin MEASUREMENT dataJ1939Dm1Failrs_as[20].dtc_as[15].fmi_u8 "" UBYTE CnvRule_NumberOneToOne 1 0 0 255 ECU_ADDRESS 0x70015C20 /end MEASUREMENT
/begin MEASUREMENT dataJ1939Dm1Failrs_as[20].dtc_as[15].occ_u8 "" UBYTE CnvRule_NumberOneToOne 1 0 0 255 ECU_ADDRESS 0x70015C21 /end MEASUREMENT
/begin MEASUREMENT dataJ1939Dm1Failrs_as[20].dtc_as[16].spn_u32 "" ULONG CnvRule_NumberOneToOne 1 0 0 4294967295 ECU_ADDRESS 0x70015C24 /end MEASUREMENT
/begin MEASUREMENT dataJ1939Dm1Failrs_as[20].dtc_as[16].fmi_u8 "" UBYTE CnvRule_NumberOneToOne 1 0 0 255 ECU_ADDRESS 0x70015C28 /end MEASUREMENT
/begin MEASUREMENT dataJ1939Dm1Failrs_as[20].dtc_as[16].occ_u8 "" UBYTE CnvRule_NumberOneToOne 1 0 0 255 ECU_ADDRESS 0x70015C29 /end MEASUREMENT
/begin MEASUREMENT dataJ1939Dm1Failrs_as[20].dtc_as[17].spn_u32 "" ULONG CnvRule_NumberOneToOne 1 0 0 4294967295 ECU_ADDRESS 0x70015C2C /end MEASUREMENT
/begin MEASUREMENT dataJ1939Dm1Failrs_as[20].dtc_as[17].fmi_u8 "" UBYTE CnvRule_NumberOneToOne 1 0 0 255 ECU_ADDRESS 0x70015C30 /end MEASUREMENT
/begin MEASUREMENT dataJ1939Dm1Failrs_as[20].dtc_as[17].occ_u8 "" UBYTE CnvRule_NumberOneToOne 1 0 0 255 ECU_ADDRESS 0x70015C31 /end MEASUREMENT
/begin MEASUREMENT dataJ1939Dm1Failrs_as[20].dtc_as[18].spn_u32 "" ULONG CnvRule_NumberOneToOne 1 0 0 4294967295 ECU_ADDRESS 0x70015C34 /end MEASUREMENT
/begin MEASUREMENT dataJ1939Dm1Failrs_as[20].dtc_as[18].fmi_u8 "" UBYTE CnvRule_NumberOneToOne 1 0 0 255 ECU_ADDRESS 0x70015C38 /end MEASUREMENT
/begin MEASUREMENT dataJ1939Dm1Failrs_as[20].dtc_as[18].occ_u8 "" UBYTE CnvRule_NumberOneToOne 1 0 0 255 ECU_ADDRESS 0x70015C39 /end MEASUREMENT
/begin MEASUREMENT dataJ1939Dm1Failrs_as[20].dtc_as[19].spn_u32 "" ULONG CnvRule_NumberOneToOne 1 0 0 4294967295 ECU_ADDRESS 0x70015C3C /end MEASUREMENT
/begin MEASUREMENT dataJ1939Dm1Failrs_as[20].dtc_as[19].fmi_u8 "" UBYTE CnvRule_NumberOneToOne 1 0 0 255 ECU_ADDRESS 0x70015C40 /end MEASUREMENT
/begin MEASUREMENT dataJ1939Dm1Failrs_as[20].dtc_as[19].occ_u8 "" UBYTE CnvRule_NumberOneToOne 1 0 0 255 ECU_ADDRESS 0x70015C41 /end MEASUREMENT
/begin MEASUREMENT dataJ1939Dm1Failrs_as[20].dtc_as[20].spn_u32 "" ULONG CnvRule_NumberOneToOne 1 0 0 4294967295 ECU_ADDRESS 0x70015C44 /end MEASUREMENT
/begin MEASUREMENT dataJ1939Dm1Failrs_as[20].dtc_as[20].fmi_u8 "" UBYTE CnvRule_NumberOneToOne 1 0 0 255 ECU_ADDRESS 0x70015C48 /end MEASUREMENT
/begin MEASUREMENT dataJ1939Dm1Failrs_as[20].dtc_as[20].occ_u8 "" UBYTE CnvRule_NumberOneToOne 1 0 0 255 ECU_ADDRESS 0x70015C49 /end MEASUREMENT
/begin MEASUREMENT dataJ1939Dm1Failrs_as[20].dtc_as "" UBYTE CnvRule_NumberOneToOne 1 0 0 255 ECU_ADDRESS 0x70015BAC ARRAY_SIZE 160 /end MEASUREMENT
/begin MEASUREMENT dataJ1939Dm1Failrs_as[21].dtc_as[1].spn_u32 "" ULONG CnvRule_NumberOneToOne 1 0 0 4294967295 ECU_ADDRESS 0x70015C50 /end MEASUREMENT
/begin MEASUREMENT dataJ1939Dm1Failrs_as[21].dtc_as[1].fmi_u8 "" UBYTE CnvRule_NumberOneToOne 1 0 0 255 ECU_ADDRESS 0x70015C54 /end MEASUREMENT
/begin MEASUREMENT dataJ1939Dm1Failrs_as[21].dtc_as[1].occ_u8 "" UBYTE CnvRule_NumberOneToOne 1 0 0 255 ECU_ADDRESS 0x70015C55 /end MEASUREMENT
/begin MEASUREMENT dataJ1939Dm1Failrs_as[21].dtc_as[2].spn_u32 "" ULONG CnvRule_NumberOneToOne 1 0 0 4294967295 ECU_ADDRESS 0x70015C58 /end MEASUREMENT
/begin MEASUREMENT dataJ1939Dm1Failrs_as[21].dtc_as[2].fmi_u8 "" UBYTE CnvRule_NumberOneToOne 1 0 0 255 ECU_ADDRESS 0x70015C5C /end MEASUREMENT
/begin MEASUREMENT dataJ1939Dm1Failrs_as[21].dtc_as[2].occ_u8 "" UBYTE CnvRule_NumberOneToOne 1 0 0 255 ECU_ADDRESS 0x70015C5D /end MEASUREMENT
/begin MEASUREMENT dataJ1939Dm1Failrs_as[21].dtc_as[3].spn_u32 "" ULONG CnvRule_NumberOneToOne 1 0 0 4294967295 ECU_ADDRESS 0x70015C60 /end MEASUREMENT
/begin MEASUREMENT dataJ1939Dm1Failrs_as[21].dtc_as[3].fmi_u8 "" UBYTE CnvRule_NumberOneToOne 1 0 0 255 ECU_ADDRESS 0x70015C64 /end MEASUREMENT
/begin MEASUREMENT dataJ1939Dm1Failrs_as[21].dtc_as[3].occ_u8 "" UBYTE CnvRule_NumberOneToOne 1 0 0 255 ECU_ADDRESS 0x70015C65 /end MEASUREMENT
/begin MEASUREMENT dataJ1939Dm1Failrs_as[21].dtc_as[4].spn_u32 "" ULONG CnvRule_NumberOneToOne 1 0 0 4294967295 ECU_ADDRESS 0x70015C68 /end MEASUREMENT
/begin MEASUREMENT dataJ1939Dm1Failrs_as[21].dtc_as[4].fmi_u8 "" UBYTE CnvRule_NumberOneToOne 1 0 0 255 ECU_ADDRESS 0x70015C6C /end MEASUREMENT
/begin MEASUREMENT dataJ1939Dm1Failrs_as[21].dtc_as[4].occ_u8 "" UBYTE CnvRule_NumberOneToOne 1 0 0 255 ECU_ADDRESS 0x70015C6D /end MEASUREMENT
/begin MEASUREMENT dataJ1939Dm1Failrs_as[21].dtc_as[5].spn_u32 "" ULONG CnvRule_NumberOneToOne 1 0 0 4294967295 ECU_ADDRESS 0x70015C70 /end MEASUREMENT
/begin MEASUREMENT dataJ1939Dm1Failrs_as[21].dtc_as[5].fmi_u8 "" UBYTE CnvRule_NumberOneToOne 1 0 0 255 ECU_ADDRESS 0x70015C74 /end MEASUREMENT
/begin MEASUREMENT dataJ1939Dm1Failrs_as[21].dtc_as[5].occ_u8 "" UBYTE CnvRule_NumberOneToOne 1 0 0 255 ECU_ADDRESS 0x70015C75 /end MEASUREMENT
/begin MEASUREMENT dataJ1939Dm1Failrs_as[21].dtc_as[6].spn_u32 "" ULONG CnvRule_NumberOneToOne 1 0 0 4294967295 ECU_ADDRESS 0x70015C78 /end MEASUREMENT
/begin MEASUREMENT dataJ1939Dm1Failrs_as[21].dtc_as[6].fmi_u8 "" UBYTE CnvRule_NumberOneToOne 1 0 0 255 ECU_ADDRESS 0x70015C7C /end MEASUREMENT
/begin MEASUREMENT dataJ1939Dm1Failrs_as[21].dtc_as[6].occ_u8 "" UBYTE CnvRule_NumberOneToOne 1 0 0 255 ECU_ADDRESS 0x70015C7D /end MEASUREMENT
/begin MEASUREMENT dataJ1939Dm1Failrs_as[21].dtc_as[7].spn_u32 "" ULONG CnvRule_NumberOneToOne 1 0 0 4294967295 ECU_ADDRESS 0x70015C80 /end MEASUREMENT
/begin MEASUREMENT dataJ1939Dm1Failrs_as[21].dtc_as[7].fmi_u8 "" UBYTE CnvRule_NumberOneToOne 1 0 0 255 ECU_ADDRESS 0x70015C84 /end MEASUREMENT
/begin MEASUREMENT dataJ1939Dm1Failrs_as[21].dtc_as[7].occ_u8 "" UBYTE CnvRule_NumberOneToOne 1 0 0 255 ECU_ADDRESS 0x70015C85 /end MEASUREMENT
/begin MEASUREMENT dataJ1939Dm1Failrs_as[21].dtc_as[8].spn_u32 "" ULONG CnvRule_NumberOneToOne 1 0 0 4294967295 ECU_ADDRESS 0x70015C88 /end MEASUREMENT
/begin MEASUREMENT dataJ1939Dm1Failrs_as[21].dtc_as[8].fmi_u8 "" UBYTE CnvRule_NumberOneToOne 1 0 0 255 ECU_ADDRESS 0x70015C8C /end MEASUREMENT
/begin MEASUREMENT dataJ1939Dm1Failrs_as[21].dtc_as[8].occ_u8 "" UBYTE CnvRule_NumberOneToOne 1 0 0 255 ECU_ADDRESS 0x70015C8D /end MEASUREMENT
/begin MEASUREMENT dataJ1939Dm1Failrs_as[21].dtc_as[9].spn_u32 "" ULONG CnvRule_NumberOneToOne 1 0 0 4294967295 ECU_ADDRESS 0x70015C90 /end MEASUREMENT
/begin MEASUREMENT dataJ1939Dm1Failrs_as[21].dtc_as[9].fmi_u8 "" UBYTE CnvRule_NumberOneToOne 1 0 0 255 ECU_ADDRESS 0x70015C94 /end MEASUREMENT
/begin MEASUREMENT dataJ1939Dm1Failrs_as[21].dtc_as[9].occ_u8 "" UBYTE CnvRule_NumberOneToOne 1 0 0 255 ECU_ADDRESS 0x70015C95 /end MEASUREMENT
/begin MEASUREMENT dataJ1939Dm1Failrs_as[21].dtc_as[10].spn_u32 "" ULONG CnvRule_NumberOneToOne 1 0 0 4294967295 ECU_ADDRESS 0x70015C98 /end MEASUREMENT
/begin MEASUREMENT dataJ1939Dm1Failrs_as[21].dtc_as[10].fmi_u8 "" UBYTE CnvRule_NumberOneToOne 1 0 0 255 ECU_ADDRESS 0x70015C9C /end MEASUREMENT
/begin MEASUREMENT dataJ1939Dm1Failrs_as[21].dtc_as[10].occ_u8 "" UBYTE CnvRule_NumberOneToOne 1 0 0 255 ECU_ADDRESS 0x70015C9D /end MEASUREMENT
/begin MEASUREMENT dataJ1939Dm1Failrs_as[21].dtc_as[11].spn_u32 "" ULONG CnvRule_NumberOneToOne 1 0 0 4294967295 ECU_ADDRESS 0x70015CA0 /end MEASUREMENT
/begin MEASUREMENT dataJ1939Dm1Failrs_as[21].dtc_as[11].fmi_u8 "" UBYTE CnvRule_NumberOneToOne 1 0 0 255 ECU_ADDRESS 0x70015CA4 /end MEASUREMENT
/begin MEASUREMENT dataJ1939Dm1Failrs_as[21].dtc_as[11].occ_u8 "" UBYTE CnvRule_NumberOneToOne 1 0 0 255 ECU_ADDRESS 0x70015CA5 /end MEASUREMENT
/begin MEASUREMENT dataJ1939Dm1Failrs_as[21].dtc_as[12].spn_u32 "" ULONG CnvRule_NumberOneToOne 1 0 0 4294967295 ECU_ADDRESS 0x70015CA8 /end MEASUREMENT
/begin MEASUREMENT dataJ1939Dm1Failrs_as[21].dtc_as[12].fmi_u8 "" UBYTE CnvRule_NumberOneToOne 1 0 0 255 ECU_ADDRESS 0x70015CAC /end MEASUREMENT
/begin MEASUREMENT dataJ1939Dm1Failrs_as[21].dtc_as[12].occ_u8 "" UBYTE CnvRule_NumberOneToOne 1 0 0 255 ECU_ADDRESS 0x70015CAD /end MEASUREMENT
/begin MEASUREMENT dataJ1939Dm1Failrs_as[21].dtc_as[13].spn_u32 "" ULONG CnvRule_NumberOneToOne 1 0 0 4294967295 ECU_ADDRESS 0x70015CB0 /end MEASUREMENT
/begin MEASUREMENT dataJ1939Dm1Failrs_as[21].dtc_as[13].fmi_u8 "" UBYTE CnvRule_NumberOneToOne 1 0 0 255 ECU_ADDRESS 0x70015CB4 /end MEASUREMENT
/begin MEASUREMENT dataJ1939Dm1Failrs_as[21].dtc_as[13].occ_u8 "" UBYTE CnvRule_NumberOneToOne 1 0 0 255 ECU_ADDRESS 0x70015CB5 /end MEASUREMENT
/begin MEASUREMENT dataJ1939Dm1Failrs_as[21].dtc_as[14].spn_u32 "" ULONG CnvRule_NumberOneToOne 1 0 0 4294967295 ECU_ADDRESS 0x70015CB8 /end MEASUREMENT
/begin MEASUREMENT dataJ1939Dm1Failrs_as[21].dtc_as[14].fmi_u8 "" UBYTE CnvRule_NumberOneToOne 1 0 0 255 ECU_ADDRESS 0x70015CBC /end MEASUREMENT
/begin MEASUREMENT dataJ1939Dm1Failrs_as[21].dtc_as[14].occ_u8 "" UBYTE CnvRule_NumberOneToOne 1 0 0 255 ECU_ADDRESS 0x70015CBD /end MEASUREMENT
/begin MEASUREMENT dataJ1939Dm1Failrs_as[21].dtc_as[15].spn_u32 "" ULONG CnvRule_NumberOneToOne 1 0 0 4294967295 ECU_ADDRESS 0x70015CC0 /end MEASUREMENT
/begin MEASUREMENT dataJ1939Dm1Failrs_as[21].dtc_as[15].fmi_u8 "" UBYTE CnvRule_NumberOneToOne 1 0 0 255 ECU_ADDRESS 0x70015CC4 /end MEASUREMENT
/begin MEASUREMENT dataJ1939Dm1Failrs_as[21].dtc_as[15].occ_u8 "" UBYTE CnvRule_NumberOneToOne 1 0 0 255 ECU_ADDRESS 0x70015CC5 /end MEASUREMENT
/begin MEASUREMENT dataJ1939Dm1Failrs_as[21].dtc_as[16].spn_u32 "" ULONG CnvRule_NumberOneToOne 1 0 0 4294967295 ECU_ADDRESS 0x70015CC8 /end MEASUREMENT
/begin MEASUREMENT dataJ1939Dm1Failrs_as[21].dtc_as[16].fmi_u8 "" UBYTE CnvRule_NumberOneToOne 1 0 0 255 ECU_ADDRESS 0x70015CCC /end MEASUREMENT
/begin MEASUREMENT dataJ1939Dm1Failrs_as[21].dtc_as[16].occ_u8 "" UBYTE CnvRule_NumberOneToOne 1 0 0 255 ECU_ADDRESS 0x70015CCD /end MEASUREMENT
/begin MEASUREMENT dataJ1939Dm1Failrs_as[21].dtc_as[17].spn_u32 "" ULONG CnvRule_NumberOneToOne 1 0 0 4294967295 ECU_ADDRESS 0x70015CD0 /end MEASUREMENT
/begin MEASUREMENT dataJ1939Dm1Failrs_as[21].dtc_as[17].fmi_u8 "" UBYTE CnvRule_NumberOneToOne 1 0 0 255 ECU_ADDRESS 0x70015CD4 /end MEASUREMENT
/begin MEASUREMENT dataJ1939Dm1Failrs_as[21].dtc_as[17].occ_u8 "" UBYTE CnvRule_NumberOneToOne 1 0 0 255 ECU_ADDRESS 0x70015CD5 /end MEASUREMENT
/begin MEASUREMENT dataJ1939Dm1Failrs_as[21].dtc_as[18].spn_u32 "" ULONG CnvRule_NumberOneToOne 1 0 0 4294967295 ECU_ADDRESS 0x70015CD8 /end MEASUREMENT
/begin MEASUREMENT dataJ1939Dm1Failrs_as[21].dtc_as[18].fmi_u8 "" UBYTE CnvRule_NumberOneToOne 1 0 0 255 ECU_ADDRESS 0x70015CDC /end MEASUREMENT
/begin MEASUREMENT dataJ1939Dm1Failrs_as[21].dtc_as[18].occ_u8 "" UBYTE CnvRule_NumberOneToOne 1 0 0 255 ECU_ADDRESS 0x70015CDD /end MEASUREMENT
/begin MEASUREMENT dataJ1939Dm1Failrs_as[21].dtc_as[19].spn_u32 "" ULONG CnvRule_NumberOneToOne 1 0 0 4294967295 ECU_ADDRESS 0x70015CE0 /end MEASUREMENT
/begin MEASUREMENT dataJ1939Dm1Failrs_as[21].dtc_as[19].fmi_u8 "" UBYTE CnvRule_NumberOneToOne 1 0 0 255 ECU_ADDRESS 0x70015CE4 /end MEASUREMENT
/begin MEASUREMENT dataJ1939Dm1Failrs_as[21].dtc_as[19].occ_u8 "" UBYTE CnvRule_NumberOneToOne 1 0 0 255 ECU_ADDRESS 0x70015CE5 /end MEASUREMENT
/begin MEASUREMENT dataJ1939Dm1Failrs_as[21].dtc_as[20].spn_u32 "" ULONG CnvRule_NumberOneToOne 1 0 0 4294967295 ECU_ADDRESS 0x70015CE8 /end MEASUREMENT
/begin MEASUREMENT dataJ1939Dm1Failrs_as[21].dtc_as[20].fmi_u8 "" UBYTE CnvRule_NumberOneToOne 1 0 0 255 ECU_ADDRESS 0x70015CEC /end MEASUREMENT
/begin MEASUREMENT dataJ1939Dm1Failrs_as[21].dtc_as[20].occ_u8 "" UBYTE CnvRule_NumberOneToOne 1 0 0 255 ECU_ADDRESS 0x70015CED /end MEASUREMENT
/begin MEASUREMENT dataJ1939Dm1Failrs_as[21].dtc_as "" UBYTE CnvRule_NumberOneToOne 1 0 0 255 ECU_ADDRESS 0x70015C50 ARRAY_SIZE 160 /end MEASUREMENT
/begin MEASUREMENT dataJ1939Dm1Failrs_as[22].dtc_as[1].spn_u32 "" ULONG CnvRule_NumberOneToOne 1 0 0 4294967295 ECU_ADDRESS 0x70015CF4 /end MEASUREMENT
/begin MEASUREMENT dataJ1939Dm1Failrs_as[22].dtc_as[1].fmi_u8 "" UBYTE CnvRule_NumberOneToOne 1 0 0 255 ECU_ADDRESS 0x70015CF8 /end MEASUREMENT
/begin MEASUREMENT dataJ1939Dm1Failrs_as[22].dtc_as[1].occ_u8 "" UBYTE CnvRule_NumberOneToOne 1 0 0 255 ECU_ADDRESS 0x70015CF9 /end MEASUREMENT
/begin MEASUREMENT dataJ1939Dm1Failrs_as[22].dtc_as[2].spn_u32 "" ULONG CnvRule_NumberOneToOne 1 0 0 4294967295 ECU_ADDRESS 0x70015CFC /end MEASUREMENT
/begin MEASUREMENT dataJ1939Dm1Failrs_as[22].dtc_as[2].fmi_u8 "" UBYTE CnvRule_NumberOneToOne 1 0 0 255 ECU_ADDRESS 0x70015D00 /end MEASUREMENT
/begin MEASUREMENT dataJ1939Dm1Failrs_as[22].dtc_as[2].occ_u8 "" UBYTE CnvRule_NumberOneToOne 1 0 0 255 ECU_ADDRESS 0x70015D01 /end MEASUREMENT
/begin MEASUREMENT dataJ1939Dm1Failrs_as[22].dtc_as[3].spn_u32 "" ULONG CnvRule_NumberOneToOne 1 0 0 4294967295 ECU_ADDRESS 0x70015D04 /end MEASUREMENT
/begin MEASUREMENT dataJ1939Dm1Failrs_as[22].dtc_as[3].fmi_u8 "" UBYTE CnvRule_NumberOneToOne 1 0 0 255 ECU_ADDRESS 0x70015D08 /end MEASUREMENT
/begin MEASUREMENT dataJ1939Dm1Failrs_as[22].dtc_as[3].occ_u8 "" UBYTE CnvRule_NumberOneToOne 1 0 0 255 ECU_ADDRESS 0x70015D09 /end MEASUREMENT
/begin MEASUREMENT dataJ1939Dm1Failrs_as[22].dtc_as[4].spn_u32 "" ULONG CnvRule_NumberOneToOne 1 0 0 4294967295 ECU_ADDRESS 0x70015D0C /end MEASUREMENT
/begin MEASUREMENT dataJ1939Dm1Failrs_as[22].dtc_as[4].fmi_u8 "" UBYTE CnvRule_NumberOneToOne 1 0 0 255 ECU_ADDRESS 0x70015D10 /end MEASUREMENT
/begin MEASUREMENT dataJ1939Dm1Failrs_as[22].dtc_as[4].occ_u8 "" UBYTE CnvRule_NumberOneToOne 1 0 0 255 ECU_ADDRESS 0x70015D11 /end MEASUREMENT
/begin MEASUREMENT dataJ1939Dm1Failrs_as[22].dtc_as[5].spn_u32 "" ULONG CnvRule_NumberOneToOne 1 0 0 4294967295 ECU_ADDRESS 0x70015D14 /end MEASUREMENT
/begin MEASUREMENT dataJ1939Dm1Failrs_as[22].dtc_as[5].fmi_u8 "" UBYTE CnvRule_NumberOneToOne 1 0 0 255 ECU_ADDRESS 0x70015D18 /end MEASUREMENT
/begin MEASUREMENT dataJ1939Dm1Failrs_as[22].dtc_as[5].occ_u8 "" UBYTE CnvRule_NumberOneToOne 1 0 0 255 ECU_ADDRESS 0x70015D19 /end MEASUREMENT
/begin MEASUREMENT dataJ1939Dm1Failrs_as[22].dtc_as[6].spn_u32 "" ULONG CnvRule_NumberOneToOne 1 0 0 4294967295 ECU_ADDRESS 0x70015D1C /end MEASUREMENT
/begin MEASUREMENT dataJ1939Dm1Failrs_as[22].dtc_as[6].fmi_u8 "" UBYTE CnvRule_NumberOneToOne 1 0 0 255 ECU_ADDRESS 0x70015D20 /end MEASUREMENT
/begin MEASUREMENT dataJ1939Dm1Failrs_as[22].dtc_as[6].occ_u8 "" UBYTE CnvRule_NumberOneToOne 1 0 0 255 ECU_ADDRESS 0x70015D21 /end MEASUREMENT
/begin MEASUREMENT dataJ1939Dm1Failrs_as[22].dtc_as[7].spn_u32 "" ULONG CnvRule_NumberOneToOne 1 0 0 4294967295 ECU_ADDRESS 0x70015D24 /end MEASUREMENT
/begin MEASUREMENT dataJ1939Dm1Failrs_as[22].dtc_as[7].fmi_u8 "" UBYTE CnvRule_NumberOneToOne 1 0 0 255 ECU_ADDRESS 0x70015D28 /end MEASUREMENT
/begin MEASUREMENT dataJ1939Dm1Failrs_as[22].dtc_as[7].occ_u8 "" UBYTE CnvRule_NumberOneToOne 1 0 0 255 ECU_ADDRESS 0x70015D29 /end MEASUREMENT
/begin MEASUREMENT dataJ1939Dm1Failrs_as[22].dtc_as[8].spn_u32 "" ULONG CnvRule_NumberOneToOne 1 0 0 4294967295 ECU_ADDRESS 0x70015D2C /end MEASUREMENT
/begin MEASUREMENT dataJ1939Dm1Failrs_as[22].dtc_as[8].fmi_u8 "" UBYTE CnvRule_NumberOneToOne 1 0 0 255 ECU_ADDRESS 0x70015D30 /end MEASUREMENT
/begin MEASUREMENT dataJ1939Dm1Failrs_as[22].dtc_as[8].occ_u8 "" UBYTE CnvRule_NumberOneToOne 1 0 0 255 ECU_ADDRESS 0x70015D31 /end MEASUREMENT
/begin MEASUREMENT dataJ1939Dm1Failrs_as[22].dtc_as[9].spn_u32 "" ULONG CnvRule_NumberOneToOne 1 0 0 4294967295 ECU_ADDRESS 0x70015D34 /end MEASUREMENT
/begin MEASUREMENT dataJ1939Dm1Failrs_as[22].dtc_as[9].fmi_u8 "" UBYTE CnvRule_NumberOneToOne 1 0 0 255 ECU_ADDRESS 0x70015D38 /end MEASUREMENT
/begin MEASUREMENT dataJ1939Dm1Failrs_as[22].dtc_as[9].occ_u8 "" UBYTE CnvRule_NumberOneToOne 1 0 0 255 ECU_ADDRESS 0x70015D39 /end MEASUREMENT
/begin MEASUREMENT dataJ1939Dm1Failrs_as[22].dtc_as[10].spn_u32 "" ULONG CnvRule_NumberOneToOne 1 0 0 4294967295 ECU_ADDRESS 0x70015D3C /end MEASUREMENT
/begin MEASUREMENT dataJ1939Dm1Failrs_as[22].dtc_as[10].fmi_u8 "" UBYTE CnvRule_NumberOneToOne 1 0 0 255 ECU_ADDRESS 0x70015D40 /end MEASUREMENT
/begin MEASUREMENT dataJ1939Dm1Failrs_as[22].dtc_as[10].occ_u8 "" UBYTE CnvRule_NumberOneToOne 1 0 0 255 ECU_ADDRESS 0x70015D41 /end MEASUREMENT
/begin MEASUREMENT dataJ1939Dm1Failrs_as[22].dtc_as[11].spn_u32 "" ULONG CnvRule_NumberOneToOne 1 0 0 4294967295 ECU_ADDRESS 0x70015D44 /end MEASUREMENT
/begin MEASUREMENT dataJ1939Dm1Failrs_as[22].dtc_as[11].fmi_u8 "" UBYTE CnvRule_NumberOneToOne 1 0 0 255 ECU_ADDRESS 0x70015D48 /end MEASUREMENT
/begin MEASUREMENT dataJ1939Dm1Failrs_as[22].dtc_as[11].occ_u8 "" UBYTE CnvRule_NumberOneToOne 1 0 0 255 ECU_ADDRESS 0x70015D49 /end MEASUREMENT
/begin MEASUREMENT dataJ1939Dm1Failrs_as[22].dtc_as[12].spn_u32 "" ULONG CnvRule_NumberOneToOne 1 0 0 4294967295 ECU_ADDRESS 0x70015D4C /end MEASUREMENT
/begin MEASUREMENT dataJ1939Dm1Failrs_as[22].dtc_as[12].fmi_u8 "" UBYTE CnvRule_NumberOneToOne 1 0 0 255 ECU_ADDRESS 0x70015D50 /end MEASUREMENT
/begin MEASUREMENT dataJ1939Dm1Failrs_as[22].dtc_as[12].occ_u8 "" UBYTE CnvRule_NumberOneToOne 1 0 0 255 ECU_ADDRESS 0x70015D51 /end MEASUREMENT
/begin MEASUREMENT dataJ1939Dm1Failrs_as[22].dtc_as[13].spn_u32 "" ULONG CnvRule_NumberOneToOne 1 0 0 4294967295 ECU_ADDRESS 0x70015D54 /end MEASUREMENT
/begin MEASUREMENT dataJ1939Dm1Failrs_as[22].dtc_as[13].fmi_u8 "" UBYTE CnvRule_NumberOneToOne 1 0 0 255 ECU_ADDRESS 0x70015D58 /end MEASUREMENT
/begin MEASUREMENT dataJ1939Dm1Failrs_as[22].dtc_as[13].occ_u8 "" UBYTE CnvRule_NumberOneToOne 1 0 0 255 ECU_ADDRESS 0x70015D59 /end MEASUREMENT
/begin MEASUREMENT dataJ1939Dm1Failrs_as[22].dtc_as[14].spn_u32 "" ULONG CnvRule_NumberOneToOne 1 0 0 4294967295 ECU_ADDRESS 0x70015D5C /end MEASUREMENT
/begin MEASUREMENT dataJ1939Dm1Failrs_as[22].dtc_as[14].fmi_u8 "" UBYTE CnvRule_NumberOneToOne 1 0 0 255 ECU_ADDRESS 0x70015D60 /end MEASUREMENT
/begin MEASUREMENT dataJ1939Dm1Failrs_as[22].dtc_as[14].occ_u8 "" UBYTE CnvRule_NumberOneToOne 1 0 0 255 ECU_ADDRESS 0x70015D61 /end MEASUREMENT
/begin MEASUREMENT dataJ1939Dm1Failrs_as[22].dtc_as[15].spn_u32 "" ULONG CnvRule_NumberOneToOne 1 0 0 4294967295 ECU_ADDRESS 0x70015D64 /end MEASUREMENT
/begin MEASUREMENT dataJ1939Dm1Failrs_as[22].dtc_as[15].fmi_u8 "" UBYTE CnvRule_NumberOneToOne 1 0 0 255 ECU_ADDRESS 0x70015D68 /end MEASUREMENT
/begin MEASUREMENT dataJ1939Dm1Failrs_as[22].dtc_as[15].occ_u8 "" UBYTE CnvRule_NumberOneToOne 1 0 0 255 ECU_ADDRESS 0x70015D69 /end MEASUREMENT
/begin MEASUREMENT dataJ1939Dm1Failrs_as[22].dtc_as[16].spn_u32 "" ULONG CnvRule_NumberOneToOne 1 0 0 4294967295 ECU_ADDRESS 0x70015D6C /end MEASUREMENT
/begin MEASUREMENT dataJ1939Dm1Failrs_as[22].dtc_as[16].fmi_u8 "" UBYTE CnvRule_NumberOneToOne 1 0 0 255 ECU_ADDRESS 0x70015D70 /end MEASUREMENT
/begin MEASUREMENT dataJ1939Dm1Failrs_as[22].dtc_as[16].occ_u8 "" UBYTE CnvRule_NumberOneToOne 1 0 0 255 ECU_ADDRESS 0x70015D71 /end MEASUREMENT
/begin MEASUREMENT dataJ1939Dm1Failrs_as[22].dtc_as[17].spn_u32 "" ULONG CnvRule_NumberOneToOne 1 0 0 4294967295 ECU_ADDRESS 0x70015D74 /end MEASUREMENT
/begin MEASUREMENT dataJ1939Dm1Failrs_as[22].dtc_as[17].fmi_u8 "" UBYTE CnvRule_NumberOneToOne 1 0 0 255 ECU_ADDRESS 0x70015D78 /end MEASUREMENT
/begin MEASUREMENT dataJ1939Dm1Failrs_as[22].dtc_as[17].occ_u8 "" UBYTE CnvRule_NumberOneToOne 1 0 0 255 ECU_ADDRESS 0x70015D79 /end MEASUREMENT
/begin MEASUREMENT dataJ1939Dm1Failrs_as[22].dtc_as[18].spn_u32 "" ULONG CnvRule_NumberOneToOne 1 0 0 4294967295 ECU_ADDRESS 0x70015D7C /end MEASUREMENT
/begin MEASUREMENT dataJ1939Dm1Failrs_as[22].dtc_as[18].fmi_u8 "" UBYTE CnvRule_NumberOneToOne 1 0 0 255 ECU_ADDRESS 0x70015D80 /end MEASUREMENT
/begin MEASUREMENT dataJ1939Dm1Failrs_as[22].dtc_as[18].occ_u8 "" UBYTE CnvRule_NumberOneToOne 1 0 0 255 ECU_ADDRESS 0x70015D81 /end MEASUREMENT
/begin MEASUREMENT dataJ1939Dm1Failrs_as[22].dtc_as[19].spn_u32 "" ULONG CnvRule_NumberOneToOne 1 0 0 4294967295 ECU_ADDRESS 0x70015D84 /end MEASUREMENT
/begin MEASUREMENT dataJ1939Dm1Failrs_as[22].dtc_as[19].fmi_u8 "" UBYTE CnvRule_NumberOneToOne 1 0 0 255 ECU_ADDRESS 0x70015D88 /end MEASUREMENT
/begin MEASUREMENT dataJ1939Dm1Failrs_as[22].dtc_as[19].occ_u8 "" UBYTE CnvRule_NumberOneToOne 1 0 0 255 ECU_ADDRESS 0x70015D89 /end MEASUREMENT
/begin MEASUREMENT dataJ1939Dm1Failrs_as[22].dtc_as[20].spn_u32 "" ULONG CnvRule_NumberOneToOne 1 0 0 4294967295 ECU_ADDRESS 0x70015D8C /end MEASUREMENT
/begin MEASUREMENT dataJ1939Dm1Failrs_as[22].dtc_as[20].fmi_u8 "" UBYTE CnvRule_NumberOneToOne 1 0 0 255 ECU_ADDRESS 0x70015D90 /end MEASUREMENT
/begin MEASUREMENT dataJ1939Dm1Failrs_as[22].dtc_as[20].occ_u8 "" UBYTE CnvRule_NumberOneToOne 1 0 0 255 ECU_ADDRESS 0x70015D91 /end MEASUREMENT
/begin MEASUREMENT dataJ1939Dm1Failrs_as[22].dtc_as "" UBYTE CnvRule_NumberOneToOne 1 0 0 255 ECU_ADDRESS 0x70015CF4 ARRAY_SIZE 160 /end MEASUREMENT
/begin MEASUREMENT dataJ1939Dm1Failrs_as[23].dtc_as[1].spn_u32 "" ULONG CnvRule_NumberOneToOne 1 0 0 4294967295 ECU_ADDRESS 0x70015D98 /end MEASUREMENT
/begin MEASUREMENT dataJ1939Dm1Failrs_as[23].dtc_as[1].fmi_u8 "" UBYTE CnvRule_NumberOneToOne 1 0 0 255 ECU_ADDRESS 0x70015D9C /end MEASUREMENT
/begin MEASUREMENT dataJ1939Dm1Failrs_as[23].dtc_as[1].occ_u8 "" UBYTE CnvRule_NumberOneToOne 1 0 0 255 ECU_ADDRESS 0x70015D9D /end MEASUREMENT
/begin MEASUREMENT dataJ1939Dm1Failrs_as[23].dtc_as[2].spn_u32 "" ULONG CnvRule_NumberOneToOne 1 0 0 4294967295 ECU_ADDRESS 0x70015DA0 /end MEASUREMENT
/begin MEASUREMENT dataJ1939Dm1Failrs_as[23].dtc_as[2].fmi_u8 "" UBYTE CnvRule_NumberOneToOne 1 0 0 255 ECU_ADDRESS 0x70015DA4 /end MEASUREMENT
/begin MEASUREMENT dataJ1939Dm1Failrs_as[23].dtc_as[2].occ_u8 "" UBYTE CnvRule_NumberOneToOne 1 0 0 255 ECU_ADDRESS 0x70015DA5 /end MEASUREMENT
/begin MEASUREMENT dataJ1939Dm1Failrs_as[23].dtc_as[3].spn_u32 "" ULONG CnvRule_NumberOneToOne 1 0 0 4294967295 ECU_ADDRESS 0x70015DA8 /end MEASUREMENT
/begin MEASUREMENT dataJ1939Dm1Failrs_as[23].dtc_as[3].fmi_u8 "" UBYTE CnvRule_NumberOneToOne 1 0 0 255 ECU_ADDRESS 0x70015DAC /end MEASUREMENT
/begin MEASUREMENT dataJ1939Dm1Failrs_as[23].dtc_as[3].occ_u8 "" UBYTE CnvRule_NumberOneToOne 1 0 0 255 ECU_ADDRESS 0x70015DAD /end MEASUREMENT
/begin MEASUREMENT dataJ1939Dm1Failrs_as[23].dtc_as[4].spn_u32 "" ULONG CnvRule_NumberOneToOne 1 0 0 4294967295 ECU_ADDRESS 0x70015DB0 /end MEASUREMENT
/begin MEASUREMENT dataJ1939Dm1Failrs_as[23].dtc_as[4].fmi_u8 "" UBYTE CnvRule_NumberOneToOne 1 0 0 255 ECU_ADDRESS 0x70015DB4 /end MEASUREMENT
/begin MEASUREMENT dataJ1939Dm1Failrs_as[23].dtc_as[4].occ_u8 "" UBYTE CnvRule_NumberOneToOne 1 0 0 255 ECU_ADDRESS 0x70015DB5 /end MEASUREMENT
/begin MEASUREMENT dataJ1939Dm1Failrs_as[23].dtc_as[5].spn_u32 "" ULONG CnvRule_NumberOneToOne 1 0 0 4294967295 ECU_ADDRESS 0x70015DB8 /end MEASUREMENT
/begin MEASUREMENT dataJ1939Dm1Failrs_as[23].dtc_as[5].fmi_u8 "" UBYTE CnvRule_NumberOneToOne 1 0 0 255 ECU_ADDRESS 0x70015DBC /end MEASUREMENT
/begin MEASUREMENT dataJ1939Dm1Failrs_as[23].dtc_as[5].occ_u8 "" UBYTE CnvRule_NumberOneToOne 1 0 0 255 ECU_ADDRESS 0x70015DBD /end MEASUREMENT
/begin MEASUREMENT dataJ1939Dm1Failrs_as[23].dtc_as[6].spn_u32 "" ULONG CnvRule_NumberOneToOne 1 0 0 4294967295 ECU_ADDRESS 0x70015DC0 /end MEASUREMENT
/begin MEASUREMENT dataJ1939Dm1Failrs_as[23].dtc_as[6].fmi_u8 "" UBYTE CnvRule_NumberOneToOne 1 0 0 255 ECU_ADDRESS 0x70015DC4 /end MEASUREMENT
/begin MEASUREMENT dataJ1939Dm1Failrs_as[23].dtc_as[6].occ_u8 "" UBYTE CnvRule_NumberOneToOne 1 0 0 255 ECU_ADDRESS 0x70015DC5 /end MEASUREMENT
/begin MEASUREMENT dataJ1939Dm1Failrs_as[23].dtc_as[7].spn_u32 "" ULONG CnvRule_NumberOneToOne 1 0 0 4294967295 ECU_ADDRESS 0x70015DC8 /end MEASUREMENT
/begin MEASUREMENT dataJ1939Dm1Failrs_as[23].dtc_as[7].fmi_u8 "" UBYTE CnvRule_NumberOneToOne 1 0 0 255 ECU_ADDRESS 0x70015DCC /end MEASUREMENT
/begin MEASUREMENT dataJ1939Dm1Failrs_as[23].dtc_as[7].occ_u8 "" UBYTE CnvRule_NumberOneToOne 1 0 0 255 ECU_ADDRESS 0x70015DCD /end MEASUREMENT
/begin MEASUREMENT dataJ1939Dm1Failrs_as[23].dtc_as[8].spn_u32 "" ULONG CnvRule_NumberOneToOne 1 0 0 4294967295 ECU_ADDRESS 0x70015DD0 /end MEASUREMENT
/begin MEASUREMENT dataJ1939Dm1Failrs_as[23].dtc_as[8].fmi_u8 "" UBYTE CnvRule_NumberOneToOne 1 0 0 255 ECU_ADDRESS 0x70015DD4 /end MEASUREMENT
/begin MEASUREMENT dataJ1939Dm1Failrs_as[23].dtc_as[8].occ_u8 "" UBYTE CnvRule_NumberOneToOne 1 0 0 255 ECU_ADDRESS 0x70015DD5 /end MEASUREMENT
/begin MEASUREMENT dataJ1939Dm1Failrs_as[23].dtc_as[9].spn_u32 "" ULONG CnvRule_NumberOneToOne 1 0 0 4294967295 ECU_ADDRESS 0x70015DD8 /end MEASUREMENT
/begin MEASUREMENT dataJ1939Dm1Failrs_as[23].dtc_as[9].fmi_u8 "" UBYTE CnvRule_NumberOneToOne 1 0 0 255 ECU_ADDRESS 0x70015DDC /end MEASUREMENT
/begin MEASUREMENT dataJ1939Dm1Failrs_as[23].dtc_as[9].occ_u8 "" UBYTE CnvRule_NumberOneToOne 1 0 0 255 ECU_ADDRESS 0x70015DDD /end MEASUREMENT
/begin MEASUREMENT dataJ1939Dm1Failrs_as[23].dtc_as[10].spn_u32 "" ULONG CnvRule_NumberOneToOne 1 0 0 4294967295 ECU_ADDRESS 0x70015DE0 /end MEASUREMENT
/begin MEASUREMENT dataJ1939Dm1Failrs_as[23].dtc_as[10].fmi_u8 "" UBYTE CnvRule_NumberOneToOne 1 0 0 255 ECU_ADDRESS 0x70015DE4 /end MEASUREMENT
/begin MEASUREMENT dataJ1939Dm1Failrs_as[23].dtc_as[10].occ_u8 "" UBYTE CnvRule_NumberOneToOne 1 0 0 255 ECU_ADDRESS 0x70015DE5 /end MEASUREMENT
/begin MEASUREMENT dataJ1939Dm1Failrs_as[23].dtc_as[11].spn_u32 "" ULONG CnvRule_NumberOneToOne 1 0 0 4294967295 ECU_ADDRESS 0x70015DE8 /end MEASUREMENT
/begin MEASUREMENT dataJ1939Dm1Failrs_as[23].dtc_as[11].fmi_u8 "" UBYTE CnvRule_NumberOneToOne 1 0 0 255 ECU_ADDRESS 0x70015DEC /end MEASUREMENT
/begin MEASUREMENT dataJ1939Dm1Failrs_as[23].dtc_as[11].occ_u8 "" UBYTE CnvRule_NumberOneToOne 1 0 0 255 ECU_ADDRESS 0x70015DED /end MEASUREMENT
/begin MEASUREMENT dataJ1939Dm1Failrs_as[23].dtc_as[12].spn_u32 "" ULONG CnvRule_NumberOneToOne 1 0 0 4294967295 ECU_ADDRESS 0x70015DF0 /end MEASUREMENT
/begin MEASUREMENT dataJ1939Dm1Failrs_as[23].dtc_as[12].fmi_u8 "" UBYTE CnvRule_NumberOneToOne 1 0 0 255 ECU_ADDRESS 0x70015DF4 /end MEASUREMENT
/begin MEASUREMENT dataJ1939Dm1Failrs_as[23].dtc_as[12].occ_u8 "" UBYTE CnvRule_NumberOneToOne 1 0 0 255 ECU_ADDRESS 0x70015DF5 /end MEASUREMENT
/begin MEASUREMENT dataJ1939Dm1Failrs_as[23].dtc_as[13].spn_u32 "" ULONG CnvRule_NumberOneToOne 1 0 0 4294967295 ECU_ADDRESS 0x70015DF8 /end MEASUREMENT
/begin MEASUREMENT dataJ1939Dm1Failrs_as[23].dtc_as[13].fmi_u8 "" UBYTE CnvRule_NumberOneToOne 1 0 0 255 ECU_ADDRESS 0x70015DFC /end MEASUREMENT
/begin MEASUREMENT dataJ1939Dm1Failrs_as[23].dtc_as[13].occ_u8 "" UBYTE CnvRule_NumberOneToOne 1 0 0 255 ECU_ADDRESS 0x70015DFD /end MEASUREMENT
/begin MEASUREMENT dataJ1939Dm1Failrs_as[23].dtc_as[14].spn_u32 "" ULONG CnvRule_NumberOneToOne 1 0 0 4294967295 ECU_ADDRESS 0x70015E00 /end MEASUREMENT
/begin MEASUREMENT dataJ1939Dm1Failrs_as[23].dtc_as[14].fmi_u8 "" UBYTE CnvRule_NumberOneToOne 1 0 0 255 ECU_ADDRESS 0x70015E04 /end MEASUREMENT
/begin MEASUREMENT dataJ1939Dm1Failrs_as[23].dtc_as[14].occ_u8 "" UBYTE CnvRule_NumberOneToOne 1 0 0 255 ECU_ADDRESS 0x70015E05 /end MEASUREMENT
/begin MEASUREMENT dataJ1939Dm1Failrs_as[23].dtc_as[15].spn_u32 "" ULONG CnvRule_NumberOneToOne 1 0 0 4294967295 ECU_ADDRESS 0x70015E08 /end MEASUREMENT
/begin MEASUREMENT dataJ1939Dm1Failrs_as[23].dtc_as[15].fmi_u8 "" UBYTE CnvRule_NumberOneToOne 1 0 0 255 ECU_ADDRESS 0x70015E0C /end MEASUREMENT
/begin MEASUREMENT dataJ1939Dm1Failrs_as[23].dtc_as[15].occ_u8 "" UBYTE CnvRule_NumberOneToOne 1 0 0 255 ECU_ADDRESS 0x70015E0D /end MEASUREMENT
/begin MEASUREMENT dataJ1939Dm1Failrs_as[23].dtc_as[16].spn_u32 "" ULONG CnvRule_NumberOneToOne 1 0 0 4294967295 ECU_ADDRESS 0x70015E10 /end MEASUREMENT
/begin MEASUREMENT dataJ1939Dm1Failrs_as[23].dtc_as[16].fmi_u8 "" UBYTE CnvRule_NumberOneToOne 1 0 0 255 ECU_ADDRESS 0x70015E14 /end MEASUREMENT
/begin MEASUREMENT dataJ1939Dm1Failrs_as[23].dtc_as[16].occ_u8 "" UBYTE CnvRule_NumberOneToOne 1 0 0 255 ECU_ADDRESS 0x70015E15 /end MEASUREMENT
/begin MEASUREMENT dataJ1939Dm1Failrs_as[23].dtc_as[17].spn_u32 "" ULONG CnvRule_NumberOneToOne 1 0 0 4294967295 ECU_ADDRESS 0x70015E18 /end MEASUREMENT
/begin MEASUREMENT dataJ1939Dm1Failrs_as[23].dtc_as[17].fmi_u8 "" UBYTE CnvRule_NumberOneToOne 1 0 0 255 ECU_ADDRESS 0x70015E1C /end MEASUREMENT
/begin MEASUREMENT dataJ1939Dm1Failrs_as[23].dtc_as[17].occ_u8 "" UBYTE CnvRule_NumberOneToOne 1 0 0 255 ECU_ADDRESS 0x70015E1D /end MEASUREMENT
/begin MEASUREMENT dataJ1939Dm1Failrs_as[23].dtc_as[18].spn_u32 "" ULONG CnvRule_NumberOneToOne 1 0 0 4294967295 ECU_ADDRESS 0x70015E20 /end MEASUREMENT
/begin MEASUREMENT dataJ1939Dm1Failrs_as[23].dtc_as[18].fmi_u8 "" UBYTE CnvRule_NumberOneToOne 1 0 0 255 ECU_ADDRESS 0x70015E24 /end MEASUREMENT
/begin MEASUREMENT dataJ1939Dm1Failrs_as[23].dtc_as[18].occ_u8 "" UBYTE CnvRule_NumberOneToOne 1 0 0 255 ECU_ADDRESS 0x70015E25 /end MEASUREMENT
/begin MEASUREMENT dataJ1939Dm1Failrs_as[23].dtc_as[19].spn_u32 "" ULONG CnvRule_NumberOneToOne 1 0 0 4294967295 ECU_ADDRESS 0x70015E28 /end MEASUREMENT
/begin MEASUREMENT dataJ1939Dm1Failrs_as[23].dtc_as[19].fmi_u8 "" UBYTE CnvRule_NumberOneToOne 1 0 0 255 ECU_ADDRESS 0x70015E2C /end MEASUREMENT
/begin MEASUREMENT dataJ1939Dm1Failrs_as[23].dtc_as[19].occ_u8 "" UBYTE CnvRule_NumberOneToOne 1 0 0 255 ECU_ADDRESS 0x70015E2D /end MEASUREMENT
/begin MEASUREMENT dataJ1939Dm1Failrs_as[23].dtc_as[20].spn_u32 "" ULONG CnvRule_NumberOneToOne 1 0 0 4294967295 ECU_ADDRESS 0x70015E30 /end MEASUREMENT
/begin MEASUREMENT dataJ1939Dm1Failrs_as[23].dtc_as[20].fmi_u8 "" UBYTE CnvRule_NumberOneToOne 1 0 0 255 ECU_ADDRESS 0x70015E34 /end MEASUREMENT
/begin MEASUREMENT dataJ1939Dm1Failrs_as[23].dtc_as[20].occ_u8 "" UBYTE CnvRule_NumberOneToOne 1 0 0 255 ECU_ADDRESS 0x70015E35 /end MEASUREMENT
/begin MEASUREMENT dataJ1939Dm1Failrs_as[23].dtc_as "" UBYTE CnvRule_NumberOneToOne 1 0 0 255 ECU_ADDRESS 0x70015D98 ARRAY_SIZE 160 /end MEASUREMENT
/begin MEASUREMENT dataJ1939Dm1Failrs_as[24].dtc_as[1].spn_u32 "" ULONG CnvRule_NumberOneToOne 1 0 0 4294967295 ECU_ADDRESS 0x70015E3C /end MEASUREMENT
/begin MEASUREMENT dataJ1939Dm1Failrs_as[24].dtc_as[1].fmi_u8 "" UBYTE CnvRule_NumberOneToOne 1 0 0 255 ECU_ADDRESS 0x70015E40 /end MEASUREMENT
/begin MEASUREMENT dataJ1939Dm1Failrs_as[24].dtc_as[1].occ_u8 "" UBYTE CnvRule_NumberOneToOne 1 0 0 255 ECU_ADDRESS 0x70015E41 /end MEASUREMENT
/begin MEASUREMENT dataJ1939Dm1Failrs_as[24].dtc_as[2].spn_u32 "" ULONG CnvRule_NumberOneToOne 1 0 0 4294967295 ECU_ADDRESS 0x70015E44 /end MEASUREMENT
/begin MEASUREMENT dataJ1939Dm1Failrs_as[24].dtc_as[2].fmi_u8 "" UBYTE CnvRule_NumberOneToOne 1 0 0 255 ECU_ADDRESS 0x70015E48 /end MEASUREMENT
/begin MEASUREMENT dataJ1939Dm1Failrs_as[24].dtc_as[2].occ_u8 "" UBYTE CnvRule_NumberOneToOne 1 0 0 255 ECU_ADDRESS 0x70015E49 /end MEASUREMENT
/begin MEASUREMENT dataJ1939Dm1Failrs_as[24].dtc_as[3].spn_u32 "" ULONG CnvRule_NumberOneToOne 1 0 0 4294967295 ECU_ADDRESS 0x70015E4C /end MEASUREMENT
/begin MEASUREMENT dataJ1939Dm1Failrs_as[24].dtc_as[3].fmi_u8 "" UBYTE CnvRule_NumberOneToOne 1 0 0 255 ECU_ADDRESS 0x70015E50 /end MEASUREMENT
/begin MEASUREMENT dataJ1939Dm1Failrs_as[24].dtc_as[3].occ_u8 "" UBYTE CnvRule_NumberOneToOne 1 0 0 255 ECU_ADDRESS 0x70015E51 /end MEASUREMENT
/begin MEASUREMENT dataJ1939Dm1Failrs_as[24].dtc_as[4].spn_u32 "" ULONG CnvRule_NumberOneToOne 1 0 0 4294967295 ECU_ADDRESS 0x70015E54 /end MEASUREMENT
/begin MEASUREMENT dataJ1939Dm1Failrs_as[24].dtc_as[4].fmi_u8 "" UBYTE CnvRule_NumberOneToOne 1 0 0 255 ECU_ADDRESS 0x70015E58 /end MEASUREMENT
/begin MEASUREMENT dataJ1939Dm1Failrs_as[24].dtc_as[4].occ_u8 "" UBYTE CnvRule_NumberOneToOne 1 0 0 255 ECU_ADDRESS 0x70015E59 /end MEASUREMENT
/begin MEASUREMENT dataJ1939Dm1Failrs_as[24].dtc_as[5].spn_u32 "" ULONG CnvRule_NumberOneToOne 1 0 0 4294967295 ECU_ADDRESS 0x70015E5C /end MEASUREMENT
/begin MEASUREMENT dataJ1939Dm1Failrs_as[24].dtc_as[5].fmi_u8 "" UBYTE CnvRule_NumberOneToOne 1 0 0 255 ECU_ADDRESS 0x70015E60 /end MEASUREMENT
/begin MEASUREMENT dataJ1939Dm1Failrs_as[24].dtc_as[5].occ_u8 "" UBYTE CnvRule_NumberOneToOne 1 0 0 255 ECU_ADDRESS 0x70015E61 /end MEASUREMENT
/begin MEASUREMENT dataJ1939Dm1Failrs_as[24].dtc_as[6].spn_u32 "" ULONG CnvRule_NumberOneToOne 1 0 0 4294967295 ECU_ADDRESS 0x70015E64 /end MEASUREMENT
/begin MEASUREMENT dataJ1939Dm1Failrs_as[24].dtc_as[6].fmi_u8 "" UBYTE CnvRule_NumberOneToOne 1 0 0 255 ECU_ADDRESS 0x70015E68 /end MEASUREMENT
/begin MEASUREMENT dataJ1939Dm1Failrs_as[24].dtc_as[6].occ_u8 "" UBYTE CnvRule_NumberOneToOne 1 0 0 255 ECU_ADDRESS 0x70015E69 /end MEASUREMENT
/begin MEASUREMENT dataJ1939Dm1Failrs_as[24].dtc_as[7].spn_u32 "" ULONG CnvRule_NumberOneToOne 1 0 0 4294967295 ECU_ADDRESS 0x70015E6C /end MEASUREMENT
/begin MEASUREMENT dataJ1939Dm1Failrs_as[24].dtc_as[7].fmi_u8 "" UBYTE CnvRule_NumberOneToOne 1 0 0 255 ECU_ADDRESS 0x70015E70 /end MEASUREMENT
/begin MEASUREMENT dataJ1939Dm1Failrs_as[24].dtc_as[7].occ_u8 "" UBYTE CnvRule_NumberOneToOne 1 0 0 255 ECU_ADDRESS 0x70015E71 /end MEASUREMENT
/begin MEASUREMENT dataJ1939Dm1Failrs_as[24].dtc_as[8].spn_u32 "" ULONG CnvRule_NumberOneToOne 1 0 0 4294967295 ECU_ADDRESS 0x70015E74 /end MEASUREMENT
/begin MEASUREMENT dataJ1939Dm1Failrs_as[24].dtc_as[8].fmi_u8 "" UBYTE CnvRule_NumberOneToOne 1 0 0 255 ECU_ADDRESS 0x70015E78 /end MEASUREMENT
/begin MEASUREMENT dataJ1939Dm1Failrs_as[24].dtc_as[8].occ_u8 "" UBYTE CnvRule_NumberOneToOne 1 0 0 255 ECU_ADDRESS 0x70015E79 /end MEASUREMENT
/begin MEASUREMENT dataJ1939Dm1Failrs_as[24].dtc_as[9].spn_u32 "" ULONG CnvRule_NumberOneToOne 1 0 0 4294967295 ECU_ADDRESS 0x70015E7C /end MEASUREMENT
/begin MEASUREMENT dataJ1939Dm1Failrs_as[24].dtc_as[9].fmi_u8 "" UBYTE CnvRule_NumberOneToOne 1 0 0 255 ECU_ADDRESS 0x70015E80 /end MEASUREMENT
/begin MEASUREMENT dataJ1939Dm1Failrs_as[24].dtc_as[9].occ_u8 "" UBYTE CnvRule_NumberOneToOne 1 0 0 255 ECU_ADDRESS 0x70015E81 /end MEASUREMENT
/begin MEASUREMENT dataJ1939Dm1Failrs_as[24].dtc_as[10].spn_u32 "" ULONG CnvRule_NumberOneToOne 1 0 0 4294967295 ECU_ADDRESS 0x70015E84 /end MEASUREMENT
/begin MEASUREMENT dataJ1939Dm1Failrs_as[24].dtc_as[10].fmi_u8 "" UBYTE CnvRule_NumberOneToOne 1 0 0 255 ECU_ADDRESS 0x70015E88 /end MEASUREMENT
/begin MEASUREMENT dataJ1939Dm1Failrs_as[24].dtc_as[10].occ_u8 "" UBYTE CnvRule_NumberOneToOne 1 0 0 255 ECU_ADDRESS 0x70015E89 /end MEASUREMENT
/begin MEASUREMENT dataJ1939Dm1Failrs_as[24].dtc_as[11].spn_u32 "" ULONG CnvRule_NumberOneToOne 1 0 0 4294967295 ECU_ADDRESS 0x70015E8C /end MEASUREMENT
/begin MEASUREMENT dataJ1939Dm1Failrs_as[24].dtc_as[11].fmi_u8 "" UBYTE CnvRule_NumberOneToOne 1 0 0 255 ECU_ADDRESS 0x70015E90 /end MEASUREMENT
/begin MEASUREMENT dataJ1939Dm1Failrs_as[24].dtc_as[11].occ_u8 "" UBYTE CnvRule_NumberOneToOne 1 0 0 255 ECU_ADDRESS 0x70015E91 /end MEASUREMENT
/begin MEASUREMENT dataJ1939Dm1Failrs_as[24].dtc_as[12].spn_u32 "" ULONG CnvRule_NumberOneToOne 1 0 0 4294967295 ECU_ADDRESS 0x70015E94 /end MEASUREMENT
/begin MEASUREMENT dataJ1939Dm1Failrs_as[24].dtc_as[12].fmi_u8 "" UBYTE CnvRule_NumberOneToOne 1 0 0 255 ECU_ADDRESS 0x70015E98 /end MEASUREMENT
/begin MEASUREMENT dataJ1939Dm1Failrs_as[24].dtc_as[12].occ_u8 "" UBYTE CnvRule_NumberOneToOne 1 0 0 255 ECU_ADDRESS 0x70015E99 /end MEASUREMENT
/begin MEASUREMENT dataJ1939Dm1Failrs_as[24].dtc_as[13].spn_u32 "" ULONG CnvRule_NumberOneToOne 1 0 0 4294967295 ECU_ADDRESS 0x70015E9C /end MEASUREMENT
/begin MEASUREMENT dataJ1939Dm1Failrs_as[24].dtc_as[13].fmi_u8 "" UBYTE CnvRule_NumberOneToOne 1 0 0 255 ECU_ADDRESS 0x70015EA0 /end MEASUREMENT
/begin MEASUREMENT dataJ1939Dm1Failrs_as[24].dtc_as[13].occ_u8 "" UBYTE CnvRule_NumberOneToOne 1 0 0 255 ECU_ADDRESS 0x70015EA1 /end MEASUREMENT
/begin MEASUREMENT dataJ1939Dm1Failrs_as[24].dtc_as[14].spn_u32 "" ULONG CnvRule_NumberOneToOne 1 0 0 4294967295 ECU_ADDRESS 0x70015EA4 /end MEASUREMENT
/begin MEASUREMENT dataJ1939Dm1Failrs_as[24].dtc_as[14].fmi_u8 "" UBYTE CnvRule_NumberOneToOne 1 0 0 255 ECU_ADDRESS 0x70015EA8 /end MEASUREMENT
/begin MEASUREMENT dataJ1939Dm1Failrs_as[24].dtc_as[14].occ_u8 "" UBYTE CnvRule_NumberOneToOne 1 0 0 255 ECU_ADDRESS 0x70015EA9 /end MEASUREMENT
/begin MEASUREMENT dataJ1939Dm1Failrs_as[24].dtc_as[15].spn_u32 "" ULONG CnvRule_NumberOneToOne 1 0 0 4294967295 ECU_ADDRESS 0x70015EAC /end MEASUREMENT
/begin MEASUREMENT dataJ1939Dm1Failrs_as[24].dtc_as[15].fmi_u8 "" UBYTE CnvRule_NumberOneToOne 1 0 0 255 ECU_ADDRESS 0x70015EB0 /end MEASUREMENT
/begin MEASUREMENT dataJ1939Dm1Failrs_as[24].dtc_as[15].occ_u8 "" UBYTE CnvRule_NumberOneToOne 1 0 0 255 ECU_ADDRESS 0x70015EB1 /end MEASUREMENT
/begin MEASUREMENT dataJ1939Dm1Failrs_as[24].dtc_as[16].spn_u32 "" ULONG CnvRule_NumberOneToOne 1 0 0 4294967295 ECU_ADDRESS 0x70015EB4 /end MEASUREMENT
/begin MEASUREMENT dataJ1939Dm1Failrs_as[24].dtc_as[16].fmi_u8 "" UBYTE CnvRule_NumberOneToOne 1 0 0 255 ECU_ADDRESS 0x70015EB8 /end MEASUREMENT
/begin MEASUREMENT dataJ1939Dm1Failrs_as[24].dtc_as[16].occ_u8 "" UBYTE CnvRule_NumberOneToOne 1 0 0 255 ECU_ADDRESS 0x70015EB9 /end MEASUREMENT
/begin MEASUREMENT dataJ1939Dm1Failrs_as[24].dtc_as[17].spn_u32 "" ULONG CnvRule_NumberOneToOne 1 0 0 4294967295 ECU_ADDRESS 0x70015EBC /end MEASUREMENT
/begin MEASUREMENT dataJ1939Dm1Failrs_as[24].dtc_as[17].fmi_u8 "" UBYTE CnvRule_NumberOneToOne 1 0 0 255 ECU_ADDRESS 0x70015EC0 /end MEASUREMENT
/begin MEASUREMENT dataJ1939Dm1Failrs_as[24].dtc_as[17].occ_u8 "" UBYTE CnvRule_NumberOneToOne 1 0 0 255 ECU_ADDRESS 0x70015EC1 /end MEASUREMENT
/begin MEASUREMENT dataJ1939Dm1Failrs_as[24].dtc_as[18].spn_u32 "" ULONG CnvRule_NumberOneToOne 1 0 0 4294967295 ECU_ADDRESS 0x70015EC4 /end MEASUREMENT
/begin MEASUREMENT dataJ1939Dm1Failrs_as[24].dtc_as[18].fmi_u8 "" UBYTE CnvRule_NumberOneToOne 1 0 0 255 ECU_ADDRESS 0x70015EC8 /end MEASUREMENT
/begin MEASUREMENT dataJ1939Dm1Failrs_as[24].dtc_as[18].occ_u8 "" UBYTE CnvRule_NumberOneToOne 1 0 0 255 ECU_ADDRESS 0x70015EC9 /end MEASUREMENT
/begin MEASUREMENT dataJ1939Dm1Failrs_as[24].dtc_as[19].spn_u32 "" ULONG CnvRule_NumberOneToOne 1 0 0 4294967295 ECU_ADDRESS 0x70015ECC /end MEASUREMENT
/begin MEASUREMENT dataJ1939Dm1Failrs_as[24].dtc_as[19].fmi_u8 "" UBYTE CnvRule_NumberOneToOne 1 0 0 255 ECU_ADDRESS 0x70015ED0 /end MEASUREMENT
/begin MEASUREMENT dataJ1939Dm1Failrs_as[24].dtc_as[19].occ_u8 "" UBYTE CnvRule_NumberOneToOne 1 0 0 255 ECU_ADDRESS 0x70015ED1 /end MEASUREMENT
/begin MEASUREMENT dataJ1939Dm1Failrs_as[24].dtc_as[20].spn_u32 "" ULONG CnvRule_NumberOneToOne 1 0 0 4294967295 ECU_ADDRESS 0x70015ED4 /end MEASUREMENT
/begin MEASUREMENT dataJ1939Dm1Failrs_as[24].dtc_as[20].fmi_u8 "" UBYTE CnvRule_NumberOneToOne 1 0 0 255 ECU_ADDRESS 0x70015ED8 /end MEASUREMENT
/begin MEASUREMENT dataJ1939Dm1Failrs_as[24].dtc_as[20].occ_u8 "" UBYTE CnvRule_NumberOneToOne 1 0 0 255 ECU_ADDRESS 0x70015ED9 /end MEASUREMENT
/begin MEASUREMENT dataJ1939Dm1Failrs_as[24].dtc_as "" UBYTE CnvRule_NumberOneToOne 1 0 0 255 ECU_ADDRESS 0x70015E3C ARRAY_SIZE 160 /end MEASUREMENT
/begin MEASUREMENT dataJ1939Dm1Failrs_as[25].dtc_as[1].spn_u32 "" ULONG CnvRule_NumberOneToOne 1 0 0 4294967295 ECU_ADDRESS 0x70015EE0 /end MEASUREMENT
/begin MEASUREMENT dataJ1939Dm1Failrs_as[25].dtc_as[1].fmi_u8 "" UBYTE CnvRule_NumberOneToOne 1 0 0 255 ECU_ADDRESS 0x70015EE4 /end MEASUREMENT
/begin MEASUREMENT dataJ1939Dm1Failrs_as[25].dtc_as[1].occ_u8 "" UBYTE CnvRule_NumberOneToOne 1 0 0 255 ECU_ADDRESS 0x70015EE5 /end MEASUREMENT
/begin MEASUREMENT dataJ1939Dm1Failrs_as[25].dtc_as[2].spn_u32 "" ULONG CnvRule_NumberOneToOne 1 0 0 4294967295 ECU_ADDRESS 0x70015EE8 /end MEASUREMENT
/begin MEASUREMENT dataJ1939Dm1Failrs_as[25].dtc_as[2].fmi_u8 "" UBYTE CnvRule_NumberOneToOne 1 0 0 255 ECU_ADDRESS 0x70015EEC /end MEASUREMENT
/begin MEASUREMENT dataJ1939Dm1Failrs_as[25].dtc_as[2].occ_u8 "" UBYTE CnvRule_NumberOneToOne 1 0 0 255 ECU_ADDRESS 0x70015EED /end MEASUREMENT
/begin MEASUREMENT dataJ1939Dm1Failrs_as[25].dtc_as[3].spn_u32 "" ULONG CnvRule_NumberOneToOne 1 0 0 4294967295 ECU_ADDRESS 0x70015EF0 /end MEASUREMENT
/begin MEASUREMENT dataJ1939Dm1Failrs_as[25].dtc_as[3].fmi_u8 "" UBYTE CnvRule_NumberOneToOne 1 0 0 255 ECU_ADDRESS 0x70015EF4 /end MEASUREMENT
/begin MEASUREMENT dataJ1939Dm1Failrs_as[25].dtc_as[3].occ_u8 "" UBYTE CnvRule_NumberOneToOne 1 0 0 255 ECU_ADDRESS 0x70015EF5 /end MEASUREMENT
/begin MEASUREMENT dataJ1939Dm1Failrs_as[25].dtc_as[4].spn_u32 "" ULONG CnvRule_NumberOneToOne 1 0 0 4294967295 ECU_ADDRESS 0x70015EF8 /end MEASUREMENT
/begin MEASUREMENT dataJ1939Dm1Failrs_as[25].dtc_as[4].fmi_u8 "" UBYTE CnvRule_NumberOneToOne 1 0 0 255 ECU_ADDRESS 0x70015EFC /end MEASUREMENT
/begin MEASUREMENT dataJ1939Dm1Failrs_as[25].dtc_as[4].occ_u8 "" UBYTE CnvRule_NumberOneToOne 1 0 0 255 ECU_ADDRESS 0x70015EFD /end MEASUREMENT
/begin MEASUREMENT dataJ1939Dm1Failrs_as[25].dtc_as[5].spn_u32 "" ULONG CnvRule_NumberOneToOne 1 0 0 4294967295 ECU_ADDRESS 0x70015F00 /end MEASUREMENT
/begin MEASUREMENT dataJ1939Dm1Failrs_as[25].dtc_as[5].fmi_u8 "" UBYTE CnvRule_NumberOneToOne 1 0 0 255 ECU_ADDRESS 0x70015F04 /end MEASUREMENT
/begin MEASUREMENT dataJ1939Dm1Failrs_as[25].dtc_as[5].occ_u8 "" UBYTE CnvRule_NumberOneToOne 1 0 0 255 ECU_ADDRESS 0x70015F05 /end MEASUREMENT
/begin MEASUREMENT dataJ1939Dm1Failrs_as[25].dtc_as[6].spn_u32 "" ULONG CnvRule_NumberOneToOne 1 0 0 4294967295 ECU_ADDRESS 0x70015F08 /end MEASUREMENT
/begin MEASUREMENT dataJ1939Dm1Failrs_as[25].dtc_as[6].fmi_u8 "" UBYTE CnvRule_NumberOneToOne 1 0 0 255 ECU_ADDRESS 0x70015F0C /end MEASUREMENT
/begin MEASUREMENT dataJ1939Dm1Failrs_as[25].dtc_as[6].occ_u8 "" UBYTE CnvRule_NumberOneToOne 1 0 0 255 ECU_ADDRESS 0x70015F0D /end MEASUREMENT
/begin MEASUREMENT dataJ1939Dm1Failrs_as[25].dtc_as[7].spn_u32 "" ULONG CnvRule_NumberOneToOne 1 0 0 4294967295 ECU_ADDRESS 0x70015F10 /end MEASUREMENT
/begin MEASUREMENT dataJ1939Dm1Failrs_as[25].dtc_as[7].fmi_u8 "" UBYTE CnvRule_NumberOneToOne 1 0 0 255 ECU_ADDRESS 0x70015F14 /end MEASUREMENT
/begin MEASUREMENT dataJ1939Dm1Failrs_as[25].dtc_as[7].occ_u8 "" UBYTE CnvRule_NumberOneToOne 1 0 0 255 ECU_ADDRESS 0x70015F15 /end MEASUREMENT
/begin MEASUREMENT dataJ1939Dm1Failrs_as[25].dtc_as[8].spn_u32 "" ULONG CnvRule_NumberOneToOne 1 0 0 4294967295 ECU_ADDRESS 0x70015F18 /end MEASUREMENT
/begin MEASUREMENT dataJ1939Dm1Failrs_as[25].dtc_as[8].fmi_u8 "" UBYTE CnvRule_NumberOneToOne 1 0 0 255 ECU_ADDRESS 0x70015F1C /end MEASUREMENT
/begin MEASUREMENT dataJ1939Dm1Failrs_as[25].dtc_as[8].occ_u8 "" UBYTE CnvRule_NumberOneToOne 1 0 0 255 ECU_ADDRESS 0x70015F1D /end MEASUREMENT
/begin MEASUREMENT dataJ1939Dm1Failrs_as[25].dtc_as[9].spn_u32 "" ULONG CnvRule_NumberOneToOne 1 0 0 4294967295 ECU_ADDRESS 0x70015F20 /end MEASUREMENT
/begin MEASUREMENT dataJ1939Dm1Failrs_as[25].dtc_as[9].fmi_u8 "" UBYTE CnvRule_NumberOneToOne 1 0 0 255 ECU_ADDRESS 0x70015F24 /end MEASUREMENT
/begin MEASUREMENT dataJ1939Dm1Failrs_as[25].dtc_as[9].occ_u8 "" UBYTE CnvRule_NumberOneToOne 1 0 0 255 ECU_ADDRESS 0x70015F25 /end MEASUREMENT
/begin MEASUREMENT dataJ1939Dm1Failrs_as[25].dtc_as[10].spn_u32 "" ULONG CnvRule_NumberOneToOne 1 0 0 4294967295 ECU_ADDRESS 0x70015F28 /end MEASUREMENT
/begin MEASUREMENT dataJ1939Dm1Failrs_as[25].dtc_as[10].fmi_u8 "" UBYTE CnvRule_NumberOneToOne 1 0 0 255 ECU_ADDRESS 0x70015F2C /end MEASUREMENT
/begin MEASUREMENT dataJ1939Dm1Failrs_as[25].dtc_as[10].occ_u8 "" UBYTE CnvRule_NumberOneToOne 1 0 0 255 ECU_ADDRESS 0x70015F2D /end MEASUREMENT
/begin MEASUREMENT dataJ1939Dm1Failrs_as[25].dtc_as[11].spn_u32 "" ULONG CnvRule_NumberOneToOne 1 0 0 4294967295 ECU_ADDRESS 0x70015F30 /end MEASUREMENT
/begin MEASUREMENT dataJ1939Dm1Failrs_as[25].dtc_as[11].fmi_u8 "" UBYTE CnvRule_NumberOneToOne 1 0 0 255 ECU_ADDRESS 0x70015F34 /end MEASUREMENT
/begin MEASUREMENT dataJ1939Dm1Failrs_as[25].dtc_as[11].occ_u8 "" UBYTE CnvRule_NumberOneToOne 1 0 0 255 ECU_ADDRESS 0x70015F35 /end MEASUREMENT
/begin MEASUREMENT dataJ1939Dm1Failrs_as[25].dtc_as[12].spn_u32 "" ULONG CnvRule_NumberOneToOne 1 0 0 4294967295 ECU_ADDRESS 0x70015F38 /end MEASUREMENT
/begin MEASUREMENT dataJ1939Dm1Failrs_as[25].dtc_as[12].fmi_u8 "" UBYTE CnvRule_NumberOneToOne 1 0 0 255 ECU_ADDRESS 0x70015F3C /end MEASUREMENT
/begin MEASUREMENT dataJ1939Dm1Failrs_as[25].dtc_as[12].occ_u8 "" UBYTE CnvRule_NumberOneToOne 1 0 0 255 ECU_ADDRESS 0x70015F3D /end MEASUREMENT
/begin MEASUREMENT dataJ1939Dm1Failrs_as[25].dtc_as[13].spn_u32 "" ULONG CnvRule_NumberOneToOne 1 0 0 4294967295 ECU_ADDRESS 0x70015F40 /end MEASUREMENT
/begin MEASUREMENT dataJ1939Dm1Failrs_as[25].dtc_as[13].fmi_u8 "" UBYTE CnvRule_NumberOneToOne 1 0 0 255 ECU_ADDRESS 0x70015F44 /end MEASUREMENT
/begin MEASUREMENT dataJ1939Dm1Failrs_as[25].dtc_as[13].occ_u8 "" UBYTE CnvRule_NumberOneToOne 1 0 0 255 ECU_ADDRESS 0x70015F45 /end MEASUREMENT
/begin MEASUREMENT dataJ1939Dm1Failrs_as[25].dtc_as[14].spn_u32 "" ULONG CnvRule_NumberOneToOne 1 0 0 4294967295 ECU_ADDRESS 0x70015F48 /end MEASUREMENT
/begin MEASUREMENT dataJ1939Dm1Failrs_as[25].dtc_as[14].fmi_u8 "" UBYTE CnvRule_NumberOneToOne 1 0 0 255 ECU_ADDRESS 0x70015F4C /end MEASUREMENT
/begin MEASUREMENT dataJ1939Dm1Failrs_as[25].dtc_as[14].occ_u8 "" UBYTE CnvRule_NumberOneToOne 1 0 0 255 ECU_ADDRESS 0x70015F4D /end MEASUREMENT
/begin MEASUREMENT dataJ1939Dm1Failrs_as[25].dtc_as[15].spn_u32 "" ULONG CnvRule_NumberOneToOne 1 0 0 4294967295 ECU_ADDRESS 0x70015F50 /end MEASUREMENT
/begin MEASUREMENT dataJ1939Dm1Failrs_as[25].dtc_as[15].fmi_u8 "" UBYTE CnvRule_NumberOneToOne 1 0 0 255 ECU_ADDRESS 0x70015F54 /end MEASUREMENT
/begin MEASUREMENT dataJ1939Dm1Failrs_as[25].dtc_as[15].occ_u8 "" UBYTE CnvRule_NumberOneToOne 1 0 0 255 ECU_ADDRESS 0x70015F55 /end MEASUREMENT
/begin MEASUREMENT dataJ1939Dm1Failrs_as[25].dtc_as[16].spn_u32 "" ULONG CnvRule_NumberOneToOne 1 0 0 4294967295 ECU_ADDRESS 0x70015F58 /end MEASUREMENT
/begin MEASUREMENT dataJ1939Dm1Failrs_as[25].dtc_as[16].fmi_u8 "" UBYTE CnvRule_NumberOneToOne 1 0 0 255 ECU_ADDRESS 0x70015F5C /end MEASUREMENT
/begin MEASUREMENT dataJ1939Dm1Failrs_as[25].dtc_as[16].occ_u8 "" UBYTE CnvRule_NumberOneToOne 1 0 0 255 ECU_ADDRESS 0x70015F5D /end MEASUREMENT
/begin MEASUREMENT dataJ1939Dm1Failrs_as[25].dtc_as[17].spn_u32 "" ULONG CnvRule_NumberOneToOne 1 0 0 4294967295 ECU_ADDRESS 0x70015F60 /end MEASUREMENT
/begin MEASUREMENT dataJ1939Dm1Failrs_as[25].dtc_as[17].fmi_u8 "" UBYTE CnvRule_NumberOneToOne 1 0 0 255 ECU_ADDRESS 0x70015F64 /end MEASUREMENT
/begin MEASUREMENT dataJ1939Dm1Failrs_as[25].dtc_as[17].occ_u8 "" UBYTE CnvRule_NumberOneToOne 1 0 0 255 ECU_ADDRESS 0x70015F65 /end MEASUREMENT
/begin MEASUREMENT dataJ1939Dm1Failrs_as[25].dtc_as[18].spn_u32 "" ULONG CnvRule_NumberOneToOne 1 0 0 4294967295 ECU_ADDRESS 0x70015F68 /end MEASUREMENT
/begin MEASUREMENT dataJ1939Dm1Failrs_as[25].dtc_as[18].fmi_u8 "" UBYTE CnvRule_NumberOneToOne 1 0 0 255 ECU_ADDRESS 0x70015F6C /end MEASUREMENT
/begin MEASUREMENT dataJ1939Dm1Failrs_as[25].dtc_as[18].occ_u8 "" UBYTE CnvRule_NumberOneToOne 1 0 0 255 ECU_ADDRESS 0x70015F6D /end MEASUREMENT
/begin MEASUREMENT dataJ1939Dm1Failrs_as[25].dtc_as[19].spn_u32 "" ULONG CnvRule_NumberOneToOne 1 0 0 4294967295 ECU_ADDRESS 0x70015F70 /end MEASUREMENT
/begin MEASUREMENT dataJ1939Dm1Failrs_as[25].dtc_as[19].fmi_u8 "" UBYTE CnvRule_NumberOneToOne 1 0 0 255 ECU_ADDRESS 0x70015F74 /end MEASUREMENT
/begin MEASUREMENT dataJ1939Dm1Failrs_as[25].dtc_as[19].occ_u8 "" UBYTE CnvRule_NumberOneToOne 1 0 0 255 ECU_ADDRESS 0x70015F75 /end MEASUREMENT
/begin MEASUREMENT dataJ1939Dm1Failrs_as[25].dtc_as[20].spn_u32 "" ULONG CnvRule_NumberOneToOne 1 0 0 4294967295 ECU_ADDRESS 0x70015F78 /end MEASUREMENT
/begin MEASUREMENT dataJ1939Dm1Failrs_as[25].dtc_as[20].fmi_u8 "" UBYTE CnvRule_NumberOneToOne 1 0 0 255 ECU_ADDRESS 0x70015F7C /end MEASUREMENT
/begin MEASUREMENT dataJ1939Dm1Failrs_as[25].dtc_as[20].occ_u8 "" UBYTE CnvRule_NumberOneToOne 1 0 0 255 ECU_ADDRESS 0x70015F7D /end MEASUREMENT
/begin MEASUREMENT dataJ1939Dm1Failrs_as[25].dtc_as "" UBYTE CnvRule_NumberOneToOne 1 0 0 255 ECU_ADDRESS 0x70015EE0 ARRAY_SIZE 160 /end MEASUREMENT
/begin MEASUREMENT dataJ1939Dm1Failrs_as[26].dtc_as[1].spn_u32 "" ULONG CnvRule_NumberOneToOne 1 0 0 4294967295 ECU_ADDRESS 0x70015F84 /end MEASUREMENT
/begin MEASUREMENT dataJ1939Dm1Failrs_as[26].dtc_as[1].fmi_u8 "" UBYTE CnvRule_NumberOneToOne 1 0 0 255 ECU_ADDRESS 0x70015F88 /end MEASUREMENT
/begin MEASUREMENT dataJ1939Dm1Failrs_as[26].dtc_as[1].occ_u8 "" UBYTE CnvRule_NumberOneToOne 1 0 0 255 ECU_ADDRESS 0x70015F89 /end MEASUREMENT
/begin MEASUREMENT dataJ1939Dm1Failrs_as[26].dtc_as[2].spn_u32 "" ULONG CnvRule_NumberOneToOne 1 0 0 4294967295 ECU_ADDRESS 0x70015F8C /end MEASUREMENT
/begin MEASUREMENT dataJ1939Dm1Failrs_as[26].dtc_as[2].fmi_u8 "" UBYTE CnvRule_NumberOneToOne 1 0 0 255 ECU_ADDRESS 0x70015F90 /end MEASUREMENT
/begin MEASUREMENT dataJ1939Dm1Failrs_as[26].dtc_as[2].occ_u8 "" UBYTE CnvRule_NumberOneToOne 1 0 0 255 ECU_ADDRESS 0x70015F91 /end MEASUREMENT
/begin MEASUREMENT dataJ1939Dm1Failrs_as[26].dtc_as[3].spn_u32 "" ULONG CnvRule_NumberOneToOne 1 0 0 4294967295 ECU_ADDRESS 0x70015F94 /end MEASUREMENT
/begin MEASUREMENT dataJ1939Dm1Failrs_as[26].dtc_as[3].fmi_u8 "" UBYTE CnvRule_NumberOneToOne 1 0 0 255 ECU_ADDRESS 0x70015F98 /end MEASUREMENT
/begin MEASUREMENT dataJ1939Dm1Failrs_as[26].dtc_as[3].occ_u8 "" UBYTE CnvRule_NumberOneToOne 1 0 0 255 ECU_ADDRESS 0x70015F99 /end MEASUREMENT
/begin MEASUREMENT dataJ1939Dm1Failrs_as[26].dtc_as[4].spn_u32 "" ULONG CnvRule_NumberOneToOne 1 0 0 4294967295 ECU_ADDRESS 0x70015F9C /end MEASUREMENT
/begin MEASUREMENT dataJ1939Dm1Failrs_as[26].dtc_as[4].fmi_u8 "" UBYTE CnvRule_NumberOneToOne 1 0 0 255 ECU_ADDRESS 0x70015FA0 /end MEASUREMENT
/begin MEASUREMENT dataJ1939Dm1Failrs_as[26].dtc_as[4].occ_u8 "" UBYTE CnvRule_NumberOneToOne 1 0 0 255 ECU_ADDRESS 0x70015FA1 /end MEASUREMENT
/begin MEASUREMENT dataJ1939Dm1Failrs_as[26].dtc_as[5].spn_u32 "" ULONG CnvRule_NumberOneToOne 1 0 0 4294967295 ECU_ADDRESS 0x70015FA4 /end MEASUREMENT
/begin MEASUREMENT dataJ1939Dm1Failrs_as[26].dtc_as[5].fmi_u8 "" UBYTE CnvRule_NumberOneToOne 1 0 0 255 ECU_ADDRESS 0x70015FA8 /end MEASUREMENT
/begin MEASUREMENT dataJ1939Dm1Failrs_as[26].dtc_as[5].occ_u8 "" UBYTE CnvRule_NumberOneToOne 1 0 0 255 ECU_ADDRESS 0x70015FA9 /end MEASUREMENT
/begin MEASUREMENT dataJ1939Dm1Failrs_as[26].dtc_as[6].spn_u32 "" ULONG CnvRule_NumberOneToOne 1 0 0 4294967295 ECU_ADDRESS 0x70015FAC /end MEASUREMENT
/begin MEASUREMENT dataJ1939Dm1Failrs_as[26].dtc_as[6].fmi_u8 "" UBYTE CnvRule_NumberOneToOne 1 0 0 255 ECU_ADDRESS 0x70015FB0 /end MEASUREMENT
/begin MEASUREMENT dataJ1939Dm1Failrs_as[26].dtc_as[6].occ_u8 "" UBYTE CnvRule_NumberOneToOne 1 0 0 255 ECU_ADDRESS 0x70015FB1 /end MEASUREMENT
/begin MEASUREMENT dataJ1939Dm1Failrs_as[26].dtc_as[7].spn_u32 "" ULONG CnvRule_NumberOneToOne 1 0 0 4294967295 ECU_ADDRESS 0x70015FB4 /end MEASUREMENT
/begin MEASUREMENT dataJ1939Dm1Failrs_as[26].dtc_as[7].fmi_u8 "" UBYTE CnvRule_NumberOneToOne 1 0 0 255 ECU_ADDRESS 0x70015FB8 /end MEASUREMENT
/begin MEASUREMENT dataJ1939Dm1Failrs_as[26].dtc_as[7].occ_u8 "" UBYTE CnvRule_NumberOneToOne 1 0 0 255 ECU_ADDRESS 0x70015FB9 /end MEASUREMENT
/begin MEASUREMENT dataJ1939Dm1Failrs_as[26].dtc_as[8].spn_u32 "" ULONG CnvRule_NumberOneToOne 1 0 0 4294967295 ECU_ADDRESS 0x70015FBC /end MEASUREMENT
/begin MEASUREMENT dataJ1939Dm1Failrs_as[26].dtc_as[8].fmi_u8 "" UBYTE CnvRule_NumberOneToOne 1 0 0 255 ECU_ADDRESS 0x70015FC0 /end MEASUREMENT
/begin MEASUREMENT dataJ1939Dm1Failrs_as[26].dtc_as[8].occ_u8 "" UBYTE CnvRule_NumberOneToOne 1 0 0 255 ECU_ADDRESS 0x70015FC1 /end MEASUREMENT
/begin MEASUREMENT dataJ1939Dm1Failrs_as[26].dtc_as[9].spn_u32 "" ULONG CnvRule_NumberOneToOne 1 0 0 4294967295 ECU_ADDRESS 0x70015FC4 /end MEASUREMENT
/begin MEASUREMENT dataJ1939Dm1Failrs_as[26].dtc_as[9].fmi_u8 "" UBYTE CnvRule_NumberOneToOne 1 0 0 255 ECU_ADDRESS 0x70015FC8 /end MEASUREMENT
/begin MEASUREMENT dataJ1939Dm1Failrs_as[26].dtc_as[9].occ_u8 "" UBYTE CnvRule_NumberOneToOne 1 0 0 255 ECU_ADDRESS 0x70015FC9 /end MEASUREMENT
/begin MEASUREMENT dataJ1939Dm1Failrs_as[26].dtc_as[10].spn_u32 "" ULONG CnvRule_NumberOneToOne 1 0 0 4294967295 ECU_ADDRESS 0x70015FCC /end MEASUREMENT
/begin MEASUREMENT dataJ1939Dm1Failrs_as[26].dtc_as[10].fmi_u8 "" UBYTE CnvRule_NumberOneToOne 1 0 0 255 ECU_ADDRESS 0x70015FD0 /end MEASUREMENT
/begin MEASUREMENT dataJ1939Dm1Failrs_as[26].dtc_as[10].occ_u8 "" UBYTE CnvRule_NumberOneToOne 1 0 0 255 ECU_ADDRESS 0x70015FD1 /end MEASUREMENT
/begin MEASUREMENT dataJ1939Dm1Failrs_as[26].dtc_as[11].spn_u32 "" ULONG CnvRule_NumberOneToOne 1 0 0 4294967295 ECU_ADDRESS 0x70015FD4 /end MEASUREMENT
/begin MEASUREMENT dataJ1939Dm1Failrs_as[26].dtc_as[11].fmi_u8 "" UBYTE CnvRule_NumberOneToOne 1 0 0 255 ECU_ADDRESS 0x70015FD8 /end MEASUREMENT
/begin MEASUREMENT dataJ1939Dm1Failrs_as[26].dtc_as[11].occ_u8 "" UBYTE CnvRule_NumberOneToOne 1 0 0 255 ECU_ADDRESS 0x70015FD9 /end MEASUREMENT
/begin MEASUREMENT dataJ1939Dm1Failrs_as[26].dtc_as[12].spn_u32 "" ULONG CnvRule_NumberOneToOne 1 0 0 4294967295 ECU_ADDRESS 0x70015FDC /end MEASUREMENT
/begin MEASUREMENT dataJ1939Dm1Failrs_as[26].dtc_as[12].fmi_u8 "" UBYTE CnvRule_NumberOneToOne 1 0 0 255 ECU_ADDRESS 0x70015FE0 /end MEASUREMENT
/begin MEASUREMENT dataJ1939Dm1Failrs_as[26].dtc_as[12].occ_u8 "" UBYTE CnvRule_NumberOneToOne 1 0 0 255 ECU_ADDRESS 0x70015FE1 /end MEASUREMENT
/begin MEASUREMENT dataJ1939Dm1Failrs_as[26].dtc_as[13].spn_u32 "" ULONG CnvRule_NumberOneToOne 1 0 0 4294967295 ECU_ADDRESS 0x70015FE4 /end MEASUREMENT
/begin MEASUREMENT dataJ1939Dm1Failrs_as[26].dtc_as[13].fmi_u8 "" UBYTE CnvRule_NumberOneToOne 1 0 0 255 ECU_ADDRESS 0x70015FE8 /end MEASUREMENT
/begin MEASUREMENT dataJ1939Dm1Failrs_as[26].dtc_as[13].occ_u8 "" UBYTE CnvRule_NumberOneToOne 1 0 0 255 ECU_ADDRESS 0x70015FE9 /end MEASUREMENT
/begin MEASUREMENT dataJ1939Dm1Failrs_as[26].dtc_as[14].spn_u32 "" ULONG CnvRule_NumberOneToOne 1 0 0 4294967295 ECU_ADDRESS 0x70015FEC /end MEASUREMENT
/begin MEASUREMENT dataJ1939Dm1Failrs_as[26].dtc_as[14].fmi_u8 "" UBYTE CnvRule_NumberOneToOne 1 0 0 255 ECU_ADDRESS 0x70015FF0 /end MEASUREMENT
/begin MEASUREMENT dataJ1939Dm1Failrs_as[26].dtc_as[14].occ_u8 "" UBYTE CnvRule_NumberOneToOne 1 0 0 255 ECU_ADDRESS 0x70015FF1 /end MEASUREMENT
/begin MEASUREMENT dataJ1939Dm1Failrs_as[26].dtc_as[15].spn_u32 "" ULONG CnvRule_NumberOneToOne 1 0 0 4294967295 ECU_ADDRESS 0x70015FF4 /end MEASUREMENT
/begin MEASUREMENT dataJ1939Dm1Failrs_as[26].dtc_as[15].fmi_u8 "" UBYTE CnvRule_NumberOneToOne 1 0 0 255 ECU_ADDRESS 0x70015FF8 /end MEASUREMENT
/begin MEASUREMENT dataJ1939Dm1Failrs_as[26].dtc_as[15].occ_u8 "" UBYTE CnvRule_NumberOneToOne 1 0 0 255 ECU_ADDRESS 0x70015FF9 /end MEASUREMENT
/begin MEASUREMENT dataJ1939Dm1Failrs_as[26].dtc_as[16].spn_u32 "" ULONG CnvRule_NumberOneToOne 1 0 0 4294967295 ECU_ADDRESS 0x70015FFC /end MEASUREMENT
/begin MEASUREMENT dataJ1939Dm1Failrs_as[26].dtc_as[16].fmi_u8 "" UBYTE CnvRule_NumberOneToOne 1 0 0 255 ECU_ADDRESS 0x70016000 /end MEASUREMENT
/begin MEASUREMENT dataJ1939Dm1Failrs_as[26].dtc_as[16].occ_u8 "" UBYTE CnvRule_NumberOneToOne 1 0 0 255 ECU_ADDRESS 0x70016001 /end MEASUREMENT
/begin MEASUREMENT dataJ1939Dm1Failrs_as[26].dtc_as[17].spn_u32 "" ULONG CnvRule_NumberOneToOne 1 0 0 4294967295 ECU_ADDRESS 0x70016004 /end MEASUREMENT
/begin MEASUREMENT dataJ1939Dm1Failrs_as[26].dtc_as[17].fmi_u8 "" UBYTE CnvRule_NumberOneToOne 1 0 0 255 ECU_ADDRESS 0x70016008 /end MEASUREMENT
/begin MEASUREMENT dataJ1939Dm1Failrs_as[26].dtc_as[17].occ_u8 "" UBYTE CnvRule_NumberOneToOne 1 0 0 255 ECU_ADDRESS 0x70016009 /end MEASUREMENT
/begin MEASUREMENT dataJ1939Dm1Failrs_as[26].dtc_as[18].spn_u32 "" ULONG CnvRule_NumberOneToOne 1 0 0 4294967295 ECU_ADDRESS 0x7001600C /end MEASUREMENT
/begin MEASUREMENT dataJ1939Dm1Failrs_as[26].dtc_as[18].fmi_u8 "" UBYTE CnvRule_NumberOneToOne 1 0 0 255 ECU_ADDRESS 0x70016010 /end MEASUREMENT
/begin MEASUREMENT dataJ1939Dm1Failrs_as[26].dtc_as[18].occ_u8 "" UBYTE CnvRule_NumberOneToOne 1 0 0 255 ECU_ADDRESS 0x70016011 /end MEASUREMENT
/begin MEASUREMENT dataJ1939Dm1Failrs_as[26].dtc_as[19].spn_u32 "" ULONG CnvRule_NumberOneToOne 1 0 0 4294967295 ECU_ADDRESS 0x70016014 /end MEASUREMENT
/begin MEASUREMENT dataJ1939Dm1Failrs_as[26].dtc_as[19].fmi_u8 "" UBYTE CnvRule_NumberOneToOne 1 0 0 255 ECU_ADDRESS 0x70016018 /end MEASUREMENT
/begin MEASUREMENT dataJ1939Dm1Failrs_as[26].dtc_as[19].occ_u8 "" UBYTE CnvRule_NumberOneToOne 1 0 0 255 ECU_ADDRESS 0x70016019 /end MEASUREMENT
/begin MEASUREMENT dataJ1939Dm1Failrs_as[26].dtc_as[20].spn_u32 "" ULONG CnvRule_NumberOneToOne 1 0 0 4294967295 ECU_ADDRESS 0x7001601C /end MEASUREMENT
/begin MEASUREMENT dataJ1939Dm1Failrs_as[26].dtc_as[20].fmi_u8 "" UBYTE CnvRule_NumberOneToOne 1 0 0 255 ECU_ADDRESS 0x70016020 /end MEASUREMENT
/begin MEASUREMENT dataJ1939Dm1Failrs_as[26].dtc_as[20].occ_u8 "" UBYTE CnvRule_NumberOneToOne 1 0 0 255 ECU_ADDRESS 0x70016021 /end MEASUREMENT
/begin MEASUREMENT dataJ1939Dm1Failrs_as[26].dtc_as "" UBYTE CnvRule_NumberOneToOne 1 0 0 255 ECU_ADDRESS 0x70015F84 ARRAY_SIZE 160 /end MEASUREMENT
/begin MEASUREMENT dataJ1939Dm1Failrs_as[27].dtc_as[1].spn_u32 "" ULONG CnvRule_NumberOneToOne 1 0 0 4294967295 ECU_ADDRESS 0x70016028 /end MEASUREMENT
/begin MEASUREMENT dataJ1939Dm1Failrs_as[27].dtc_as[1].fmi_u8 "" UBYTE CnvRule_NumberOneToOne 1 0 0 255 ECU_ADDRESS 0x7001602C /end MEASUREMENT
/begin MEASUREMENT dataJ1939Dm1Failrs_as[27].dtc_as[1].occ_u8 "" UBYTE CnvRule_NumberOneToOne 1 0 0 255 ECU_ADDRESS 0x7001602D /end MEASUREMENT
/begin MEASUREMENT dataJ1939Dm1Failrs_as[27].dtc_as[2].spn_u32 "" ULONG CnvRule_NumberOneToOne 1 0 0 4294967295 ECU_ADDRESS 0x70016030 /end MEASUREMENT
/begin MEASUREMENT dataJ1939Dm1Failrs_as[27].dtc_as[2].fmi_u8 "" UBYTE CnvRule_NumberOneToOne 1 0 0 255 ECU_ADDRESS 0x70016034 /end MEASUREMENT
/begin MEASUREMENT dataJ1939Dm1Failrs_as[27].dtc_as[2].occ_u8 "" UBYTE CnvRule_NumberOneToOne 1 0 0 255 ECU_ADDRESS 0x70016035 /end MEASUREMENT
/begin MEASUREMENT dataJ1939Dm1Failrs_as[27].dtc_as[3].spn_u32 "" ULONG CnvRule_NumberOneToOne 1 0 0 4294967295 ECU_ADDRESS 0x70016038 /end MEASUREMENT
/begin MEASUREMENT dataJ1939Dm1Failrs_as[27].dtc_as[3].fmi_u8 "" UBYTE CnvRule_NumberOneToOne 1 0 0 255 ECU_ADDRESS 0x7001603C /end MEASUREMENT
/begin MEASUREMENT dataJ1939Dm1Failrs_as[27].dtc_as[3].occ_u8 "" UBYTE CnvRule_NumberOneToOne 1 0 0 255 ECU_ADDRESS 0x7001603D /end MEASUREMENT
/begin MEASUREMENT dataJ1939Dm1Failrs_as[27].dtc_as[4].spn_u32 "" ULONG CnvRule_NumberOneToOne 1 0 0 4294967295 ECU_ADDRESS 0x70016040 /end MEASUREMENT
/begin MEASUREMENT dataJ1939Dm1Failrs_as[27].dtc_as[4].fmi_u8 "" UBYTE CnvRule_NumberOneToOne 1 0 0 255 ECU_ADDRESS 0x70016044 /end MEASUREMENT
/begin MEASUREMENT dataJ1939Dm1Failrs_as[27].dtc_as[4].occ_u8 "" UBYTE CnvRule_NumberOneToOne 1 0 0 255 ECU_ADDRESS 0x70016045 /end MEASUREMENT
/begin MEASUREMENT dataJ1939Dm1Failrs_as[27].dtc_as[5].spn_u32 "" ULONG CnvRule_NumberOneToOne 1 0 0 4294967295 ECU_ADDRESS 0x70016048 /end MEASUREMENT
/begin MEASUREMENT dataJ1939Dm1Failrs_as[27].dtc_as[5].fmi_u8 "" UBYTE CnvRule_NumberOneToOne 1 0 0 255 ECU_ADDRESS 0x7001604C /end MEASUREMENT
/begin MEASUREMENT dataJ1939Dm1Failrs_as[27].dtc_as[5].occ_u8 "" UBYTE CnvRule_NumberOneToOne 1 0 0 255 ECU_ADDRESS 0x7001604D /end MEASUREMENT
/begin MEASUREMENT dataJ1939Dm1Failrs_as[27].dtc_as[6].spn_u32 "" ULONG CnvRule_NumberOneToOne 1 0 0 4294967295 ECU_ADDRESS 0x70016050 /end MEASUREMENT
/begin MEASUREMENT dataJ1939Dm1Failrs_as[27].dtc_as[6].fmi_u8 "" UBYTE CnvRule_NumberOneToOne 1 0 0 255 ECU_ADDRESS 0x70016054 /end MEASUREMENT
/begin MEASUREMENT dataJ1939Dm1Failrs_as[27].dtc_as[6].occ_u8 "" UBYTE CnvRule_NumberOneToOne 1 0 0 255 ECU_ADDRESS 0x70016055 /end MEASUREMENT
/begin MEASUREMENT dataJ1939Dm1Failrs_as[27].dtc_as[7].spn_u32 "" ULONG CnvRule_NumberOneToOne 1 0 0 4294967295 ECU_ADDRESS 0x70016058 /end MEASUREMENT
/begin MEASUREMENT dataJ1939Dm1Failrs_as[27].dtc_as[7].fmi_u8 "" UBYTE CnvRule_NumberOneToOne 1 0 0 255 ECU_ADDRESS 0x7001605C /end MEASUREMENT
/begin MEASUREMENT dataJ1939Dm1Failrs_as[27].dtc_as[7].occ_u8 "" UBYTE CnvRule_NumberOneToOne 1 0 0 255 ECU_ADDRESS 0x7001605D /end MEASUREMENT
/begin MEASUREMENT dataJ1939Dm1Failrs_as[27].dtc_as[8].spn_u32 "" ULONG CnvRule_NumberOneToOne 1 0 0 4294967295 ECU_ADDRESS 0x70016060 /end MEASUREMENT
/begin MEASUREMENT dataJ1939Dm1Failrs_as[27].dtc_as[8].fmi_u8 "" UBYTE CnvRule_NumberOneToOne 1 0 0 255 ECU_ADDRESS 0x70016064 /end MEASUREMENT
/begin MEASUREMENT dataJ1939Dm1Failrs_as[27].dtc_as[8].occ_u8 "" UBYTE CnvRule_NumberOneToOne 1 0 0 255 ECU_ADDRESS 0x70016065 /end MEASUREMENT
/begin MEASUREMENT dataJ1939Dm1Failrs_as[27].dtc_as[9].spn_u32 "" ULONG CnvRule_NumberOneToOne 1 0 0 4294967295 ECU_ADDRESS 0x70016068 /end MEASUREMENT
/begin MEASUREMENT dataJ1939Dm1Failrs_as[27].dtc_as[9].fmi_u8 "" UBYTE CnvRule_NumberOneToOne 1 0 0 255 ECU_ADDRESS 0x7001606C /end MEASUREMENT
/begin MEASUREMENT dataJ1939Dm1Failrs_as[27].dtc_as[9].occ_u8 "" UBYTE CnvRule_NumberOneToOne 1 0 0 255 ECU_ADDRESS 0x7001606D /end MEASUREMENT
/begin MEASUREMENT dataJ1939Dm1Failrs_as[27].dtc_as[10].spn_u32 "" ULONG CnvRule_NumberOneToOne 1 0 0 4294967295 ECU_ADDRESS 0x70016070 /end MEASUREMENT
/begin MEASUREMENT dataJ1939Dm1Failrs_as[27].dtc_as[10].fmi_u8 "" UBYTE CnvRule_NumberOneToOne 1 0 0 255 ECU_ADDRESS 0x70016074 /end MEASUREMENT
/begin MEASUREMENT dataJ1939Dm1Failrs_as[27].dtc_as[10].occ_u8 "" UBYTE CnvRule_NumberOneToOne 1 0 0 255 ECU_ADDRESS 0x70016075 /end MEASUREMENT
/begin MEASUREMENT dataJ1939Dm1Failrs_as[27].dtc_as[11].spn_u32 "" ULONG CnvRule_NumberOneToOne 1 0 0 4294967295 ECU_ADDRESS 0x70016078 /end MEASUREMENT
/begin MEASUREMENT dataJ1939Dm1Failrs_as[27].dtc_as[11].fmi_u8 "" UBYTE CnvRule_NumberOneToOne 1 0 0 255 ECU_ADDRESS 0x7001607C /end MEASUREMENT
/begin MEASUREMENT dataJ1939Dm1Failrs_as[27].dtc_as[11].occ_u8 "" UBYTE CnvRule_NumberOneToOne 1 0 0 255 ECU_ADDRESS 0x7001607D /end MEASUREMENT
/begin MEASUREMENT dataJ1939Dm1Failrs_as[27].dtc_as[12].spn_u32 "" ULONG CnvRule_NumberOneToOne 1 0 0 4294967295 ECU_ADDRESS 0x70016080 /end MEASUREMENT
/begin MEASUREMENT dataJ1939Dm1Failrs_as[27].dtc_as[12].fmi_u8 "" UBYTE CnvRule_NumberOneToOne 1 0 0 255 ECU_ADDRESS 0x70016084 /end MEASUREMENT
/begin MEASUREMENT dataJ1939Dm1Failrs_as[27].dtc_as[12].occ_u8 "" UBYTE CnvRule_NumberOneToOne 1 0 0 255 ECU_ADDRESS 0x70016085 /end MEASUREMENT
/begin MEASUREMENT dataJ1939Dm1Failrs_as[27].dtc_as[13].spn_u32 "" ULONG CnvRule_NumberOneToOne 1 0 0 4294967295 ECU_ADDRESS 0x70016088 /end MEASUREMENT
/begin MEASUREMENT dataJ1939Dm1Failrs_as[27].dtc_as[13].fmi_u8 "" UBYTE CnvRule_NumberOneToOne 1 0 0 255 ECU_ADDRESS 0x7001608C /end MEASUREMENT
/begin MEASUREMENT dataJ1939Dm1Failrs_as[27].dtc_as[13].occ_u8 "" UBYTE CnvRule_NumberOneToOne 1 0 0 255 ECU_ADDRESS 0x7001608D /end MEASUREMENT
/begin MEASUREMENT dataJ1939Dm1Failrs_as[27].dtc_as[14].spn_u32 "" ULONG CnvRule_NumberOneToOne 1 0 0 4294967295 ECU_ADDRESS 0x70016090 /end MEASUREMENT
/begin MEASUREMENT dataJ1939Dm1Failrs_as[27].dtc_as[14].fmi_u8 "" UBYTE CnvRule_NumberOneToOne 1 0 0 255 ECU_ADDRESS 0x70016094 /end MEASUREMENT
/begin MEASUREMENT dataJ1939Dm1Failrs_as[27].dtc_as[14].occ_u8 "" UBYTE CnvRule_NumberOneToOne 1 0 0 255 ECU_ADDRESS 0x70016095 /end MEASUREMENT
/begin MEASUREMENT dataJ1939Dm1Failrs_as[27].dtc_as[15].spn_u32 "" ULONG CnvRule_NumberOneToOne 1 0 0 4294967295 ECU_ADDRESS 0x70016098 /end MEASUREMENT
/begin MEASUREMENT dataJ1939Dm1Failrs_as[27].dtc_as[15].fmi_u8 "" UBYTE CnvRule_NumberOneToOne 1 0 0 255 ECU_ADDRESS 0x7001609C /end MEASUREMENT
/begin MEASUREMENT dataJ1939Dm1Failrs_as[27].dtc_as[15].occ_u8 "" UBYTE CnvRule_NumberOneToOne 1 0 0 255 ECU_ADDRESS 0x7001609D /end MEASUREMENT
/begin MEASUREMENT dataJ1939Dm1Failrs_as[27].dtc_as[16].spn_u32 "" ULONG CnvRule_NumberOneToOne 1 0 0 4294967295 ECU_ADDRESS 0x700160A0 /end MEASUREMENT
/begin MEASUREMENT dataJ1939Dm1Failrs_as[27].dtc_as[16].fmi_u8 "" UBYTE CnvRule_NumberOneToOne 1 0 0 255 ECU_ADDRESS 0x700160A4 /end MEASUREMENT
/begin MEASUREMENT dataJ1939Dm1Failrs_as[27].dtc_as[16].occ_u8 "" UBYTE CnvRule_NumberOneToOne 1 0 0 255 ECU_ADDRESS 0x700160A5 /end MEASUREMENT
/begin MEASUREMENT dataJ1939Dm1Failrs_as[27].dtc_as[17].spn_u32 "" ULONG CnvRule_NumberOneToOne 1 0 0 4294967295 ECU_ADDRESS 0x700160A8 /end MEASUREMENT
/begin MEASUREMENT dataJ1939Dm1Failrs_as[27].dtc_as[17].fmi_u8 "" UBYTE CnvRule_NumberOneToOne 1 0 0 255 ECU_ADDRESS 0x700160AC /end MEASUREMENT
/begin MEASUREMENT dataJ1939Dm1Failrs_as[27].dtc_as[17].occ_u8 "" UBYTE CnvRule_NumberOneToOne 1 0 0 255 ECU_ADDRESS 0x700160AD /end MEASUREMENT
/begin MEASUREMENT dataJ1939Dm1Failrs_as[27].dtc_as[18].spn_u32 "" ULONG CnvRule_NumberOneToOne 1 0 0 4294967295 ECU_ADDRESS 0x700160B0 /end MEASUREMENT
/begin MEASUREMENT dataJ1939Dm1Failrs_as[27].dtc_as[18].fmi_u8 "" UBYTE CnvRule_NumberOneToOne 1 0 0 255 ECU_ADDRESS 0x700160B4 /end MEASUREMENT
/begin MEASUREMENT dataJ1939Dm1Failrs_as[27].dtc_as[18].occ_u8 "" UBYTE CnvRule_NumberOneToOne 1 0 0 255 ECU_ADDRESS 0x700160B5 /end MEASUREMENT
/begin MEASUREMENT dataJ1939Dm1Failrs_as[27].dtc_as[19].spn_u32 "" ULONG CnvRule_NumberOneToOne 1 0 0 4294967295 ECU_ADDRESS 0x700160B8 /end MEASUREMENT
/begin MEASUREMENT dataJ1939Dm1Failrs_as[27].dtc_as[19].fmi_u8 "" UBYTE CnvRule_NumberOneToOne 1 0 0 255 ECU_ADDRESS 0x700160BC /end MEASUREMENT
/begin MEASUREMENT dataJ1939Dm1Failrs_as[27].dtc_as[19].occ_u8 "" UBYTE CnvRule_NumberOneToOne 1 0 0 255 ECU_ADDRESS 0x700160BD /end MEASUREMENT
/begin MEASUREMENT dataJ1939Dm1Failrs_as[27].dtc_as[20].spn_u32 "" ULONG CnvRule_NumberOneToOne 1 0 0 4294967295 ECU_ADDRESS 0x700160C0 /end MEASUREMENT
/begin MEASUREMENT dataJ1939Dm1Failrs_as[27].dtc_as[20].fmi_u8 "" UBYTE CnvRule_NumberOneToOne 1 0 0 255 ECU_ADDRESS 0x700160C4 /end MEASUREMENT
/begin MEASUREMENT dataJ1939Dm1Failrs_as[27].dtc_as[20].occ_u8 "" UBYTE CnvRule_NumberOneToOne 1 0 0 255 ECU_ADDRESS 0x700160C5 /end MEASUREMENT
/begin MEASUREMENT dataJ1939Dm1Failrs_as[27].dtc_as "" UBYTE CnvRule_NumberOneToOne 1 0 0 255 ECU_ADDRESS 0x70016028 ARRAY_SIZE 160 /end MEASUREMENT
/begin MEASUREMENT dataJ1939Dm1Failrs_as[28].dtc_as[1].spn_u32 "" ULONG CnvRule_NumberOneToOne 1 0 0 4294967295 ECU_ADDRESS 0x700160CC /end MEASUREMENT
/begin MEASUREMENT dataJ1939Dm1Failrs_as[28].dtc_as[1].fmi_u8 "" UBYTE CnvRule_NumberOneToOne 1 0 0 255 ECU_ADDRESS 0x700160D0 /end MEASUREMENT
/begin MEASUREMENT dataJ1939Dm1Failrs_as[28].dtc_as[1].occ_u8 "" UBYTE CnvRule_NumberOneToOne 1 0 0 255 ECU_ADDRESS 0x700160D1 /end MEASUREMENT
/begin MEASUREMENT dataJ1939Dm1Failrs_as[28].dtc_as[2].spn_u32 "" ULONG CnvRule_NumberOneToOne 1 0 0 4294967295 ECU_ADDRESS 0x700160D4 /end MEASUREMENT
/begin MEASUREMENT dataJ1939Dm1Failrs_as[28].dtc_as[2].fmi_u8 "" UBYTE CnvRule_NumberOneToOne 1 0 0 255 ECU_ADDRESS 0x700160D8 /end MEASUREMENT
/begin MEASUREMENT dataJ1939Dm1Failrs_as[28].dtc_as[2].occ_u8 "" UBYTE CnvRule_NumberOneToOne 1 0 0 255 ECU_ADDRESS 0x700160D9 /end MEASUREMENT
/begin MEASUREMENT dataJ1939Dm1Failrs_as[28].dtc_as[3].spn_u32 "" ULONG CnvRule_NumberOneToOne 1 0 0 4294967295 ECU_ADDRESS 0x700160DC /end MEASUREMENT
/begin MEASUREMENT dataJ1939Dm1Failrs_as[28].dtc_as[3].fmi_u8 "" UBYTE CnvRule_NumberOneToOne 1 0 0 255 ECU_ADDRESS 0x700160E0 /end MEASUREMENT
/begin MEASUREMENT dataJ1939Dm1Failrs_as[28].dtc_as[3].occ_u8 "" UBYTE CnvRule_NumberOneToOne 1 0 0 255 ECU_ADDRESS 0x700160E1 /end MEASUREMENT
/begin MEASUREMENT dataJ1939Dm1Failrs_as[28].dtc_as[4].spn_u32 "" ULONG CnvRule_NumberOneToOne 1 0 0 4294967295 ECU_ADDRESS 0x700160E4 /end MEASUREMENT
/begin MEASUREMENT dataJ1939Dm1Failrs_as[28].dtc_as[4].fmi_u8 "" UBYTE CnvRule_NumberOneToOne 1 0 0 255 ECU_ADDRESS 0x700160E8 /end MEASUREMENT
/begin MEASUREMENT dataJ1939Dm1Failrs_as[28].dtc_as[4].occ_u8 "" UBYTE CnvRule_NumberOneToOne 1 0 0 255 ECU_ADDRESS 0x700160E9 /end MEASUREMENT
/begin MEASUREMENT dataJ1939Dm1Failrs_as[28].dtc_as[5].spn_u32 "" ULONG CnvRule_NumberOneToOne 1 0 0 4294967295 ECU_ADDRESS 0x700160EC /end MEASUREMENT
/begin MEASUREMENT dataJ1939Dm1Failrs_as[28].dtc_as[5].fmi_u8 "" UBYTE CnvRule_NumberOneToOne 1 0 0 255 ECU_ADDRESS 0x700160F0 /end MEASUREMENT
/begin MEASUREMENT dataJ1939Dm1Failrs_as[28].dtc_as[5].occ_u8 "" UBYTE CnvRule_NumberOneToOne 1 0 0 255 ECU_ADDRESS 0x700160F1 /end MEASUREMENT
/begin MEASUREMENT dataJ1939Dm1Failrs_as[28].dtc_as[6].spn_u32 "" ULONG CnvRule_NumberOneToOne 1 0 0 4294967295 ECU_ADDRESS 0x700160F4 /end MEASUREMENT
/begin MEASUREMENT dataJ1939Dm1Failrs_as[28].dtc_as[6].fmi_u8 "" UBYTE CnvRule_NumberOneToOne 1 0 0 255 ECU_ADDRESS 0x700160F8 /end MEASUREMENT
/begin MEASUREMENT dataJ1939Dm1Failrs_as[28].dtc_as[6].occ_u8 "" UBYTE CnvRule_NumberOneToOne 1 0 0 255 ECU_ADDRESS 0x700160F9 /end MEASUREMENT
/begin MEASUREMENT dataJ1939Dm1Failrs_as[28].dtc_as[7].spn_u32 "" ULONG CnvRule_NumberOneToOne 1 0 0 4294967295 ECU_ADDRESS 0x700160FC /end MEASUREMENT
/begin MEASUREMENT dataJ1939Dm1Failrs_as[28].dtc_as[7].fmi_u8 "" UBYTE CnvRule_NumberOneToOne 1 0 0 255 ECU_ADDRESS 0x70016100 /end MEASUREMENT
/begin MEASUREMENT dataJ1939Dm1Failrs_as[28].dtc_as[7].occ_u8 "" UBYTE CnvRule_NumberOneToOne 1 0 0 255 ECU_ADDRESS 0x70016101 /end MEASUREMENT
/begin MEASUREMENT dataJ1939Dm1Failrs_as[28].dtc_as[8].spn_u32 "" ULONG CnvRule_NumberOneToOne 1 0 0 4294967295 ECU_ADDRESS 0x70016104 /end MEASUREMENT
/begin MEASUREMENT dataJ1939Dm1Failrs_as[28].dtc_as[8].fmi_u8 "" UBYTE CnvRule_NumberOneToOne 1 0 0 255 ECU_ADDRESS 0x70016108 /end MEASUREMENT
/begin MEASUREMENT dataJ1939Dm1Failrs_as[28].dtc_as[8].occ_u8 "" UBYTE CnvRule_NumberOneToOne 1 0 0 255 ECU_ADDRESS 0x70016109 /end MEASUREMENT
/begin MEASUREMENT dataJ1939Dm1Failrs_as[28].dtc_as[9].spn_u32 "" ULONG CnvRule_NumberOneToOne 1 0 0 4294967295 ECU_ADDRESS 0x7001610C /end MEASUREMENT
/begin MEASUREMENT dataJ1939Dm1Failrs_as[28].dtc_as[9].fmi_u8 "" UBYTE CnvRule_NumberOneToOne 1 0 0 255 ECU_ADDRESS 0x70016110 /end MEASUREMENT
/begin MEASUREMENT dataJ1939Dm1Failrs_as[28].dtc_as[9].occ_u8 "" UBYTE CnvRule_NumberOneToOne 1 0 0 255 ECU_ADDRESS 0x70016111 /end MEASUREMENT
/begin MEASUREMENT dataJ1939Dm1Failrs_as[28].dtc_as[10].spn_u32 "" ULONG CnvRule_NumberOneToOne 1 0 0 4294967295 ECU_ADDRESS 0x70016114 /end MEASUREMENT
/begin MEASUREMENT dataJ1939Dm1Failrs_as[28].dtc_as[10].fmi_u8 "" UBYTE CnvRule_NumberOneToOne 1 0 0 255 ECU_ADDRESS 0x70016118 /end MEASUREMENT
/begin MEASUREMENT dataJ1939Dm1Failrs_as[28].dtc_as[10].occ_u8 "" UBYTE CnvRule_NumberOneToOne 1 0 0 255 ECU_ADDRESS 0x70016119 /end MEASUREMENT
/begin MEASUREMENT dataJ1939Dm1Failrs_as[28].dtc_as[11].spn_u32 "" ULONG CnvRule_NumberOneToOne 1 0 0 4294967295 ECU_ADDRESS 0x7001611C /end MEASUREMENT
/begin MEASUREMENT dataJ1939Dm1Failrs_as[28].dtc_as[11].fmi_u8 "" UBYTE CnvRule_NumberOneToOne 1 0 0 255 ECU_ADDRESS 0x70016120 /end MEASUREMENT
/begin MEASUREMENT dataJ1939Dm1Failrs_as[28].dtc_as[11].occ_u8 "" UBYTE CnvRule_NumberOneToOne 1 0 0 255 ECU_ADDRESS 0x70016121 /end MEASUREMENT
/begin MEASUREMENT dataJ1939Dm1Failrs_as[28].dtc_as[12].spn_u32 "" ULONG CnvRule_NumberOneToOne 1 0 0 4294967295 ECU_ADDRESS 0x70016124 /end MEASUREMENT
/begin MEASUREMENT dataJ1939Dm1Failrs_as[28].dtc_as[12].fmi_u8 "" UBYTE CnvRule_NumberOneToOne 1 0 0 255 ECU_ADDRESS 0x70016128 /end MEASUREMENT
/begin MEASUREMENT dataJ1939Dm1Failrs_as[28].dtc_as[12].occ_u8 "" UBYTE CnvRule_NumberOneToOne 1 0 0 255 ECU_ADDRESS 0x70016129 /end MEASUREMENT
/begin MEASUREMENT dataJ1939Dm1Failrs_as[28].dtc_as[13].spn_u32 "" ULONG CnvRule_NumberOneToOne 1 0 0 4294967295 ECU_ADDRESS 0x7001612C /end MEASUREMENT
/begin MEASUREMENT dataJ1939Dm1Failrs_as[28].dtc_as[13].fmi_u8 "" UBYTE CnvRule_NumberOneToOne 1 0 0 255 ECU_ADDRESS 0x70016130 /end MEASUREMENT
/begin MEASUREMENT dataJ1939Dm1Failrs_as[28].dtc_as[13].occ_u8 "" UBYTE CnvRule_NumberOneToOne 1 0 0 255 ECU_ADDRESS 0x70016131 /end MEASUREMENT
/begin MEASUREMENT dataJ1939Dm1Failrs_as[28].dtc_as[14].spn_u32 "" ULONG CnvRule_NumberOneToOne 1 0 0 4294967295 ECU_ADDRESS 0x70016134 /end MEASUREMENT
/begin MEASUREMENT dataJ1939Dm1Failrs_as[28].dtc_as[14].fmi_u8 "" UBYTE CnvRule_NumberOneToOne 1 0 0 255 ECU_ADDRESS 0x70016138 /end MEASUREMENT
/begin MEASUREMENT dataJ1939Dm1Failrs_as[28].dtc_as[14].occ_u8 "" UBYTE CnvRule_NumberOneToOne 1 0 0 255 ECU_ADDRESS 0x70016139 /end MEASUREMENT
/begin MEASUREMENT dataJ1939Dm1Failrs_as[28].dtc_as[15].spn_u32 "" ULONG CnvRule_NumberOneToOne 1 0 0 4294967295 ECU_ADDRESS 0x7001613C /end MEASUREMENT
/begin MEASUREMENT dataJ1939Dm1Failrs_as[28].dtc_as[15].fmi_u8 "" UBYTE CnvRule_NumberOneToOne 1 0 0 255 ECU_ADDRESS 0x70016140 /end MEASUREMENT
/begin MEASUREMENT dataJ1939Dm1Failrs_as[28].dtc_as[15].occ_u8 "" UBYTE CnvRule_NumberOneToOne 1 0 0 255 ECU_ADDRESS 0x70016141 /end MEASUREMENT
/begin MEASUREMENT dataJ1939Dm1Failrs_as[28].dtc_as[16].spn_u32 "" ULONG CnvRule_NumberOneToOne 1 0 0 4294967295 ECU_ADDRESS 0x70016144 /end MEASUREMENT
/begin MEASUREMENT dataJ1939Dm1Failrs_as[28].dtc_as[16].fmi_u8 "" UBYTE CnvRule_NumberOneToOne 1 0 0 255 ECU_ADDRESS 0x70016148 /end MEASUREMENT
/begin MEASUREMENT dataJ1939Dm1Failrs_as[28].dtc_as[16].occ_u8 "" UBYTE CnvRule_NumberOneToOne 1 0 0 255 ECU_ADDRESS 0x70016149 /end MEASUREMENT
/begin MEASUREMENT dataJ1939Dm1Failrs_as[28].dtc_as[17].spn_u32 "" ULONG CnvRule_NumberOneToOne 1 0 0 4294967295 ECU_ADDRESS 0x7001614C /end MEASUREMENT
/begin MEASUREMENT dataJ1939Dm1Failrs_as[28].dtc_as[17].fmi_u8 "" UBYTE CnvRule_NumberOneToOne 1 0 0 255 ECU_ADDRESS 0x70016150 /end MEASUREMENT
/begin MEASUREMENT dataJ1939Dm1Failrs_as[28].dtc_as[17].occ_u8 "" UBYTE CnvRule_NumberOneToOne 1 0 0 255 ECU_ADDRESS 0x70016151 /end MEASUREMENT
/begin MEASUREMENT dataJ1939Dm1Failrs_as[28].dtc_as[18].spn_u32 "" ULONG CnvRule_NumberOneToOne 1 0 0 4294967295 ECU_ADDRESS 0x70016154 /end MEASUREMENT
/begin MEASUREMENT dataJ1939Dm1Failrs_as[28].dtc_as[18].fmi_u8 "" UBYTE CnvRule_NumberOneToOne 1 0 0 255 ECU_ADDRESS 0x70016158 /end MEASUREMENT
/begin MEASUREMENT dataJ1939Dm1Failrs_as[28].dtc_as[18].occ_u8 "" UBYTE CnvRule_NumberOneToOne 1 0 0 255 ECU_ADDRESS 0x70016159 /end MEASUREMENT
/begin MEASUREMENT dataJ1939Dm1Failrs_as[28].dtc_as[19].spn_u32 "" ULONG CnvRule_NumberOneToOne 1 0 0 4294967295 ECU_ADDRESS 0x7001615C /end MEASUREMENT
/begin MEASUREMENT dataJ1939Dm1Failrs_as[28].dtc_as[19].fmi_u8 "" UBYTE CnvRule_NumberOneToOne 1 0 0 255 ECU_ADDRESS 0x70016160 /end MEASUREMENT
/begin MEASUREMENT dataJ1939Dm1Failrs_as[28].dtc_as[19].occ_u8 "" UBYTE CnvRule_NumberOneToOne 1 0 0 255 ECU_ADDRESS 0x70016161 /end MEASUREMENT
/begin MEASUREMENT dataJ1939Dm1Failrs_as[28].dtc_as[20].spn_u32 "" ULONG CnvRule_NumberOneToOne 1 0 0 4294967295 ECU_ADDRESS 0x70016164 /end MEASUREMENT
/begin MEASUREMENT dataJ1939Dm1Failrs_as[28].dtc_as[20].fmi_u8 "" UBYTE CnvRule_NumberOneToOne 1 0 0 255 ECU_ADDRESS 0x70016168 /end MEASUREMENT
/begin MEASUREMENT dataJ1939Dm1Failrs_as[28].dtc_as[20].occ_u8 "" UBYTE CnvRule_NumberOneToOne 1 0 0 255 ECU_ADDRESS 0x70016169 /end MEASUREMENT
/begin MEASUREMENT dataJ1939Dm1Failrs_as[28].dtc_as "" UBYTE CnvRule_NumberOneToOne 1 0 0 255 ECU_ADDRESS 0x700160CC ARRAY_SIZE 160 /end MEASUREMENT
/begin MEASUREMENT dataJ1939Dm1Failrs_as[29].dtc_as[1].spn_u32 "" ULONG CnvRule_NumberOneToOne 1 0 0 4294967295 ECU_ADDRESS 0x70016170 /end MEASUREMENT
/begin MEASUREMENT dataJ1939Dm1Failrs_as[29].dtc_as[1].fmi_u8 "" UBYTE CnvRule_NumberOneToOne 1 0 0 255 ECU_ADDRESS 0x70016174 /end MEASUREMENT
/begin MEASUREMENT dataJ1939Dm1Failrs_as[29].dtc_as[1].occ_u8 "" UBYTE CnvRule_NumberOneToOne 1 0 0 255 ECU_ADDRESS 0x70016175 /end MEASUREMENT
/begin MEASUREMENT dataJ1939Dm1Failrs_as[29].dtc_as[2].spn_u32 "" ULONG CnvRule_NumberOneToOne 1 0 0 4294967295 ECU_ADDRESS 0x70016178 /end MEASUREMENT
/begin MEASUREMENT dataJ1939Dm1Failrs_as[29].dtc_as[2].fmi_u8 "" UBYTE CnvRule_NumberOneToOne 1 0 0 255 ECU_ADDRESS 0x7001617C /end MEASUREMENT
/begin MEASUREMENT dataJ1939Dm1Failrs_as[29].dtc_as[2].occ_u8 "" UBYTE CnvRule_NumberOneToOne 1 0 0 255 ECU_ADDRESS 0x7001617D /end MEASUREMENT
/begin MEASUREMENT dataJ1939Dm1Failrs_as[29].dtc_as[3].spn_u32 "" ULONG CnvRule_NumberOneToOne 1 0 0 4294967295 ECU_ADDRESS 0x70016180 /end MEASUREMENT
/begin MEASUREMENT dataJ1939Dm1Failrs_as[29].dtc_as[3].fmi_u8 "" UBYTE CnvRule_NumberOneToOne 1 0 0 255 ECU_ADDRESS 0x70016184 /end MEASUREMENT
/begin MEASUREMENT dataJ1939Dm1Failrs_as[29].dtc_as[3].occ_u8 "" UBYTE CnvRule_NumberOneToOne 1 0 0 255 ECU_ADDRESS 0x70016185 /end MEASUREMENT
/begin MEASUREMENT dataJ1939Dm1Failrs_as[29].dtc_as[4].spn_u32 "" ULONG CnvRule_NumberOneToOne 1 0 0 4294967295 ECU_ADDRESS 0x70016188 /end MEASUREMENT
/begin MEASUREMENT dataJ1939Dm1Failrs_as[29].dtc_as[4].fmi_u8 "" UBYTE CnvRule_NumberOneToOne 1 0 0 255 ECU_ADDRESS 0x7001618C /end MEASUREMENT
/begin MEASUREMENT dataJ1939Dm1Failrs_as[29].dtc_as[4].occ_u8 "" UBYTE CnvRule_NumberOneToOne 1 0 0 255 ECU_ADDRESS 0x7001618D /end MEASUREMENT
/begin MEASUREMENT dataJ1939Dm1Failrs_as[29].dtc_as[5].spn_u32 "" ULONG CnvRule_NumberOneToOne 1 0 0 4294967295 ECU_ADDRESS 0x70016190 /end MEASUREMENT
/begin MEASUREMENT dataJ1939Dm1Failrs_as[29].dtc_as[5].fmi_u8 "" UBYTE CnvRule_NumberOneToOne 1 0 0 255 ECU_ADDRESS 0x70016194 /end MEASUREMENT
/begin MEASUREMENT dataJ1939Dm1Failrs_as[29].dtc_as[5].occ_u8 "" UBYTE CnvRule_NumberOneToOne 1 0 0 255 ECU_ADDRESS 0x70016195 /end MEASUREMENT
/begin MEASUREMENT dataJ1939Dm1Failrs_as[29].dtc_as[6].spn_u32 "" ULONG CnvRule_NumberOneToOne 1 0 0 4294967295 ECU_ADDRESS 0x70016198 /end MEASUREMENT
/begin MEASUREMENT dataJ1939Dm1Failrs_as[29].dtc_as[6].fmi_u8 "" UBYTE CnvRule_NumberOneToOne 1 0 0 255 ECU_ADDRESS 0x7001619C /end MEASUREMENT
/begin MEASUREMENT dataJ1939Dm1Failrs_as[29].dtc_as[6].occ_u8 "" UBYTE CnvRule_NumberOneToOne 1 0 0 255 ECU_ADDRESS 0x7001619D /end MEASUREMENT
/begin COMPU_METHOD CnvRule_NumberOneToOne "This is a predefined standard conversion rule for signals representing a number with a 1:1 conversion (*nr*_*)." IDENTICAL "%.0" "-" /end COMPU_METHOD
