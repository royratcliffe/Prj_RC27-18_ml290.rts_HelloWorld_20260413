/begin MEASUREMENT st_InitDone_b "" UBYTE CnvRule_NumberOneToOne 1 0 0 1 ECU_ADDRESS 0x70013A97 /end MEASUREMENT
/begin MEASUREMENT ResetInfo_struc.rbr_UserDefined_u32 "" ULONG CnvRule_NumberOneToOne 1 0 0 4294967295 ECU_ADDRESS 0x70013A98 /end MEASUREMENT
/begin MEASUREMENT ResetInfo_struc.rbr_Type_u16 "" UWORD CnvRule_NumberOneToOne 1 0 0 65535 ECU_ADDRESS 0x70013A9C /end MEASUREMENT
/begin MEASUREMENT ResetInfo_struc.rbr_Grp_u16 "" UWORD CnvRule_NumberOneToOne 1 0 0 65535 ECU_ADDRESS 0x70013A9E /end MEASUREMENT
/begin MEASUREMENT ResetInfo_struc.rbr_TiStampCurr_u64 "" A_UINT64 CnvRule_NumberOneToOne 1 0 0 18446744073709551615 ECU_ADDRESS 0x70013AA0 /end MEASUREMENT
/begin MEASUREMENT ResetInfoData_au32 "" ULONG CnvRule_NumberOneToOne 1 0 0 4294967295 ECU_ADDRESS 0x70013AA8 ARRAY_SIZE 8 /end MEASUREMENT
/begin MEASUREMENT ApplSwName_str "" CnvRule_NumberOneToOne 1 0 DISPLAY_IDENTIFIER ApplSwName_str ECU_ADDRESS 0x70013AB0 /end MEASUREMENT
/begin MEASUREMENT UDSUUID_no_au8 "" UBYTE CnvRule_NumberOneToOne 1 0 0 255 ECU_ADDRESS 0x70013AE3 ARRAY_SIZE 18 /end MEASUREMENT
/begin MEASUREMENT status_u16 "" UWORD CnvRule_NumberOneToOne 1 0 0 65535 ECU_ADDRESS 0x70013AF6 /end MEASUREMENT
/begin MEASUREMENT StartRelease_st_b "" UBYTE CnvRule_NumberOneToOne 1 0 0 1 ECU_ADDRESS 0x700134AB /end MEASUREMENT
/begin MEASUREMENT PostRun_st_b "" UBYTE CnvRule_NumberOneToOne 1 0 0 1 ECU_ADDRESS 0x70013578 /end MEASUREMENT
/begin MEASUREMENT CallPostRunNr_no_u16 "" UWORD CnvRule_NumberOneToOne 1 0 0 65535 ECU_ADDRESS 0x7001357A /end MEASUREMENT
/begin MEASUREMENT States_s.currentState_e "" SWORD CnvRule_NumberOneToOne 1 0 -32768 32767 ECU_ADDRESS 0x7001357C /end MEASUREMENT
/begin MEASUREMENT States_s.prvState_e "" SWORD CnvRule_NumberOneToOne 1 0 -32768 32767 ECU_ADDRESS 0x7001357E /end MEASUREMENT
/begin MEASUREMENT st_Startlock_b "" UBYTE CnvRule_NumberOneToOne 1 0 0 1 ECU_ADDRESS 0x70013579 /end MEASUREMENT
/begin MEASUREMENT MainTaskState_enu "" SWORD CnvRule_NumberOneToOne 1 0 -32768 32767 ECU_ADDRESS 0x70013580 /end MEASUREMENT
/begin MEASUREMENT i_UPumpSensr_mV_u16 "" UWORD CnvRule_NumberOneToOne 1 0 0 65535 ECU_ADDRESS 0x70013600 /end MEASUREMENT
/begin MEASUREMENT diagParam_s.diFullDiag_l "" UBYTE CnvRule_NumberOneToOne 1 0 0 1 ECU_ADDRESS 0x70013602 /end MEASUREMENT
/begin MEASUREMENT diagParam_s.diCntlAndDiag_l "" UBYTE CnvRule_NumberOneToOne 1 0 0 1 ECU_ADDRESS 0x70013603 /end MEASUREMENT
/begin MEASUREMENT diagParam_s.diOpenLoadDetn_l "" UBYTE CnvRule_NumberOneToOne 1 0 0 1 ECU_ADDRESS 0x70013604 /end MEASUREMENT
/begin MEASUREMENT diagParam_s.diNonHotSCDetn_l "" UBYTE CnvRule_NumberOneToOne 1 0 0 1 ECU_ADDRESS 0x70013605 /end MEASUREMENT
/begin MEASUREMENT bds_outPwm_retGet_s.iSet_u16 "" UWORD CnvRule_NumberOneToOne 1 0 0 65535 ECU_ADDRESS 0x70013606 /end MEASUREMENT
/begin MEASUREMENT bds_outPwm_retGet_s.iAct_mA_u16 "" UWORD CnvRule_NumberOneToOne 1 0 0 65535 ECU_ADDRESS 0x70013608 /end MEASUREMENT
/begin MEASUREMENT bds_outPwm_retGet_s.ratDutyCycle_permil_u16 "" UWORD CnvRule_NumberOneToOne 1 0 0 65535 ECU_ADDRESS 0x7001360A /end MEASUREMENT
/begin MEASUREMENT bds_outPwm_retGet_s.statusApi_e "" UBYTE CnvRule_NumberOneToOne 1 0 0 255 ECU_ADDRESS 0x70013612 /end MEASUREMENT
/begin MEASUREMENT no_UBatt_mV_u16 "" UWORD CnvRule_NumberOneToOne 1 0 0 65535 ECU_ADDRESS 0x70013614 /end MEASUREMENT
/begin MEASUREMENT st_FlgInhActive_b "" UBYTE CnvRule_NumberOneToOne 1 0 0 1 ECU_ADDRESS 0x70013616 /end MEASUREMENT
/begin MEASUREMENT st_FlgUBatLowDetd_b "" UBYTE CnvRule_NumberOneToOne 1 0 0 1 ECU_ADDRESS 0x70013617 /end MEASUREMENT
/begin MEASUREMENT st_FlgUBatLowDetdPrev_b "" UBYTE CnvRule_NumberOneToOne 1 0 0 1 ECU_ADDRESS 0x70013618 /end MEASUREMENT
/begin MEASUREMENT st_FlgOutpLocked_b "" UBYTE CnvRule_NumberOneToOne 1 0 0 1 ECU_ADDRESS 0x70013619 /end MEASUREMENT
/begin MEASUREMENT st_FlgUnderUbat_b "" UBYTE CnvRule_NumberOneToOne 1 0 0 1 ECU_ADDRESS 0x7001361A /end MEASUREMENT
/begin MEASUREMENT st_FlgRstInh_b "" UBYTE CnvRule_NumberOneToOne 1 0 0 1 ECU_ADDRESS 0x7001361B /end MEASUREMENT
/begin MEASUREMENT st_FlgRstLowBatt_b "" UBYTE CnvRule_NumberOneToOne 1 0 0 1 ECU_ADDRESS 0x7001361C /end MEASUREMENT
/begin MEASUREMENT no_NrCycDebRst_u16 "" UWORD CnvRule_NumberOneToOne 1 0 0 65535 ECU_ADDRESS 0x7001361E /end MEASUREMENT
/begin MEASUREMENT no_CurrentK07_mA_u16 "" UWORD CnvRule_NumberOneToOne 1 0 0 65535 ECU_ADDRESS 0x70013620 /end MEASUREMENT
/begin MEASUREMENT iPmpFwdSet_mA_u16 "" UWORD CnvRule_NumberOneToOne 1 0 0 65535 ECU_ADDRESS 0x70013622 /end MEASUREMENT
/begin MEASUREMENT st_CurStK07_u8 "" UBYTE CnvRule_NumberOneToOne 1 0 0 255 ECU_ADDRESS 0x7001361D /end MEASUREMENT
/begin MEASUREMENT no_UPumpSensr_mV_u16 "" UWORD CnvRule_NumberOneToOne 1 0 0 65535 ECU_ADDRESS 0x70013624 /end MEASUREMENT
/begin MEASUREMENT st_CtrlValve_u8 "" UBYTE CnvRule_NumberOneToOne 1 0 0 255 ECU_ADDRESS 0x70013626 /end MEASUREMENT
/begin MEASUREMENT st_BrkSwt_u8 "" UBYTE CnvRule_NumberOneToOne 1 0 0 255 ECU_ADDRESS 0x70013627 /end MEASUREMENT
/begin MEASUREMENT MngInh_struc.st_flgUBattLowDetd_b "" UBYTE CnvRule_NumberOneToOne 1 0 0 1 ECU_ADDRESS 0x70013628 /end MEASUREMENT
/begin MEASUREMENT MngInh_struc.st_flgInhbActv_b "" UBYTE CnvRule_NumberOneToOne 1 0 0 1 ECU_ADDRESS 0x70013629 /end MEASUREMENT
/begin MEASUREMENT MngInh_struc.st_flgOutpLockd_b "" UBYTE CnvRule_NumberOneToOne 1 0 0 1 ECU_ADDRESS 0x7001362A /end MEASUREMENT
/begin MEASUREMENT MngInh_struc.UBatt_mV_u16 "" UWORD CnvRule_NumberOneToOne 1 0 0 65535 ECU_ADDRESS 0x7001362C /end MEASUREMENT
/begin MEASUREMENT MngInh_struc.NrCycDebRst_u16 "" UWORD CnvRule_NumberOneToOne 1 0 0 65535 ECU_ADDRESS 0x7001362E /end MEASUREMENT
/begin MEASUREMENT PHMDL_CHNL1 "" UWORD CnvRule_NumberOneToOne 1 0 0 65535 ECU_ADDRESS 0x70013630 /end MEASUREMENT
/begin MEASUREMENT PHMDL_CHNL1 "" UWORD CnvRule_NumberOneToOne 1 0 0 65535 ECU_ADDRESS 0x70013B08 /end MEASUREMENT
/begin MEASUREMENT i_TaskCycleTime_ms_u16 "" UWORD CnvRule_NumberOneToOne 1 0 0 65535 ECU_ADDRESS 0x70013682 /end MEASUREMENT
/begin MEASUREMENT st_K21Inh_u8 "" UBYTE CnvRule_NumberOneToOne 1 0 0 255 ECU_ADDRESS 0x70013681 /end MEASUREMENT
/begin MEASUREMENT st_K22Inh_u8 "" UBYTE CnvRule_NumberOneToOne 1 0 0 255 ECU_ADDRESS 0x70013684 /end MEASUREMENT
/begin MEASUREMENT st_FlgStInhb_u8 "" UBYTE CnvRule_NumberOneToOne 1 0 0 255 ECU_ADDRESS 0x70013685 /end MEASUREMENT
/begin MEASUREMENT bds_inPwm_getFrqPwm_s.frq_dHz_u32 "" ULONG CnvRule_NumberOneToOne 1 0 0 4294967295 ECU_ADDRESS 0x70013688 /end MEASUREMENT
/begin MEASUREMENT bds_inPwm_getFrqPwm_s.dutyCyc_perml_u16 "" UWORD CnvRule_NumberOneToOne 1 0 0 65535 ECU_ADDRESS 0x7001368C /end MEASUREMENT
/begin MEASUREMENT bds_inPwm_getFrqPwm_s.cntPls_u32 "" ULONG CnvRule_NumberOneToOne 1 0 0 4294967295 ECU_ADDRESS 0x70013690 /end MEASUREMENT
/begin MEASUREMENT bds_inPwm_getFrqPwm_s.status_e "" UBYTE CnvRule_NumberOneToOne 1 0 0 255 ECU_ADDRESS 0x70013694 /end MEASUREMENT
/begin MEASUREMENT FrqP_Hz_10_u32 "" ULONG CnvRule_NumberOneToOne 1 0 0 4294967295 ECU_ADDRESS 0x70013698 /end MEASUREMENT
/begin MEASUREMENT Tmp_u32 "" ULONG CnvRule_NumberOneToOne 1 0 0 4294967295 ECU_ADDRESS 0x7001369C /end MEASUREMENT
/begin MEASUREMENT stPmpSnsrU_struc.status_e "" UBYTE CnvRule_NumberOneToOne 1 0 0 255 ECU_ADDRESS 0x700136A0 /end MEASUREMENT
/begin MEASUREMENT stPmpSnsrU_struc.u_mV_u16 "" UWORD CnvRule_NumberOneToOne 1 0 0 65535 ECU_ADDRESS 0x700136A2 /end MEASUREMENT
/begin MEASUREMENT uPmpSnsr_mV_u16 "" UWORD CnvRule_NumberOneToOne 1 0 0 65535 ECU_ADDRESS 0x70013686 /end MEASUREMENT
/begin MEASUREMENT stPmpSnsrSigInvldErr_e "" UBYTE CnvRule_NumberOneToOne 1 0 0 255 ECU_ADDRESS 0x700136A4 /end MEASUREMENT
/begin MEASUREMENT stBrkSwtU_struc.status_e "" UBYTE CnvRule_NumberOneToOne 1 0 0 255 ECU_ADDRESS 0x700136A6 /end MEASUREMENT
/begin MEASUREMENT stBrkSwtU_struc.u_mV_u16 "" UWORD CnvRule_NumberOneToOne 1 0 0 65535 ECU_ADDRESS 0x700136A8 /end MEASUREMENT
/begin MEASUREMENT uBrkSwt_mV_u16 "" UWORD CnvRule_NumberOneToOne 1 0 0 65535 ECU_ADDRESS 0x700136AA /end MEASUREMENT
/begin MEASUREMENT stBrkSwt_u8 "" UBYTE CnvRule_NumberOneToOne 1 0 0 255 ECU_ADDRESS 0x700136A5 /end MEASUREMENT
/begin MEASUREMENT stBrkSwtSigInvldErr_e "" UBYTE CnvRule_NumberOneToOne 1 0 0 255 ECU_ADDRESS 0x700136AC /end MEASUREMENT
/begin MEASUREMENT stVehSnsrFrq_struc.frq_dHz_u32 "" ULONG CnvRule_NumberOneToOne 1 0 0 4294967295 ECU_ADDRESS 0x700136B0 /end MEASUREMENT
/begin MEASUREMENT stVehSnsrFrq_struc.dutyCyc_perml_u16 "" UWORD CnvRule_NumberOneToOne 1 0 0 65535 ECU_ADDRESS 0x700136B4 /end MEASUREMENT
/begin MEASUREMENT stVehSnsrFrq_struc.cntPls_u32 "" ULONG CnvRule_NumberOneToOne 1 0 0 4294967295 ECU_ADDRESS 0x700136B8 /end MEASUREMENT
/begin MEASUREMENT stVehSnsrFrq_struc.status_e "" UBYTE CnvRule_NumberOneToOne 1 0 0 255 ECU_ADDRESS 0x700136BC /end MEASUREMENT
/begin MEASUREMENT frqVehSnsr_Hz_u32 "" ULONG CnvRule_NumberOneToOne 1 0 0 4294967295 ECU_ADDRESS 0x700136C0 /end MEASUREMENT
/begin MEASUREMENT vWhlSpd_kph_u16 "" UWORD CnvRule_NumberOneToOne 1 0 0 65535 ECU_ADDRESS 0x700136AE /end MEASUREMENT
/begin MEASUREMENT SpdSnsrDST1_struc.spd_dRpm_u32 "" ULONG CnvRule_NumberOneToOne 1 0 0 4294967295 ECU_ADDRESS 0x700136C8 /end MEASUREMENT
/begin MEASUREMENT SpdSnsrDST1_struc.dir_e "" UBYTE CnvRule_NumberOneToOne 1 0 0 255 ECU_ADDRESS 0x700136CC /end MEASUREMENT
/begin MEASUREMENT SpdSnsrDST1_struc.statusApi_e "" UBYTE CnvRule_NumberOneToOne 1 0 0 255 ECU_ADDRESS 0x700136CD /end MEASUREMENT
/begin MEASUREMENT SpdSnsrDST1_inst_enu "" UBYTE CnvRule_NumberOneToOne 1 0 0 255 ECU_ADDRESS 0x700136AD /end MEASUREMENT
/begin MEASUREMENT SpdSnsrDST1_dRpm_u32 "" ULONG CnvRule_NumberOneToOne 1 0 0 4294967295 ECU_ADDRESS 0x700136D0 /end MEASUREMENT
/begin MEASUREMENT SpdSnsrDST1_rotDir_enu "" UBYTE CnvRule_NumberOneToOne 1 0 0 255 ECU_ADDRESS 0x700136D4 /end MEASUREMENT
/begin MEASUREMENT SpdSnsrDST1Temp_struc.statusApi_e "" UBYTE CnvRule_NumberOneToOne 1 0 0 255 ECU_ADDRESS 0x700136D8 /end MEASUREMENT
/begin MEASUREMENT SpdSnsrDST1Temp_struc.temp_degC_s32 "" SLONG CnvRule_NumberOneToOne 1 0 -2147483648 2147483647 ECU_ADDRESS 0x700136E0 /end MEASUREMENT
/begin MEASUREMENT SpdSnsrDST1_temp_degC_s32 "" SLONG CnvRule_NumberOneToOne 1 0 -2147483648 2147483647 ECU_ADDRESS 0x700136E4 /end MEASUREMENT
/begin MEASUREMENT PR4Snsr_getP_struc.stsApi_e "" UBYTE CnvRule_NumberOneToOne 1 0 0 255 ECU_ADDRESS 0x700136E8 /end MEASUREMENT
/begin MEASUREMENT PR4Snsr_getP_struc.pressureMeasmtRng_dBar_u16 "" UWORD CnvRule_NumberOneToOne 1 0 0 65535 ECU_ADDRESS 0x700136EA /end MEASUREMENT
/begin MEASUREMENT PR4Snsr_getP_struc.pressure_dBar_u16 "" UWORD CnvRule_NumberOneToOne 1 0 0 65535 ECU_ADDRESS 0x700136F0 /end MEASUREMENT
/begin MEASUREMENT PR4Snsr_getP_struc.padding "" UBYTE CnvRule_NumberOneToOne 1 0 0 255 ECU_ADDRESS 0x700136F2 ARRAY_SIZE 2 /end MEASUREMENT
/begin MEASUREMENT PR4SnsrP_u16 "" UWORD CnvRule_NumberOneToOne 1 0 0 65535 ECU_ADDRESS 0x700136D6 /end MEASUREMENT
/begin MEASUREMENT PR4Snsr_getT_struc.stsApi_e "" UBYTE CnvRule_NumberOneToOne 1 0 0 255 ECU_ADDRESS 0x700136F4 /end MEASUREMENT
/begin MEASUREMENT PR4Snsr_getT_struc.temp_degC_s32 "" SLONG CnvRule_NumberOneToOne 1 0 -2147483648 2147483647 ECU_ADDRESS 0x700136FC /end MEASUREMENT
/begin MEASUREMENT PR4SnsrT_s32 "" SLONG CnvRule_NumberOneToOne 1 0 -2147483648 2147483647 ECU_ADDRESS 0x70013700 /end MEASUREMENT
/begin MEASUREMENT o_T15_st_u8 "" UBYTE CnvRule_NumberOneToOne 1 0 0 255 ECU_ADDRESS 0x700136D5 /end MEASUREMENT
/begin MEASUREMENT PrmAsw_gstruc.fctPmp_s16 "" SWORD CnvRule_NumberOneToOne 1 0 -32768 32767 ECU_ADDRESS 0x70018800 /end MEASUREMENT
/begin MEASUREMENT PrmAsw_gstruc.listCtrlVlv_enu "" SWORD CnvRule_NumberOneToOne 1 0 -32768 32767 ECU_ADDRESS 0x70018802 /end MEASUREMENT
/begin MEASUREMENT PrmAsw_gstruc.nrCogs_s16 "" SWORD CnvRule_NumberOneToOne 1 0 -32768 32767 ECU_ADDRESS 0x70018804 /end MEASUREMENT
/begin MEASUREMENT PrmAsw_gstruc.iSpSafout1_u16 "" UWORD CnvRule_NumberOneToOne 1 0 0 65535 ECU_ADDRESS 0x70018806 /end MEASUREMENT
/begin MEASUREMENT PrmAsw_gstruc.iSpSafout2_u16 "" UWORD CnvRule_NumberOneToOne 1 0 0 65535 ECU_ADDRESS 0x70018808 /end MEASUREMENT
/begin MEASUREMENT PrmAsw_gstruc.nEngSpd_rpm_au16 "" UWORD CnvRule_NumberOneToOne 1 0 0 65535 ECU_ADDRESS 0x7001880A ARRAY_SIZE 6 /end MEASUREMENT
/begin MEASUREMENT PrmAsw_gstruc.eff_perc_au16 "" UWORD CnvRule_NumberOneToOne 1 0 0 65535 ECU_ADDRESS 0x70018810 ARRAY_SIZE 6 /end MEASUREMENT
/begin MEASUREMENT anValue_perc_gu8 "" UBYTE CnvRule_NumberOneToOne 1 0 0 255 ECU_ADDRESS 0x70018818 /end MEASUREMENT
/begin MEASUREMENT swtStatus_gu8 "" UBYTE CnvRule_NumberOneToOne 1 0 0 255 ECU_ADDRESS 0x70018819 /end MEASUREMENT
/begin MEASUREMENT can1RxDataboxCbkCntr_gu32 "" ULONG CnvRule_NumberOneToOne 1 0 0 4294967295 ECU_ADDRESS 0x7001881C /end MEASUREMENT
/begin MEASUREMENT PrmAsw_cgstruc.fctPmp_s16 "" SWORD CnvRule_NumberOneToOne 1 0 -32768 32767 ECU_ADDRESS 0x802E01C0 /end MEASUREMENT
/begin MEASUREMENT PrmAsw_cgstruc.listCtrlVlv_enu "" SWORD CnvRule_NumberOneToOne 1 0 -32768 32767 ECU_ADDRESS 0x802E01C2 /end MEASUREMENT
/begin MEASUREMENT PrmAsw_cgstruc.nrCogs_s16 "" SWORD CnvRule_NumberOneToOne 1 0 -32768 32767 ECU_ADDRESS 0x802E01C4 /end MEASUREMENT
/begin MEASUREMENT PrmAsw_cgstruc.iSpSafout1_u16 "" UWORD CnvRule_NumberOneToOne 1 0 0 65535 ECU_ADDRESS 0x802E01C6 /end MEASUREMENT
/begin MEASUREMENT PrmAsw_cgstruc.iSpSafout2_u16 "" UWORD CnvRule_NumberOneToOne 1 0 0 65535 ECU_ADDRESS 0x802E01C8 /end MEASUREMENT
/begin MEASUREMENT PrmAsw_cgstruc.nEngSpd_rpm_au16 "" UWORD CnvRule_NumberOneToOne 1 0 0 65535 ECU_ADDRESS 0x802E01CA ARRAY_SIZE 6 /end MEASUREMENT
/begin MEASUREMENT PrmAsw_cgstruc.eff_perc_au16 "" UWORD CnvRule_NumberOneToOne 1 0 0 65535 ECU_ADDRESS 0x802E01D0 ARRAY_SIZE 6 /end MEASUREMENT
/begin MEASUREMENT CAN1RxData_astruc[1].data_au8 "" UBYTE CnvRule_NumberOneToOne 1 0 0 255 ECU_ADDRESS 0x70013582 ARRAY_SIZE 8 /end MEASUREMENT
/begin MEASUREMENT CAN1RxData_astruc[1].numBytes_u8 "" UBYTE CnvRule_NumberOneToOne 1 0 0 255 ECU_ADDRESS 0x7001358A /end MEASUREMENT
/begin MEASUREMENT CAN1RxData_astruc[2].data_au8 "" UBYTE CnvRule_NumberOneToOne 1 0 0 255 ECU_ADDRESS 0x7001358C ARRAY_SIZE 8 /end MEASUREMENT
/begin MEASUREMENT CAN1RxData_astruc[2].numBytes_u8 "" UBYTE CnvRule_NumberOneToOne 1 0 0 255 ECU_ADDRESS 0x70013594 /end MEASUREMENT
/begin MEASUREMENT CAN2RxData_astruc[1].data_au8 "" UBYTE CnvRule_NumberOneToOne 1 0 0 255 ECU_ADDRESS 0x70013596 ARRAY_SIZE 8 /end MEASUREMENT
/begin MEASUREMENT CAN2RxData_astruc[1].numBytes_u8 "" UBYTE CnvRule_NumberOneToOne 1 0 0 255 ECU_ADDRESS 0x7001359E /end MEASUREMENT
/begin MEASUREMENT CAN2RxData_astruc[2].data_au8 "" UBYTE CnvRule_NumberOneToOne 1 0 0 255 ECU_ADDRESS 0x700135A0 ARRAY_SIZE 8 /end MEASUREMENT
/begin MEASUREMENT CAN2RxData_astruc[2].numBytes_u8 "" UBYTE CnvRule_NumberOneToOne 1 0 0 255 ECU_ADDRESS 0x700135A8 /end MEASUREMENT
/begin MEASUREMENT CAN2RxData_astruc[3].data_au8 "" UBYTE CnvRule_NumberOneToOne 1 0 0 255 ECU_ADDRESS 0x700135AA ARRAY_SIZE 8 /end MEASUREMENT
/begin MEASUREMENT CAN2RxData_astruc[3].numBytes_u8 "" UBYTE CnvRule_NumberOneToOne 1 0 0 255 ECU_ADDRESS 0x700135B2 /end MEASUREMENT
/begin MEASUREMENT CAN2RxData_astruc[4].data_au8 "" UBYTE CnvRule_NumberOneToOne 1 0 0 255 ECU_ADDRESS 0x700135B4 ARRAY_SIZE 8 /end MEASUREMENT
/begin MEASUREMENT CAN2RxData_astruc[4].numBytes_u8 "" UBYTE CnvRule_NumberOneToOne 1 0 0 255 ECU_ADDRESS 0x700135BC /end MEASUREMENT
/begin MEASUREMENT CAN2RxData_astruc[5].data_au8 "" UBYTE CnvRule_NumberOneToOne 1 0 0 255 ECU_ADDRESS 0x700135BE ARRAY_SIZE 8 /end MEASUREMENT
/begin MEASUREMENT CAN2RxData_astruc[5].numBytes_u8 "" UBYTE CnvRule_NumberOneToOne 1 0 0 255 ECU_ADDRESS 0x700135C6 /end MEASUREMENT
/begin MEASUREMENT bds_IPduGrpVctr_au8 "" UBYTE CnvRule_NumberOneToOne 1 0 0 255 ECU_ADDRESS 0x700135C8 ARRAY_SIZE 8 /end MEASUREMENT
/begin MEASUREMENT retSet_u16 "" UWORD CnvRule_NumberOneToOne 1 0 0 65535 ECU_ADDRESS 0x700135D0 /end MEASUREMENT
/begin MEASUREMENT retStrt_u16 "" UWORD CnvRule_NumberOneToOne 1 0 0 65535 ECU_ADDRESS 0x700135D2 /end MEASUREMENT
/begin MEASUREMENT data_au8 "" UBYTE CnvRule_NumberOneToOne 1 0 0 255 ECU_ADDRESS 0x700135D4 ARRAY_SIZE 8 /end MEASUREMENT
/begin MEASUREMENT dataTx_au8 "" UBYTE CnvRule_NumberOneToOne 1 0 0 255 ECU_ADDRESS 0x700135DC ARRAY_SIZE 8 /end MEASUREMENT
/begin MEASUREMENT sigData_au8 "" UBYTE CnvRule_NumberOneToOne 1 0 0 255 ECU_ADDRESS 0x700135E4 ARRAY_SIZE 8 /end MEASUREMENT
/begin MEASUREMENT i_statusNvmIni_u16 "" UWORD CnvRule_NumberOneToOne 1 0 0 65535 ECU_ADDRESS 0x700135EC /end MEASUREMENT
/begin MEASUREMENT i_iPmpFwdAct_mA_u16 "" UWORD CnvRule_NumberOneToOne 1 0 0 65535 ECU_ADDRESS 0x700135EE /end MEASUREMENT
/begin MEASUREMENT i_iPmpFwdSet_mA_u16 "" UWORD CnvRule_NumberOneToOne 1 0 0 65535 ECU_ADDRESS 0x700135F0 /end MEASUREMENT
/begin MEASUREMENT i_CtrlValve_u8 "" UBYTE CnvRule_NumberOneToOne 1 0 0 255 ECU_ADDRESS 0x700135F2 /end MEASUREMENT
/begin MEASUREMENT i_rxActEngPercTq_u8 "" UBYTE CnvRule_NumberOneToOne 1 0 0 255 ECU_ADDRESS 0x700135F3 /end MEASUREMENT
/begin MEASUREMENT i_vWhlSpd_kph_u16 "" SWORD CnvRule_NumberOneToOne 1 0 -32768 32767 ECU_ADDRESS 0x700135F4 /end MEASUREMENT
/begin MEASUREMENT i_uPmpSnsr_mV_u16 "" UWORD CnvRule_NumberOneToOne 1 0 0 65535 ECU_ADDRESS 0x700135F6 /end MEASUREMENT
/begin MEASUREMENT i_frqVehSnsr_Hz_u32 "" ULONG CnvRule_NumberOneToOne 1 0 0 4294967295 ECU_ADDRESS 0x700135F8 /end MEASUREMENT
/begin MEASUREMENT i_anValue_perc_u8 "" UBYTE CnvRule_NumberOneToOne 1 0 0 255 ECU_ADDRESS 0x700135FC /end MEASUREMENT
/begin MEASUREMENT i_stBrkSwt_u8 "" UBYTE CnvRule_NumberOneToOne 1 0 0 255 ECU_ADDRESS 0x700135FD /end MEASUREMENT
/begin MEASUREMENT CAN1RxData_astruc[1].data_au8 "" UBYTE CnvRule_NumberOneToOne 1 0 0 255 ECU_ADDRESS 0x70013632 ARRAY_SIZE 8 /end MEASUREMENT
/begin MEASUREMENT CAN1RxData_astruc[1].numBytes_u8 "" UBYTE CnvRule_NumberOneToOne 1 0 0 255 ECU_ADDRESS 0x7001363A /end MEASUREMENT
/begin MEASUREMENT CAN1RxData_astruc[2].data_au8 "" UBYTE CnvRule_NumberOneToOne 1 0 0 255 ECU_ADDRESS 0x7001363C ARRAY_SIZE 8 /end MEASUREMENT
/begin MEASUREMENT CAN1RxData_astruc[2].numBytes_u8 "" UBYTE CnvRule_NumberOneToOne 1 0 0 255 ECU_ADDRESS 0x70013644 /end MEASUREMENT
/begin MEASUREMENT CAN2RxData_astruc[1].data_au8 "" UBYTE CnvRule_NumberOneToOne 1 0 0 255 ECU_ADDRESS 0x70013646 ARRAY_SIZE 8 /end MEASUREMENT
/begin MEASUREMENT CAN2RxData_astruc[1].numBytes_u8 "" UBYTE CnvRule_NumberOneToOne 1 0 0 255 ECU_ADDRESS 0x7001364E /end MEASUREMENT
/begin MEASUREMENT CAN2RxData_astruc[2].data_au8 "" UBYTE CnvRule_NumberOneToOne 1 0 0 255 ECU_ADDRESS 0x70013650 ARRAY_SIZE 8 /end MEASUREMENT
/begin MEASUREMENT CAN2RxData_astruc[2].numBytes_u8 "" UBYTE CnvRule_NumberOneToOne 1 0 0 255 ECU_ADDRESS 0x70013658 /end MEASUREMENT
/begin MEASUREMENT CAN2RxData_astruc[3].data_au8 "" UBYTE CnvRule_NumberOneToOne 1 0 0 255 ECU_ADDRESS 0x7001365A ARRAY_SIZE 8 /end MEASUREMENT
/begin MEASUREMENT CAN2RxData_astruc[3].numBytes_u8 "" UBYTE CnvRule_NumberOneToOne 1 0 0 255 ECU_ADDRESS 0x70013662 /end MEASUREMENT
/begin MEASUREMENT CAN2RxData_astruc[4].data_au8 "" UBYTE CnvRule_NumberOneToOne 1 0 0 255 ECU_ADDRESS 0x70013664 ARRAY_SIZE 8 /end MEASUREMENT
/begin MEASUREMENT CAN2RxData_astruc[4].numBytes_u8 "" UBYTE CnvRule_NumberOneToOne 1 0 0 255 ECU_ADDRESS 0x7001366C /end MEASUREMENT
/begin MEASUREMENT CAN2RxData_astruc[5].data_au8 "" UBYTE CnvRule_NumberOneToOne 1 0 0 255 ECU_ADDRESS 0x7001366E ARRAY_SIZE 8 /end MEASUREMENT
/begin MEASUREMENT CAN2RxData_astruc[5].numBytes_u8 "" UBYTE CnvRule_NumberOneToOne 1 0 0 255 ECU_ADDRESS 0x70013676 /end MEASUREMENT
/begin MEASUREMENT sigData_au8 "" UBYTE CnvRule_NumberOneToOne 1 0 0 255 ECU_ADDRESS 0x70013678 ARRAY_SIZE 8 /end MEASUREMENT
/begin MEASUREMENT o_rxActEngPercTq_u8 "" UBYTE CnvRule_NumberOneToOne 1 0 0 255 ECU_ADDRESS 0x70013680 /end MEASUREMENT
/begin MEASUREMENT dataJ1939Inst_as[1].prodSdgDataboxNum_u16 "" UWORD CnvRule_NumberOneToOne 1 0 0 65535 ECU_ADDRESS 0x70013B2C /end MEASUREMENT
/begin MEASUREMENT dataJ1939Inst_as[1].addClaimInfoFunc_pf "" UWORD CnvRule_NumberOneToOne 1 0 0 65535 ECU_ADDRESS 0x70013B38 /end MEASUREMENT
/begin MEASUREMENT dataJ1939Inst_as[1].DM3func_pf "" UBYTE CnvRule_NumberOneToOne 1 0 0 1 ECU_ADDRESS 0x70013BDC /end MEASUREMENT
/begin MEASUREMENT dataJ1939Inst_as[1].DM11func_pf "" UBYTE CnvRule_NumberOneToOne 1 0 0 1 ECU_ADDRESS 0x70013BE0 /end MEASUREMENT
/begin MEASUREMENT dataJ1939Inst_as[1].ecuLoc_pas8 "" SBYTE CnvRule_NumberOneToOne 1 0 -128 127 ECU_ADDRESS 0x70013BE4 /end MEASUREMENT
/begin MEASUREMENT dataJ1939Inst_as[1].ecuType_pas8 "" SBYTE CnvRule_NumberOneToOne 1 0 -128 127 ECU_ADDRESS 0x70013BE8 /end MEASUREMENT
/begin MEASUREMENT dataJ1939Inst_as[1].ecuMan_pas8 "" SBYTE CnvRule_NumberOneToOne 1 0 -128 127 ECU_ADDRESS 0x70013BEC /end MEASUREMENT
/begin MEASUREMENT dataJ1939Inst_as[1].applTask_pas8 "" SBYTE CnvRule_NumberOneToOne 1 0 -128 127 ECU_ADDRESS 0x70013BF0 /end MEASUREMENT
/begin MEASUREMENT dataJ1939Inst_as[1].rxSysDatabox_as[1].data_pau8 "" UBYTE CnvRule_NumberOneToOne 1 0 0 255 ECU_ADDRESS 0x70013BF8 /end MEASUREMENT
/begin MEASUREMENT dataJ1939Inst_as[1].rxSysDatabox_as[1].func_pf "" UBYTE CnvRule_NumberOneToOne 1 0 0 1 ECU_ADDRESS 0x70013BFC /end MEASUREMENT
/begin MEASUREMENT dataJ1939Inst_as[1].rxSysDatabox_as[1].lenAct_u32 "" ULONG CnvRule_NumberOneToOne 1 0 0 4294967295 ECU_ADDRESS 0x70013C04 /end MEASUREMENT
/begin MEASUREMENT dataJ1939Inst_as[1].rxSysDatabox_as[1].lenRx_u32 "" ULONG CnvRule_NumberOneToOne 1 0 0 4294967295 ECU_ADDRESS 0x70013C08 /end MEASUREMENT
/begin MEASUREMENT dataJ1939Inst_as[1].rxSysDatabox_as[1].lenMax_u32 "" ULONG CnvRule_NumberOneToOne 1 0 0 4294967295 ECU_ADDRESS 0x70013C0C /end MEASUREMENT
/begin MEASUREMENT dataJ1939Inst_as[1].rxSysDatabox_as[1].timeout_u16 "" UWORD CnvRule_NumberOneToOne 1 0 0 65535 ECU_ADDRESS 0x70013C10 /end MEASUREMENT
/begin MEASUREMENT dataJ1939Inst_as[1].rxSysDatabox_as[1].startTimeout_u16 "" UWORD CnvRule_NumberOneToOne 1 0 0 65535 ECU_ADDRESS 0x70013C12 /end MEASUREMENT
/begin MEASUREMENT dataJ1939Inst_as[1].rxSysDatabox_as[1].counter_u16 "" UWORD CnvRule_NumberOneToOne 1 0 0 65535 ECU_ADDRESS 0x70013C14 /end MEASUREMENT
/begin MEASUREMENT dataJ1939Inst_as[1].rxSysDatabox_as[1].status_u16 "" UWORD CnvRule_NumberOneToOne 1 0 0 65535 ECU_ADDRESS 0x70013C16 /end MEASUREMENT
/begin MEASUREMENT dataJ1939Inst_as[1].rxSysDatabox_as[1].action_u16 "" UWORD CnvRule_NumberOneToOne 1 0 0 65535 ECU_ADDRESS 0x70013C18 /end MEASUREMENT
/begin MEASUREMENT dataJ1939Inst_as[1].rxSysDatabox_as[1].internalBox_l "" UBYTE CnvRule_NumberOneToOne 1 0 0 1 ECU_ADDRESS 0x70013C1A /end MEASUREMENT
/begin MEASUREMENT dataJ1939Inst_as[1].rxSysDatabox_as[2].data_pau8 "" UBYTE CnvRule_NumberOneToOne 1 0 0 255 ECU_ADDRESS 0x70013C1C /end MEASUREMENT
/begin MEASUREMENT dataJ1939Inst_as[1].rxSysDatabox_as[2].func_pf "" UBYTE CnvRule_NumberOneToOne 1 0 0 1 ECU_ADDRESS 0x70013C20 /end MEASUREMENT
/begin MEASUREMENT dataJ1939Inst_as[1].rxSysDatabox_as[2].lenAct_u32 "" ULONG CnvRule_NumberOneToOne 1 0 0 4294967295 ECU_ADDRESS 0x70013C28 /end MEASUREMENT
/begin MEASUREMENT dataJ1939Inst_as[1].rxSysDatabox_as[2].lenRx_u32 "" ULONG CnvRule_NumberOneToOne 1 0 0 4294967295 ECU_ADDRESS 0x70013C2C /end MEASUREMENT
/begin MEASUREMENT dataJ1939Inst_as[1].rxSysDatabox_as[2].lenMax_u32 "" ULONG CnvRule_NumberOneToOne 1 0 0 4294967295 ECU_ADDRESS 0x70013C30 /end MEASUREMENT
/begin MEASUREMENT dataJ1939Inst_as[1].rxSysDatabox_as[2].timeout_u16 "" UWORD CnvRule_NumberOneToOne 1 0 0 65535 ECU_ADDRESS 0x70013C34 /end MEASUREMENT
/begin MEASUREMENT dataJ1939Inst_as[1].rxSysDatabox_as[2].startTimeout_u16 "" UWORD CnvRule_NumberOneToOne 1 0 0 65535 ECU_ADDRESS 0x70013C36 /end MEASUREMENT
/begin MEASUREMENT dataJ1939Inst_as[1].rxSysDatabox_as[2].counter_u16 "" UWORD CnvRule_NumberOneToOne 1 0 0 65535 ECU_ADDRESS 0x70013C38 /end MEASUREMENT
/begin MEASUREMENT dataJ1939Inst_as[1].rxSysDatabox_as[2].status_u16 "" UWORD CnvRule_NumberOneToOne 1 0 0 65535 ECU_ADDRESS 0x70013C3A /end MEASUREMENT
/begin MEASUREMENT dataJ1939Inst_as[1].rxSysDatabox_as[2].action_u16 "" UWORD CnvRule_NumberOneToOne 1 0 0 65535 ECU_ADDRESS 0x70013C3C /end MEASUREMENT
/begin MEASUREMENT dataJ1939Inst_as[1].rxSysDatabox_as[2].internalBox_l "" UBYTE CnvRule_NumberOneToOne 1 0 0 1 ECU_ADDRESS 0x70013C3E /end MEASUREMENT
/begin MEASUREMENT dataJ1939Inst_as[1].rxSysDatabox_as[3].data_pau8 "" UBYTE CnvRule_NumberOneToOne 1 0 0 255 ECU_ADDRESS 0x70013C40 /end MEASUREMENT
/begin MEASUREMENT dataJ1939Inst_as[1].rxSysDatabox_as[3].func_pf "" UBYTE CnvRule_NumberOneToOne 1 0 0 1 ECU_ADDRESS 0x70013C44 /end MEASUREMENT
/begin MEASUREMENT dataJ1939Inst_as[1].rxSysDatabox_as[3].lenAct_u32 "" ULONG CnvRule_NumberOneToOne 1 0 0 4294967295 ECU_ADDRESS 0x70013C4C /end MEASUREMENT
/begin MEASUREMENT dataJ1939Inst_as[1].rxSysDatabox_as[3].lenRx_u32 "" ULONG CnvRule_NumberOneToOne 1 0 0 4294967295 ECU_ADDRESS 0x70013C50 /end MEASUREMENT
/begin MEASUREMENT dataJ1939Inst_as[1].rxSysDatabox_as[3].lenMax_u32 "" ULONG CnvRule_NumberOneToOne 1 0 0 4294967295 ECU_ADDRESS 0x70013C54 /end MEASUREMENT
/begin MEASUREMENT dataJ1939Inst_as[1].rxSysDatabox_as[3].timeout_u16 "" UWORD CnvRule_NumberOneToOne 1 0 0 65535 ECU_ADDRESS 0x70013C58 /end MEASUREMENT
/begin MEASUREMENT dataJ1939Inst_as[1].rxSysDatabox_as[3].startTimeout_u16 "" UWORD CnvRule_NumberOneToOne 1 0 0 65535 ECU_ADDRESS 0x70013C5A /end MEASUREMENT
/begin MEASUREMENT dataJ1939Inst_as[1].rxSysDatabox_as[3].counter_u16 "" UWORD CnvRule_NumberOneToOne 1 0 0 65535 ECU_ADDRESS 0x70013C5C /end MEASUREMENT
/begin MEASUREMENT dataJ1939Inst_as[1].rxSysDatabox_as[3].status_u16 "" UWORD CnvRule_NumberOneToOne 1 0 0 65535 ECU_ADDRESS 0x70013C5E /end MEASUREMENT
/begin MEASUREMENT dataJ1939Inst_as[1].rxSysDatabox_as[3].action_u16 "" UWORD CnvRule_NumberOneToOne 1 0 0 65535 ECU_ADDRESS 0x70013C60 /end MEASUREMENT
/begin MEASUREMENT dataJ1939Inst_as[1].rxSysDatabox_as[3].internalBox_l "" UBYTE CnvRule_NumberOneToOne 1 0 0 1 ECU_ADDRESS 0x70013C62 /end MEASUREMENT
/begin MEASUREMENT dataJ1939Inst_as[1].rxSysDatabox_as[4].data_pau8 "" UBYTE CnvRule_NumberOneToOne 1 0 0 255 ECU_ADDRESS 0x70013C64 /end MEASUREMENT
/begin MEASUREMENT dataJ1939Inst_as[1].rxSysDatabox_as[4].func_pf "" UBYTE CnvRule_NumberOneToOne 1 0 0 1 ECU_ADDRESS 0x70013C68 /end MEASUREMENT
/begin MEASUREMENT dataJ1939Inst_as[1].rxSysDatabox_as[4].lenAct_u32 "" ULONG CnvRule_NumberOneToOne 1 0 0 4294967295 ECU_ADDRESS 0x70013C70 /end MEASUREMENT
/begin MEASUREMENT dataJ1939Inst_as[1].rxSysDatabox_as[4].lenRx_u32 "" ULONG CnvRule_NumberOneToOne 1 0 0 4294967295 ECU_ADDRESS 0x70013C74 /end MEASUREMENT
/begin MEASUREMENT dataJ1939Inst_as[1].rxSysDatabox_as[4].lenMax_u32 "" ULONG CnvRule_NumberOneToOne 1 0 0 4294967295 ECU_ADDRESS 0x70013C78 /end MEASUREMENT
/begin MEASUREMENT dataJ1939Inst_as[1].rxSysDatabox_as[4].timeout_u16 "" UWORD CnvRule_NumberOneToOne 1 0 0 65535 ECU_ADDRESS 0x70013C7C /end MEASUREMENT
/begin MEASUREMENT dataJ1939Inst_as[1].rxSysDatabox_as[4].startTimeout_u16 "" UWORD CnvRule_NumberOneToOne 1 0 0 65535 ECU_ADDRESS 0x70013C7E /end MEASUREMENT
/begin MEASUREMENT dataJ1939Inst_as[1].rxSysDatabox_as[4].counter_u16 "" UWORD CnvRule_NumberOneToOne 1 0 0 65535 ECU_ADDRESS 0x70013C80 /end MEASUREMENT
/begin MEASUREMENT dataJ1939Inst_as[1].rxSysDatabox_as[4].status_u16 "" UWORD CnvRule_NumberOneToOne 1 0 0 65535 ECU_ADDRESS 0x70013C82 /end MEASUREMENT
/begin MEASUREMENT dataJ1939Inst_as[1].rxSysDatabox_as[4].action_u16 "" UWORD CnvRule_NumberOneToOne 1 0 0 65535 ECU_ADDRESS 0x70013C84 /end MEASUREMENT
/begin MEASUREMENT dataJ1939Inst_as[1].rxSysDatabox_as[4].internalBox_l "" UBYTE CnvRule_NumberOneToOne 1 0 0 1 ECU_ADDRESS 0x70013C86 /end MEASUREMENT
/begin MEASUREMENT dataJ1939Inst_as[1].rxSysDatabox_as[5].data_pau8 "" UBYTE CnvRule_NumberOneToOne 1 0 0 255 ECU_ADDRESS 0x70013C88 /end MEASUREMENT
/begin MEASUREMENT dataJ1939Inst_as[1].rxSysDatabox_as[5].func_pf "" UBYTE CnvRule_NumberOneToOne 1 0 0 1 ECU_ADDRESS 0x70013C8C /end MEASUREMENT
/begin MEASUREMENT dataJ1939Inst_as[1].rxSysDatabox_as[5].lenAct_u32 "" ULONG CnvRule_NumberOneToOne 1 0 0 4294967295 ECU_ADDRESS 0x70013C94 /end MEASUREMENT
/begin MEASUREMENT dataJ1939Inst_as[1].rxSysDatabox_as[5].lenRx_u32 "" ULONG CnvRule_NumberOneToOne 1 0 0 4294967295 ECU_ADDRESS 0x70013C98 /end MEASUREMENT
/begin MEASUREMENT dataJ1939Inst_as[1].rxSysDatabox_as[5].lenMax_u32 "" ULONG CnvRule_NumberOneToOne 1 0 0 4294967295 ECU_ADDRESS 0x70013C9C /end MEASUREMENT
/begin MEASUREMENT dataJ1939Inst_as[1].rxSysDatabox_as[5].timeout_u16 "" UWORD CnvRule_NumberOneToOne 1 0 0 65535 ECU_ADDRESS 0x70013CA0 /end MEASUREMENT
/begin MEASUREMENT dataJ1939Inst_as[1].rxSysDatabox_as[5].startTimeout_u16 "" UWORD CnvRule_NumberOneToOne 1 0 0 65535 ECU_ADDRESS 0x70013CA2 /end MEASUREMENT
/begin MEASUREMENT dataJ1939Inst_as[1].rxSysDatabox_as[5].counter_u16 "" UWORD CnvRule_NumberOneToOne 1 0 0 65535 ECU_ADDRESS 0x70013CA4 /end MEASUREMENT
/begin MEASUREMENT dataJ1939Inst_as[1].rxSysDatabox_as[5].status_u16 "" UWORD CnvRule_NumberOneToOne 1 0 0 65535 ECU_ADDRESS 0x70013CA6 /end MEASUREMENT
/begin MEASUREMENT dataJ1939Inst_as[1].rxSysDatabox_as[5].action_u16 "" UWORD CnvRule_NumberOneToOne 1 0 0 65535 ECU_ADDRESS 0x70013CA8 /end MEASUREMENT
/begin MEASUREMENT dataJ1939Inst_as[1].rxSysDatabox_as[5].internalBox_l "" UBYTE CnvRule_NumberOneToOne 1 0 0 1 ECU_ADDRESS 0x70013CAA /end MEASUREMENT
/begin MEASUREMENT dataJ1939Inst_as[1].rxSysDatabox_as "" UBYTE CnvRule_NumberOneToOne 1 0 0 1 ECU_ADDRESS 0x70013BF8 ARRAY_SIZE 180 /end MEASUREMENT
/begin MEASUREMENT dataJ1939Inst_as[1].txSysDatabox_as[1].data_pau8 "" UBYTE CnvRule_NumberOneToOne 1 0 0 255 ECU_ADDRESS 0x70013CAC /end MEASUREMENT
/begin MEASUREMENT dataJ1939Inst_as[1].txSysDatabox_as[1].func_pf "" ULONG CnvRule_NumberOneToOne 1 0 0 4294967295 ECU_ADDRESS 0x70013CB0 /end MEASUREMENT
/begin MEASUREMENT dataJ1939Inst_as[1].txSysDatabox_as[1].lenMax_u32 "" ULONG CnvRule_NumberOneToOne 1 0 0 4294967295 ECU_ADDRESS 0x70013CB8 /end MEASUREMENT
/begin MEASUREMENT dataJ1939Inst_as[1].txSysDatabox_as[1].lenAct_u32 "" ULONG CnvRule_NumberOneToOne 1 0 0 4294967295 ECU_ADDRESS 0x70013CBC /end MEASUREMENT
/begin MEASUREMENT dataJ1939Inst_as[1].txSysDatabox_as[1].cycle_u16 "" UWORD CnvRule_NumberOneToOne 1 0 0 65535 ECU_ADDRESS 0x70013CC0 /end MEASUREMENT
/begin MEASUREMENT dataJ1939Inst_as[1].txSysDatabox_as[1].counter_u16 "" UWORD CnvRule_NumberOneToOne 1 0 0 65535 ECU_ADDRESS 0x70013CC2 /end MEASUREMENT
/begin MEASUREMENT dataJ1939Inst_as[1].txSysDatabox_as[1].status_u16 "" UWORD CnvRule_NumberOneToOne 1 0 0 65535 ECU_ADDRESS 0x70013CC4 /end MEASUREMENT
/begin MEASUREMENT dataJ1939Inst_as[1].txSysDatabox_as[1].aperiodicdatabox_u16 "" UWORD CnvRule_NumberOneToOne 1 0 0 65535 ECU_ADDRESS 0x70013CC6 /end MEASUREMENT
/begin MEASUREMENT dataJ1939Inst_as[1].txSysDatabox_as[1].periodicdatabox_u16 "" UWORD CnvRule_NumberOneToOne 1 0 0 65535 ECU_ADDRESS 0x70013CC8 /end MEASUREMENT
/begin MEASUREMENT dataJ1939Inst_as[1].txSysDatabox_as "" ULONG CnvRule_NumberOneToOne 1 0 0 4294967295 ECU_ADDRESS 0x70013CAC ARRAY_SIZE 32 /end MEASUREMENT
/begin MEASUREMENT dataJ1939Inst_as[1].rxDataRequPgn_au8 "" UBYTE CnvRule_NumberOneToOne 1 0 0 255 ECU_ADDRESS 0x70013CCC ARRAY_SIZE 8 /end MEASUREMENT
/begin MEASUREMENT dataJ1939Inst_as[1].rxDataAddrClm_au8 "" UBYTE CnvRule_NumberOneToOne 1 0 0 255 ECU_ADDRESS 0x70013CD4 ARRAY_SIZE 8 /end MEASUREMENT
/begin MEASUREMENT dataJ1939Inst_as[1].rxDataCmdAddr_au8 "" UBYTE CnvRule_NumberOneToOne 1 0 0 255 ECU_ADDRESS 0x70013CDC ARRAY_SIZE 9 /end MEASUREMENT
/begin MEASUREMENT dataJ1939Inst_as[1].rxDataNameNmt_au8 "" UBYTE CnvRule_NumberOneToOne 1 0 0 255 ECU_ADDRESS 0x70013CE5 ARRAY_SIZE 8 /end MEASUREMENT
/begin MEASUREMENT dataJ1939Inst_as[1].rxDataDm13_au8 "" UBYTE CnvRule_NumberOneToOne 1 0 0 255 ECU_ADDRESS 0x70013CED ARRAY_SIZE 8 /end MEASUREMENT
/begin MEASUREMENT dataJ1939Inst_as[1].txDataRequPgn_au8 "" UBYTE CnvRule_NumberOneToOne 1 0 0 255 ECU_ADDRESS 0x70013CF5 ARRAY_SIZE 300 /end MEASUREMENT
/begin MEASUREMENT dataJ1939Inst_as[1].dm1BuffDat_au8 "" UBYTE CnvRule_NumberOneToOne 1 0 0 255 ECU_ADDRESS 0x70013E21 ARRAY_SIZE 130 /end MEASUREMENT
/begin MEASUREMENT dataJ1939Inst_as[1].dm2BuffDat_au8 "" UBYTE CnvRule_NumberOneToOne 1 0 0 255 ECU_ADDRESS 0x70013EA3 ARRAY_SIZE 130 /end MEASUREMENT
/begin MEASUREMENT dataJ1939Inst_as[1].caStatus_u16 "" UWORD CnvRule_NumberOneToOne 1 0 0 65535 ECU_ADDRESS 0x70013F38 /end MEASUREMENT
/begin MEASUREMENT dataJ1939Inst_as[1].addrClaimTimer_u16 "" UWORD CnvRule_NumberOneToOne 1 0 0 65535 ECU_ADDRESS 0x70013F3A /end MEASUREMENT
/begin MEASUREMENT dataJ1939Inst_as[1].taskNxtPeriodicTxIdx_u16 "" UWORD CnvRule_NumberOneToOne 1 0 0 65535 ECU_ADDRESS 0x70013F3C /end MEASUREMENT
/begin MEASUREMENT dataJ1939Inst_as[1].ownAddr_u8 "" UBYTE CnvRule_NumberOneToOne 1 0 0 255 ECU_ADDRESS 0x70013F3E /end MEASUREMENT
/begin MEASUREMENT dataJ1939Inst_as[1].canChannel_u8 "" UBYTE CnvRule_NumberOneToOne 1 0 0 255 ECU_ADDRESS 0x70013F3F /end MEASUREMENT
/begin MEASUREMENT dataJ1939Inst_as[1].nameMngSourceAddr_u8 "" UBYTE CnvRule_NumberOneToOne 1 0 0 255 ECU_ADDRESS 0x70013F40 /end MEASUREMENT
/begin MEASUREMENT dataJ1939Inst_as[1].usedDm13Port_u8 "" UBYTE CnvRule_NumberOneToOne 1 0 0 255 ECU_ADDRESS 0x70013F41 /end MEASUREMENT
/begin MEASUREMENT dataJ1939Inst_as[1].sendDm1Allowed_l "" UBYTE CnvRule_NumberOneToOne 1 0 0 1 ECU_ADDRESS 0x70013F42 /end MEASUREMENT
/begin MEASUREMENT dataJ1939Inst_as[1].dmLampStateJ1939_l "" UBYTE CnvRule_NumberOneToOne 1 0 0 1 ECU_ADDRESS 0x70013F43 /end MEASUREMENT
/begin MEASUREMENT dataJ1939Inst_as[2].prodSdgDataboxNum_u16 "" UWORD CnvRule_NumberOneToOne 1 0 0 65535 ECU_ADDRESS 0x70013F6C /end MEASUREMENT
/begin MEASUREMENT dataJ1939Inst_as[2].addClaimInfoFunc_pf "" UWORD CnvRule_NumberOneToOne 1 0 0 65535 ECU_ADDRESS 0x70013F78 /end MEASUREMENT
/begin MEASUREMENT dataJ1939Inst_as[2].DM3func_pf "" UBYTE CnvRule_NumberOneToOne 1 0 0 1 ECU_ADDRESS 0x7001401C /end MEASUREMENT
/begin MEASUREMENT dataJ1939Inst_as[2].DM11func_pf "" UBYTE CnvRule_NumberOneToOne 1 0 0 1 ECU_ADDRESS 0x70014020 /end MEASUREMENT
/begin MEASUREMENT dataJ1939Inst_as[2].ecuLoc_pas8 "" SBYTE CnvRule_NumberOneToOne 1 0 -128 127 ECU_ADDRESS 0x70014024 /end MEASUREMENT
/begin MEASUREMENT dataJ1939Inst_as[2].ecuType_pas8 "" SBYTE CnvRule_NumberOneToOne 1 0 -128 127 ECU_ADDRESS 0x70014028 /end MEASUREMENT
/begin MEASUREMENT dataJ1939Inst_as[2].ecuMan_pas8 "" SBYTE CnvRule_NumberOneToOne 1 0 -128 127 ECU_ADDRESS 0x7001402C /end MEASUREMENT
/begin MEASUREMENT dataJ1939Inst_as[2].applTask_pas8 "" SBYTE CnvRule_NumberOneToOne 1 0 -128 127 ECU_ADDRESS 0x70014030 /end MEASUREMENT
/begin MEASUREMENT dataJ1939Inst_as[2].rxSysDatabox_as[1].data_pau8 "" UBYTE CnvRule_NumberOneToOne 1 0 0 255 ECU_ADDRESS 0x70014038 /end MEASUREMENT
/begin MEASUREMENT dataJ1939Inst_as[2].rxSysDatabox_as[1].func_pf "" UBYTE CnvRule_NumberOneToOne 1 0 0 1 ECU_ADDRESS 0x7001403C /end MEASUREMENT
/begin MEASUREMENT dataJ1939Inst_as[2].rxSysDatabox_as[1].lenAct_u32 "" ULONG CnvRule_NumberOneToOne 1 0 0 4294967295 ECU_ADDRESS 0x70014044 /end MEASUREMENT
/begin MEASUREMENT dataJ1939Inst_as[2].rxSysDatabox_as[1].lenRx_u32 "" ULONG CnvRule_NumberOneToOne 1 0 0 4294967295 ECU_ADDRESS 0x70014048 /end MEASUREMENT
/begin MEASUREMENT dataJ1939Inst_as[2].rxSysDatabox_as[1].lenMax_u32 "" ULONG CnvRule_NumberOneToOne 1 0 0 4294967295 ECU_ADDRESS 0x7001404C /end MEASUREMENT
/begin MEASUREMENT dataJ1939Inst_as[2].rxSysDatabox_as[1].timeout_u16 "" UWORD CnvRule_NumberOneToOne 1 0 0 65535 ECU_ADDRESS 0x70014050 /end MEASUREMENT
/begin MEASUREMENT dataJ1939Inst_as[2].rxSysDatabox_as[1].startTimeout_u16 "" UWORD CnvRule_NumberOneToOne 1 0 0 65535 ECU_ADDRESS 0x70014052 /end MEASUREMENT
/begin MEASUREMENT dataJ1939Inst_as[2].rxSysDatabox_as[1].counter_u16 "" UWORD CnvRule_NumberOneToOne 1 0 0 65535 ECU_ADDRESS 0x70014054 /end MEASUREMENT
/begin MEASUREMENT dataJ1939Inst_as[2].rxSysDatabox_as[1].status_u16 "" UWORD CnvRule_NumberOneToOne 1 0 0 65535 ECU_ADDRESS 0x70014056 /end MEASUREMENT
/begin MEASUREMENT dataJ1939Inst_as[2].rxSysDatabox_as[1].action_u16 "" UWORD CnvRule_NumberOneToOne 1 0 0 65535 ECU_ADDRESS 0x70014058 /end MEASUREMENT
/begin MEASUREMENT dataJ1939Inst_as[2].rxSysDatabox_as[1].internalBox_l "" UBYTE CnvRule_NumberOneToOne 1 0 0 1 ECU_ADDRESS 0x7001405A /end MEASUREMENT
/begin MEASUREMENT dataJ1939Inst_as[2].rxSysDatabox_as[2].data_pau8 "" UBYTE CnvRule_NumberOneToOne 1 0 0 255 ECU_ADDRESS 0x7001405C /end MEASUREMENT
/begin MEASUREMENT dataJ1939Inst_as[2].rxSysDatabox_as[2].func_pf "" UBYTE CnvRule_NumberOneToOne 1 0 0 1 ECU_ADDRESS 0x70014060 /end MEASUREMENT
/begin MEASUREMENT dataJ1939Inst_as[2].rxSysDatabox_as[2].lenAct_u32 "" ULONG CnvRule_NumberOneToOne 1 0 0 4294967295 ECU_ADDRESS 0x70014068 /end MEASUREMENT
/begin MEASUREMENT dataJ1939Inst_as[2].rxSysDatabox_as[2].lenRx_u32 "" ULONG CnvRule_NumberOneToOne 1 0 0 4294967295 ECU_ADDRESS 0x7001406C /end MEASUREMENT
/begin MEASUREMENT dataJ1939Inst_as[2].rxSysDatabox_as[2].lenMax_u32 "" ULONG CnvRule_NumberOneToOne 1 0 0 4294967295 ECU_ADDRESS 0x70014070 /end MEASUREMENT
/begin MEASUREMENT dataJ1939Inst_as[2].rxSysDatabox_as[2].timeout_u16 "" UWORD CnvRule_NumberOneToOne 1 0 0 65535 ECU_ADDRESS 0x70014074 /end MEASUREMENT
/begin MEASUREMENT dataJ1939Inst_as[2].rxSysDatabox_as[2].startTimeout_u16 "" UWORD CnvRule_NumberOneToOne 1 0 0 65535 ECU_ADDRESS 0x70014076 /end MEASUREMENT
/begin MEASUREMENT dataJ1939Inst_as[2].rxSysDatabox_as[2].counter_u16 "" UWORD CnvRule_NumberOneToOne 1 0 0 65535 ECU_ADDRESS 0x70014078 /end MEASUREMENT
/begin MEASUREMENT dataJ1939Inst_as[2].rxSysDatabox_as[2].status_u16 "" UWORD CnvRule_NumberOneToOne 1 0 0 65535 ECU_ADDRESS 0x7001407A /end MEASUREMENT
/begin MEASUREMENT dataJ1939Inst_as[2].rxSysDatabox_as[2].action_u16 "" UWORD CnvRule_NumberOneToOne 1 0 0 65535 ECU_ADDRESS 0x7001407C /end MEASUREMENT
/begin MEASUREMENT dataJ1939Inst_as[2].rxSysDatabox_as[2].internalBox_l "" UBYTE CnvRule_NumberOneToOne 1 0 0 1 ECU_ADDRESS 0x7001407E /end MEASUREMENT
/begin MEASUREMENT dataJ1939Inst_as[2].rxSysDatabox_as[3].data_pau8 "" UBYTE CnvRule_NumberOneToOne 1 0 0 255 ECU_ADDRESS 0x70014080 /end MEASUREMENT
/begin MEASUREMENT dataJ1939Inst_as[2].rxSysDatabox_as[3].func_pf "" UBYTE CnvRule_NumberOneToOne 1 0 0 1 ECU_ADDRESS 0x70014084 /end MEASUREMENT
/begin MEASUREMENT dataJ1939Inst_as[2].rxSysDatabox_as[3].lenAct_u32 "" ULONG CnvRule_NumberOneToOne 1 0 0 4294967295 ECU_ADDRESS 0x7001408C /end MEASUREMENT
/begin MEASUREMENT dataJ1939Inst_as[2].rxSysDatabox_as[3].lenRx_u32 "" ULONG CnvRule_NumberOneToOne 1 0 0 4294967295 ECU_ADDRESS 0x70014090 /end MEASUREMENT
/begin MEASUREMENT dataJ1939Inst_as[2].rxSysDatabox_as[3].lenMax_u32 "" ULONG CnvRule_NumberOneToOne 1 0 0 4294967295 ECU_ADDRESS 0x70014094 /end MEASUREMENT
/begin MEASUREMENT dataJ1939Inst_as[2].rxSysDatabox_as[3].timeout_u16 "" UWORD CnvRule_NumberOneToOne 1 0 0 65535 ECU_ADDRESS 0x70014098 /end MEASUREMENT
/begin MEASUREMENT dataJ1939Inst_as[2].rxSysDatabox_as[3].startTimeout_u16 "" UWORD CnvRule_NumberOneToOne 1 0 0 65535 ECU_ADDRESS 0x7001409A /end MEASUREMENT
/begin MEASUREMENT dataJ1939Inst_as[2].rxSysDatabox_as[3].counter_u16 "" UWORD CnvRule_NumberOneToOne 1 0 0 65535 ECU_ADDRESS 0x7001409C /end MEASUREMENT
/begin MEASUREMENT dataJ1939Inst_as[2].rxSysDatabox_as[3].status_u16 "" UWORD CnvRule_NumberOneToOne 1 0 0 65535 ECU_ADDRESS 0x7001409E /end MEASUREMENT
/begin MEASUREMENT dataJ1939Inst_as[2].rxSysDatabox_as[3].action_u16 "" UWORD CnvRule_NumberOneToOne 1 0 0 65535 ECU_ADDRESS 0x700140A0 /end MEASUREMENT
/begin MEASUREMENT dataJ1939Inst_as[2].rxSysDatabox_as[3].internalBox_l "" UBYTE CnvRule_NumberOneToOne 1 0 0 1 ECU_ADDRESS 0x700140A2 /end MEASUREMENT
/begin MEASUREMENT dataJ1939Inst_as[2].rxSysDatabox_as[4].data_pau8 "" UBYTE CnvRule_NumberOneToOne 1 0 0 255 ECU_ADDRESS 0x700140A4 /end MEASUREMENT
/begin MEASUREMENT dataJ1939Inst_as[2].rxSysDatabox_as[4].func_pf "" UBYTE CnvRule_NumberOneToOne 1 0 0 1 ECU_ADDRESS 0x700140A8 /end MEASUREMENT
/begin MEASUREMENT dataJ1939Inst_as[2].rxSysDatabox_as[4].lenAct_u32 "" ULONG CnvRule_NumberOneToOne 1 0 0 4294967295 ECU_ADDRESS 0x700140B0 /end MEASUREMENT
/begin MEASUREMENT dataJ1939Inst_as[2].rxSysDatabox_as[4].lenRx_u32 "" ULONG CnvRule_NumberOneToOne 1 0 0 4294967295 ECU_ADDRESS 0x700140B4 /end MEASUREMENT
/begin MEASUREMENT dataJ1939Inst_as[2].rxSysDatabox_as[4].lenMax_u32 "" ULONG CnvRule_NumberOneToOne 1 0 0 4294967295 ECU_ADDRESS 0x700140B8 /end MEASUREMENT
/begin MEASUREMENT dataJ1939Inst_as[2].rxSysDatabox_as[4].timeout_u16 "" UWORD CnvRule_NumberOneToOne 1 0 0 65535 ECU_ADDRESS 0x700140BC /end MEASUREMENT
/begin MEASUREMENT dataJ1939Inst_as[2].rxSysDatabox_as[4].startTimeout_u16 "" UWORD CnvRule_NumberOneToOne 1 0 0 65535 ECU_ADDRESS 0x700140BE /end MEASUREMENT
/begin MEASUREMENT dataJ1939Inst_as[2].rxSysDatabox_as[4].counter_u16 "" UWORD CnvRule_NumberOneToOne 1 0 0 65535 ECU_ADDRESS 0x700140C0 /end MEASUREMENT
/begin MEASUREMENT dataJ1939Inst_as[2].rxSysDatabox_as[4].status_u16 "" UWORD CnvRule_NumberOneToOne 1 0 0 65535 ECU_ADDRESS 0x700140C2 /end MEASUREMENT
/begin MEASUREMENT dataJ1939Inst_as[2].rxSysDatabox_as[4].action_u16 "" UWORD CnvRule_NumberOneToOne 1 0 0 65535 ECU_ADDRESS 0x700140C4 /end MEASUREMENT
/begin MEASUREMENT dataJ1939Inst_as[2].rxSysDatabox_as[4].internalBox_l "" UBYTE CnvRule_NumberOneToOne 1 0 0 1 ECU_ADDRESS 0x700140C6 /end MEASUREMENT
/begin MEASUREMENT dataJ1939Inst_as[2].rxSysDatabox_as[5].data_pau8 "" UBYTE CnvRule_NumberOneToOne 1 0 0 255 ECU_ADDRESS 0x700140C8 /end MEASUREMENT
/begin MEASUREMENT dataJ1939Inst_as[2].rxSysDatabox_as[5].func_pf "" UBYTE CnvRule_NumberOneToOne 1 0 0 1 ECU_ADDRESS 0x700140CC /end MEASUREMENT
/begin MEASUREMENT dataJ1939Inst_as[2].rxSysDatabox_as[5].lenAct_u32 "" ULONG CnvRule_NumberOneToOne 1 0 0 4294967295 ECU_ADDRESS 0x700140D4 /end MEASUREMENT
/begin MEASUREMENT dataJ1939Inst_as[2].rxSysDatabox_as[5].lenRx_u32 "" ULONG CnvRule_NumberOneToOne 1 0 0 4294967295 ECU_ADDRESS 0x700140D8 /end MEASUREMENT
/begin MEASUREMENT dataJ1939Inst_as[2].rxSysDatabox_as[5].lenMax_u32 "" ULONG CnvRule_NumberOneToOne 1 0 0 4294967295 ECU_ADDRESS 0x700140DC /end MEASUREMENT
/begin MEASUREMENT dataJ1939Inst_as[2].rxSysDatabox_as[5].timeout_u16 "" UWORD CnvRule_NumberOneToOne 1 0 0 65535 ECU_ADDRESS 0x700140E0 /end MEASUREMENT
/begin MEASUREMENT dataJ1939Inst_as[2].rxSysDatabox_as[5].startTimeout_u16 "" UWORD CnvRule_NumberOneToOne 1 0 0 65535 ECU_ADDRESS 0x700140E2 /end MEASUREMENT
/begin MEASUREMENT dataJ1939Inst_as[2].rxSysDatabox_as[5].counter_u16 "" UWORD CnvRule_NumberOneToOne 1 0 0 65535 ECU_ADDRESS 0x700140E4 /end MEASUREMENT
/begin MEASUREMENT dataJ1939Inst_as[2].rxSysDatabox_as[5].status_u16 "" UWORD CnvRule_NumberOneToOne 1 0 0 65535 ECU_ADDRESS 0x700140E6 /end MEASUREMENT
/begin MEASUREMENT dataJ1939Inst_as[2].rxSysDatabox_as[5].action_u16 "" UWORD CnvRule_NumberOneToOne 1 0 0 65535 ECU_ADDRESS 0x700140E8 /end MEASUREMENT
/begin MEASUREMENT dataJ1939Inst_as[2].rxSysDatabox_as[5].internalBox_l "" UBYTE CnvRule_NumberOneToOne 1 0 0 1 ECU_ADDRESS 0x700140EA /end MEASUREMENT
/begin MEASUREMENT dataJ1939Inst_as[2].rxSysDatabox_as "" UBYTE CnvRule_NumberOneToOne 1 0 0 1 ECU_ADDRESS 0x70014038 ARRAY_SIZE 180 /end MEASUREMENT
/begin MEASUREMENT dataJ1939Inst_as[2].txSysDatabox_as[1].data_pau8 "" UBYTE CnvRule_NumberOneToOne 1 0 0 255 ECU_ADDRESS 0x700140EC /end MEASUREMENT
/begin MEASUREMENT dataJ1939Inst_as[2].txSysDatabox_as[1].func_pf "" ULONG CnvRule_NumberOneToOne 1 0 0 4294967295 ECU_ADDRESS 0x700140F0 /end MEASUREMENT
/begin MEASUREMENT dataJ1939Inst_as[2].txSysDatabox_as[1].lenMax_u32 "" ULONG CnvRule_NumberOneToOne 1 0 0 4294967295 ECU_ADDRESS 0x700140F8 /end MEASUREMENT
/begin MEASUREMENT dataJ1939Inst_as[2].txSysDatabox_as[1].lenAct_u32 "" ULONG CnvRule_NumberOneToOne 1 0 0 4294967295 ECU_ADDRESS 0x700140FC /end MEASUREMENT
/begin MEASUREMENT dataJ1939Inst_as[2].txSysDatabox_as[1].cycle_u16 "" UWORD CnvRule_NumberOneToOne 1 0 0 65535 ECU_ADDRESS 0x70014100 /end MEASUREMENT
/begin MEASUREMENT dataJ1939Inst_as[2].txSysDatabox_as[1].counter_u16 "" UWORD CnvRule_NumberOneToOne 1 0 0 65535 ECU_ADDRESS 0x70014102 /end MEASUREMENT
/begin MEASUREMENT dataJ1939Inst_as[2].txSysDatabox_as[1].status_u16 "" UWORD CnvRule_NumberOneToOne 1 0 0 65535 ECU_ADDRESS 0x70014104 /end MEASUREMENT
/begin MEASUREMENT dataJ1939Inst_as[2].txSysDatabox_as[1].aperiodicdatabox_u16 "" UWORD CnvRule_NumberOneToOne 1 0 0 65535 ECU_ADDRESS 0x70014106 /end MEASUREMENT
/begin MEASUREMENT dataJ1939Inst_as[2].txSysDatabox_as[1].periodicdatabox_u16 "" UWORD CnvRule_NumberOneToOne 1 0 0 65535 ECU_ADDRESS 0x70014108 /end MEASUREMENT
/begin MEASUREMENT dataJ1939Inst_as[2].txSysDatabox_as "" ULONG CnvRule_NumberOneToOne 1 0 0 4294967295 ECU_ADDRESS 0x700140EC ARRAY_SIZE 32 /end MEASUREMENT
/begin MEASUREMENT dataJ1939Inst_as[2].rxDataRequPgn_au8 "" UBYTE CnvRule_NumberOneToOne 1 0 0 255 ECU_ADDRESS 0x7001410C ARRAY_SIZE 8 /end MEASUREMENT
/begin MEASUREMENT dataJ1939Inst_as[2].rxDataAddrClm_au8 "" UBYTE CnvRule_NumberOneToOne 1 0 0 255 ECU_ADDRESS 0x70014114 ARRAY_SIZE 8 /end MEASUREMENT
/begin MEASUREMENT dataJ1939Inst_as[2].rxDataCmdAddr_au8 "" UBYTE CnvRule_NumberOneToOne 1 0 0 255 ECU_ADDRESS 0x7001411C ARRAY_SIZE 9 /end MEASUREMENT
/begin MEASUREMENT dataJ1939Inst_as[2].rxDataNameNmt_au8 "" UBYTE CnvRule_NumberOneToOne 1 0 0 255 ECU_ADDRESS 0x70014125 ARRAY_SIZE 8 /end MEASUREMENT
/begin MEASUREMENT dataJ1939Inst_as[2].rxDataDm13_au8 "" UBYTE CnvRule_NumberOneToOne 1 0 0 255 ECU_ADDRESS 0x7001412D ARRAY_SIZE 8 /end MEASUREMENT
/begin MEASUREMENT dataJ1939Inst_as[2].txDataRequPgn_au8 "" UBYTE CnvRule_NumberOneToOne 1 0 0 255 ECU_ADDRESS 0x70014135 ARRAY_SIZE 300 /end MEASUREMENT
/begin MEASUREMENT dataJ1939Inst_as[2].dm1BuffDat_au8 "" UBYTE CnvRule_NumberOneToOne 1 0 0 255 ECU_ADDRESS 0x70014261 ARRAY_SIZE 130 /end MEASUREMENT
/begin MEASUREMENT dataJ1939Inst_as[2].dm2BuffDat_au8 "" UBYTE CnvRule_NumberOneToOne 1 0 0 255 ECU_ADDRESS 0x700142E3 ARRAY_SIZE 130 /end MEASUREMENT
/begin MEASUREMENT dataJ1939Inst_as[2].caStatus_u16 "" UWORD CnvRule_NumberOneToOne 1 0 0 65535 ECU_ADDRESS 0x70014378 /end MEASUREMENT
/begin MEASUREMENT dataJ1939Inst_as[2].addrClaimTimer_u16 "" UWORD CnvRule_NumberOneToOne 1 0 0 65535 ECU_ADDRESS 0x7001437A /end MEASUREMENT
/begin MEASUREMENT dataJ1939Inst_as[2].taskNxtPeriodicTxIdx_u16 "" UWORD CnvRule_NumberOneToOne 1 0 0 65535 ECU_ADDRESS 0x7001437C /end MEASUREMENT
/begin MEASUREMENT dataJ1939Inst_as[2].ownAddr_u8 "" UBYTE CnvRule_NumberOneToOne 1 0 0 255 ECU_ADDRESS 0x7001437E /end MEASUREMENT
/begin MEASUREMENT dataJ1939Inst_as[2].canChannel_u8 "" UBYTE CnvRule_NumberOneToOne 1 0 0 255 ECU_ADDRESS 0x7001437F /end MEASUREMENT
/begin MEASUREMENT dataJ1939Inst_as[2].nameMngSourceAddr_u8 "" UBYTE CnvRule_NumberOneToOne 1 0 0 255 ECU_ADDRESS 0x70014380 /end MEASUREMENT
/begin MEASUREMENT dataJ1939Inst_as[2].usedDm13Port_u8 "" UBYTE CnvRule_NumberOneToOne 1 0 0 255 ECU_ADDRESS 0x70014381 /end MEASUREMENT
/begin MEASUREMENT dataJ1939Inst_as[2].sendDm1Allowed_l "" UBYTE CnvRule_NumberOneToOne 1 0 0 1 ECU_ADDRESS 0x70014382 /end MEASUREMENT
/begin MEASUREMENT dataJ1939Inst_as[2].dmLampStateJ1939_l "" UBYTE CnvRule_NumberOneToOne 1 0 0 1 ECU_ADDRESS 0x70014383 /end MEASUREMENT
/begin MEASUREMENT dataJ1939Inst_as[3].prodSdgDataboxNum_u16 "" UWORD CnvRule_NumberOneToOne 1 0 0 65535 ECU_ADDRESS 0x700143AC /end MEASUREMENT
/begin MEASUREMENT dataJ1939Inst_as[3].addClaimInfoFunc_pf "" UWORD CnvRule_NumberOneToOne 1 0 0 65535 ECU_ADDRESS 0x700143B8 /end MEASUREMENT
/begin MEASUREMENT dataJ1939Inst_as[3].DM3func_pf "" UBYTE CnvRule_NumberOneToOne 1 0 0 1 ECU_ADDRESS 0x7001445C /end MEASUREMENT
/begin MEASUREMENT dataJ1939Inst_as[3].DM11func_pf "" UBYTE CnvRule_NumberOneToOne 1 0 0 1 ECU_ADDRESS 0x70014460 /end MEASUREMENT
/begin MEASUREMENT dataJ1939Inst_as[3].ecuLoc_pas8 "" SBYTE CnvRule_NumberOneToOne 1 0 -128 127 ECU_ADDRESS 0x70014464 /end MEASUREMENT
/begin MEASUREMENT dataJ1939Inst_as[3].ecuType_pas8 "" SBYTE CnvRule_NumberOneToOne 1 0 -128 127 ECU_ADDRESS 0x70014468 /end MEASUREMENT
/begin MEASUREMENT dataJ1939Inst_as[3].ecuMan_pas8 "" SBYTE CnvRule_NumberOneToOne 1 0 -128 127 ECU_ADDRESS 0x7001446C /end MEASUREMENT
/begin MEASUREMENT dataJ1939Inst_as[3].applTask_pas8 "" SBYTE CnvRule_NumberOneToOne 1 0 -128 127 ECU_ADDRESS 0x70014470 /end MEASUREMENT
/begin MEASUREMENT dataJ1939Inst_as[3].rxSysDatabox_as[1].data_pau8 "" UBYTE CnvRule_NumberOneToOne 1 0 0 255 ECU_ADDRESS 0x70014478 /end MEASUREMENT
/begin MEASUREMENT dataJ1939Inst_as[3].rxSysDatabox_as[1].func_pf "" UBYTE CnvRule_NumberOneToOne 1 0 0 1 ECU_ADDRESS 0x7001447C /end MEASUREMENT
/begin MEASUREMENT dataJ1939Inst_as[3].rxSysDatabox_as[1].lenAct_u32 "" ULONG CnvRule_NumberOneToOne 1 0 0 4294967295 ECU_ADDRESS 0x70014484 /end MEASUREMENT
/begin MEASUREMENT dataJ1939Inst_as[3].rxSysDatabox_as[1].lenRx_u32 "" ULONG CnvRule_NumberOneToOne 1 0 0 4294967295 ECU_ADDRESS 0x70014488 /end MEASUREMENT
/begin MEASUREMENT dataJ1939Inst_as[3].rxSysDatabox_as[1].lenMax_u32 "" ULONG CnvRule_NumberOneToOne 1 0 0 4294967295 ECU_ADDRESS 0x7001448C /end MEASUREMENT
/begin MEASUREMENT dataJ1939Inst_as[3].rxSysDatabox_as[1].timeout_u16 "" UWORD CnvRule_NumberOneToOne 1 0 0 65535 ECU_ADDRESS 0x70014490 /end MEASUREMENT
/begin MEASUREMENT dataJ1939Inst_as[3].rxSysDatabox_as[1].startTimeout_u16 "" UWORD CnvRule_NumberOneToOne 1 0 0 65535 ECU_ADDRESS 0x70014492 /end MEASUREMENT
/begin MEASUREMENT dataJ1939Inst_as[3].rxSysDatabox_as[1].counter_u16 "" UWORD CnvRule_NumberOneToOne 1 0 0 65535 ECU_ADDRESS 0x70014494 /end MEASUREMENT
/begin MEASUREMENT dataJ1939Inst_as[3].rxSysDatabox_as[1].status_u16 "" UWORD CnvRule_NumberOneToOne 1 0 0 65535 ECU_ADDRESS 0x70014496 /end MEASUREMENT
/begin MEASUREMENT dataJ1939Inst_as[3].rxSysDatabox_as[1].action_u16 "" UWORD CnvRule_NumberOneToOne 1 0 0 65535 ECU_ADDRESS 0x70014498 /end MEASUREMENT
/begin MEASUREMENT dataJ1939Inst_as[3].rxSysDatabox_as[1].internalBox_l "" UBYTE CnvRule_NumberOneToOne 1 0 0 1 ECU_ADDRESS 0x7001449A /end MEASUREMENT
/begin MEASUREMENT dataJ1939Inst_as[3].rxSysDatabox_as[2].data_pau8 "" UBYTE CnvRule_NumberOneToOne 1 0 0 255 ECU_ADDRESS 0x7001449C /end MEASUREMENT
/begin MEASUREMENT dataJ1939Inst_as[3].rxSysDatabox_as[2].func_pf "" UBYTE CnvRule_NumberOneToOne 1 0 0 1 ECU_ADDRESS 0x700144A0 /end MEASUREMENT
/begin MEASUREMENT dataJ1939Inst_as[3].rxSysDatabox_as[2].lenAct_u32 "" ULONG CnvRule_NumberOneToOne 1 0 0 4294967295 ECU_ADDRESS 0x700144A8 /end MEASUREMENT
/begin MEASUREMENT dataJ1939Inst_as[3].rxSysDatabox_as[2].lenRx_u32 "" ULONG CnvRule_NumberOneToOne 1 0 0 4294967295 ECU_ADDRESS 0x700144AC /end MEASUREMENT
/begin MEASUREMENT dataJ1939Inst_as[3].rxSysDatabox_as[2].lenMax_u32 "" ULONG CnvRule_NumberOneToOne 1 0 0 4294967295 ECU_ADDRESS 0x700144B0 /end MEASUREMENT
/begin MEASUREMENT dataJ1939Inst_as[3].rxSysDatabox_as[2].timeout_u16 "" UWORD CnvRule_NumberOneToOne 1 0 0 65535 ECU_ADDRESS 0x700144B4 /end MEASUREMENT
/begin MEASUREMENT dataJ1939Inst_as[3].rxSysDatabox_as[2].startTimeout_u16 "" UWORD CnvRule_NumberOneToOne 1 0 0 65535 ECU_ADDRESS 0x700144B6 /end MEASUREMENT
/begin MEASUREMENT dataJ1939Inst_as[3].rxSysDatabox_as[2].counter_u16 "" UWORD CnvRule_NumberOneToOne 1 0 0 65535 ECU_ADDRESS 0x700144B8 /end MEASUREMENT
/begin MEASUREMENT dataJ1939Inst_as[3].rxSysDatabox_as[2].status_u16 "" UWORD CnvRule_NumberOneToOne 1 0 0 65535 ECU_ADDRESS 0x700144BA /end MEASUREMENT
/begin MEASUREMENT dataJ1939Inst_as[3].rxSysDatabox_as[2].action_u16 "" UWORD CnvRule_NumberOneToOne 1 0 0 65535 ECU_ADDRESS 0x700144BC /end MEASUREMENT
/begin MEASUREMENT dataJ1939Inst_as[3].rxSysDatabox_as[2].internalBox_l "" UBYTE CnvRule_NumberOneToOne 1 0 0 1 ECU_ADDRESS 0x700144BE /end MEASUREMENT
/begin MEASUREMENT dataJ1939Inst_as[3].rxSysDatabox_as[3].data_pau8 "" UBYTE CnvRule_NumberOneToOne 1 0 0 255 ECU_ADDRESS 0x700144C0 /end MEASUREMENT
/begin MEASUREMENT dataJ1939Inst_as[3].rxSysDatabox_as[3].func_pf "" UBYTE CnvRule_NumberOneToOne 1 0 0 1 ECU_ADDRESS 0x700144C4 /end MEASUREMENT
/begin MEASUREMENT dataJ1939Inst_as[3].rxSysDatabox_as[3].lenAct_u32 "" ULONG CnvRule_NumberOneToOne 1 0 0 4294967295 ECU_ADDRESS 0x700144CC /end MEASUREMENT
/begin MEASUREMENT dataJ1939Inst_as[3].rxSysDatabox_as[3].lenRx_u32 "" ULONG CnvRule_NumberOneToOne 1 0 0 4294967295 ECU_ADDRESS 0x700144D0 /end MEASUREMENT
/begin MEASUREMENT dataJ1939Inst_as[3].rxSysDatabox_as[3].lenMax_u32 "" ULONG CnvRule_NumberOneToOne 1 0 0 4294967295 ECU_ADDRESS 0x700144D4 /end MEASUREMENT
/begin MEASUREMENT dataJ1939Inst_as[3].rxSysDatabox_as[3].timeout_u16 "" UWORD CnvRule_NumberOneToOne 1 0 0 65535 ECU_ADDRESS 0x700144D8 /end MEASUREMENT
/begin MEASUREMENT dataJ1939Inst_as[3].rxSysDatabox_as[3].startTimeout_u16 "" UWORD CnvRule_NumberOneToOne 1 0 0 65535 ECU_ADDRESS 0x700144DA /end MEASUREMENT
/begin MEASUREMENT dataJ1939Inst_as[3].rxSysDatabox_as[3].counter_u16 "" UWORD CnvRule_NumberOneToOne 1 0 0 65535 ECU_ADDRESS 0x700144DC /end MEASUREMENT
/begin MEASUREMENT dataJ1939Inst_as[3].rxSysDatabox_as[3].status_u16 "" UWORD CnvRule_NumberOneToOne 1 0 0 65535 ECU_ADDRESS 0x700144DE /end MEASUREMENT
/begin MEASUREMENT dataJ1939Inst_as[3].rxSysDatabox_as[3].action_u16 "" UWORD CnvRule_NumberOneToOne 1 0 0 65535 ECU_ADDRESS 0x700144E0 /end MEASUREMENT
/begin MEASUREMENT dataJ1939Inst_as[3].rxSysDatabox_as[3].internalBox_l "" UBYTE CnvRule_NumberOneToOne 1 0 0 1 ECU_ADDRESS 0x700144E2 /end MEASUREMENT
/begin MEASUREMENT dataJ1939Inst_as[3].rxSysDatabox_as[4].data_pau8 "" UBYTE CnvRule_NumberOneToOne 1 0 0 255 ECU_ADDRESS 0x700144E4 /end MEASUREMENT
/begin MEASUREMENT dataJ1939Inst_as[3].rxSysDatabox_as[4].func_pf "" UBYTE CnvRule_NumberOneToOne 1 0 0 1 ECU_ADDRESS 0x700144E8 /end MEASUREMENT
/begin MEASUREMENT dataJ1939Inst_as[3].rxSysDatabox_as[4].lenAct_u32 "" ULONG CnvRule_NumberOneToOne 1 0 0 4294967295 ECU_ADDRESS 0x700144F0 /end MEASUREMENT
/begin MEASUREMENT dataJ1939Inst_as[3].rxSysDatabox_as[4].lenRx_u32 "" ULONG CnvRule_NumberOneToOne 1 0 0 4294967295 ECU_ADDRESS 0x700144F4 /end MEASUREMENT
/begin MEASUREMENT dataJ1939Inst_as[3].rxSysDatabox_as[4].lenMax_u32 "" ULONG CnvRule_NumberOneToOne 1 0 0 4294967295 ECU_ADDRESS 0x700144F8 /end MEASUREMENT
/begin MEASUREMENT dataJ1939Inst_as[3].rxSysDatabox_as[4].timeout_u16 "" UWORD CnvRule_NumberOneToOne 1 0 0 65535 ECU_ADDRESS 0x700144FC /end MEASUREMENT
/begin MEASUREMENT dataJ1939Inst_as[3].rxSysDatabox_as[4].startTimeout_u16 "" UWORD CnvRule_NumberOneToOne 1 0 0 65535 ECU_ADDRESS 0x700144FE /end MEASUREMENT
/begin MEASUREMENT dataJ1939Inst_as[3].rxSysDatabox_as[4].counter_u16 "" UWORD CnvRule_NumberOneToOne 1 0 0 65535 ECU_ADDRESS 0x70014500 /end MEASUREMENT
/begin MEASUREMENT dataJ1939Inst_as[3].rxSysDatabox_as[4].status_u16 "" UWORD CnvRule_NumberOneToOne 1 0 0 65535 ECU_ADDRESS 0x70014502 /end MEASUREMENT
/begin MEASUREMENT dataJ1939Inst_as[3].rxSysDatabox_as[4].action_u16 "" UWORD CnvRule_NumberOneToOne 1 0 0 65535 ECU_ADDRESS 0x70014504 /end MEASUREMENT
/begin MEASUREMENT dataJ1939Inst_as[3].rxSysDatabox_as[4].internalBox_l "" UBYTE CnvRule_NumberOneToOne 1 0 0 1 ECU_ADDRESS 0x70014506 /end MEASUREMENT
/begin MEASUREMENT dataJ1939Inst_as[3].rxSysDatabox_as[5].data_pau8 "" UBYTE CnvRule_NumberOneToOne 1 0 0 255 ECU_ADDRESS 0x70014508 /end MEASUREMENT
/begin MEASUREMENT dataJ1939Inst_as[3].rxSysDatabox_as[5].func_pf "" UBYTE CnvRule_NumberOneToOne 1 0 0 1 ECU_ADDRESS 0x7001450C /end MEASUREMENT
/begin MEASUREMENT dataJ1939Inst_as[3].rxSysDatabox_as[5].lenAct_u32 "" ULONG CnvRule_NumberOneToOne 1 0 0 4294967295 ECU_ADDRESS 0x70014514 /end MEASUREMENT
/begin MEASUREMENT dataJ1939Inst_as[3].rxSysDatabox_as[5].lenRx_u32 "" ULONG CnvRule_NumberOneToOne 1 0 0 4294967295 ECU_ADDRESS 0x70014518 /end MEASUREMENT
/begin MEASUREMENT dataJ1939Inst_as[3].rxSysDatabox_as[5].lenMax_u32 "" ULONG CnvRule_NumberOneToOne 1 0 0 4294967295 ECU_ADDRESS 0x7001451C /end MEASUREMENT
/begin MEASUREMENT dataJ1939Inst_as[3].rxSysDatabox_as[5].timeout_u16 "" UWORD CnvRule_NumberOneToOne 1 0 0 65535 ECU_ADDRESS 0x70014520 /end MEASUREMENT
/begin MEASUREMENT dataJ1939Inst_as[3].rxSysDatabox_as[5].startTimeout_u16 "" UWORD CnvRule_NumberOneToOne 1 0 0 65535 ECU_ADDRESS 0x70014522 /end MEASUREMENT
/begin MEASUREMENT dataJ1939Inst_as[3].rxSysDatabox_as[5].counter_u16 "" UWORD CnvRule_NumberOneToOne 1 0 0 65535 ECU_ADDRESS 0x70014524 /end MEASUREMENT
/begin MEASUREMENT dataJ1939Inst_as[3].rxSysDatabox_as[5].status_u16 "" UWORD CnvRule_NumberOneToOne 1 0 0 65535 ECU_ADDRESS 0x70014526 /end MEASUREMENT
/begin MEASUREMENT dataJ1939Inst_as[3].rxSysDatabox_as[5].action_u16 "" UWORD CnvRule_NumberOneToOne 1 0 0 65535 ECU_ADDRESS 0x70014528 /end MEASUREMENT
/begin MEASUREMENT dataJ1939Inst_as[3].rxSysDatabox_as[5].internalBox_l "" UBYTE CnvRule_NumberOneToOne 1 0 0 1 ECU_ADDRESS 0x7001452A /end MEASUREMENT
/begin MEASUREMENT dataJ1939Inst_as[3].rxSysDatabox_as "" UBYTE CnvRule_NumberOneToOne 1 0 0 1 ECU_ADDRESS 0x70014478 ARRAY_SIZE 180 /end MEASUREMENT
/begin MEASUREMENT dataJ1939Inst_as[3].txSysDatabox_as[1].data_pau8 "" UBYTE CnvRule_NumberOneToOne 1 0 0 255 ECU_ADDRESS 0x7001452C /end MEASUREMENT
/begin MEASUREMENT dataJ1939Inst_as[3].txSysDatabox_as[1].func_pf "" ULONG CnvRule_NumberOneToOne 1 0 0 4294967295 ECU_ADDRESS 0x70014530 /end MEASUREMENT
/begin MEASUREMENT dataJ1939Inst_as[3].txSysDatabox_as[1].lenMax_u32 "" ULONG CnvRule_NumberOneToOne 1 0 0 4294967295 ECU_ADDRESS 0x70014538 /end MEASUREMENT
/begin MEASUREMENT dataJ1939Inst_as[3].txSysDatabox_as[1].lenAct_u32 "" ULONG CnvRule_NumberOneToOne 1 0 0 4294967295 ECU_ADDRESS 0x7001453C /end MEASUREMENT
/begin MEASUREMENT dataJ1939Inst_as[3].txSysDatabox_as[1].cycle_u16 "" UWORD CnvRule_NumberOneToOne 1 0 0 65535 ECU_ADDRESS 0x70014540 /end MEASUREMENT
/begin MEASUREMENT dataJ1939Inst_as[3].txSysDatabox_as[1].counter_u16 "" UWORD CnvRule_NumberOneToOne 1 0 0 65535 ECU_ADDRESS 0x70014542 /end MEASUREMENT
/begin MEASUREMENT dataJ1939Inst_as[3].txSysDatabox_as[1].status_u16 "" UWORD CnvRule_NumberOneToOne 1 0 0 65535 ECU_ADDRESS 0x70014544 /end MEASUREMENT
/begin MEASUREMENT dataJ1939Inst_as[3].txSysDatabox_as[1].aperiodicdatabox_u16 "" UWORD CnvRule_NumberOneToOne 1 0 0 65535 ECU_ADDRESS 0x70014546 /end MEASUREMENT
/begin MEASUREMENT dataJ1939Inst_as[3].txSysDatabox_as[1].periodicdatabox_u16 "" UWORD CnvRule_NumberOneToOne 1 0 0 65535 ECU_ADDRESS 0x70014548 /end MEASUREMENT
/begin MEASUREMENT dataJ1939Inst_as[3].txSysDatabox_as "" ULONG CnvRule_NumberOneToOne 1 0 0 4294967295 ECU_ADDRESS 0x7001452C ARRAY_SIZE 32 /end MEASUREMENT
/begin MEASUREMENT dataJ1939Inst_as[3].rxDataRequPgn_au8 "" UBYTE CnvRule_NumberOneToOne 1 0 0 255 ECU_ADDRESS 0x7001454C ARRAY_SIZE 8 /end MEASUREMENT
/begin MEASUREMENT dataJ1939Inst_as[3].rxDataAddrClm_au8 "" UBYTE CnvRule_NumberOneToOne 1 0 0 255 ECU_ADDRESS 0x70014554 ARRAY_SIZE 8 /end MEASUREMENT
/begin MEASUREMENT dataJ1939Inst_as[3].rxDataCmdAddr_au8 "" UBYTE CnvRule_NumberOneToOne 1 0 0 255 ECU_ADDRESS 0x7001455C ARRAY_SIZE 9 /end MEASUREMENT
/begin MEASUREMENT dataJ1939Inst_as[3].rxDataNameNmt_au8 "" UBYTE CnvRule_NumberOneToOne 1 0 0 255 ECU_ADDRESS 0x70014565 ARRAY_SIZE 8 /end MEASUREMENT
/begin MEASUREMENT dataJ1939Inst_as[3].rxDataDm13_au8 "" UBYTE CnvRule_NumberOneToOne 1 0 0 255 ECU_ADDRESS 0x7001456D ARRAY_SIZE 8 /end MEASUREMENT
/begin MEASUREMENT dataJ1939Inst_as[3].txDataRequPgn_au8 "" UBYTE CnvRule_NumberOneToOne 1 0 0 255 ECU_ADDRESS 0x70014575 ARRAY_SIZE 300 /end MEASUREMENT
/begin MEASUREMENT dataJ1939Inst_as[3].dm1BuffDat_au8 "" UBYTE CnvRule_NumberOneToOne 1 0 0 255 ECU_ADDRESS 0x700146A1 ARRAY_SIZE 130 /end MEASUREMENT
/begin MEASUREMENT dataJ1939Inst_as[3].dm2BuffDat_au8 "" UBYTE CnvRule_NumberOneToOne 1 0 0 255 ECU_ADDRESS 0x70014723 ARRAY_SIZE 130 /end MEASUREMENT
/begin MEASUREMENT dataJ1939Inst_as[3].caStatus_u16 "" UWORD CnvRule_NumberOneToOne 1 0 0 65535 ECU_ADDRESS 0x700147B8 /end MEASUREMENT
/begin MEASUREMENT dataJ1939Inst_as[3].addrClaimTimer_u16 "" UWORD CnvRule_NumberOneToOne 1 0 0 65535 ECU_ADDRESS 0x700147BA /end MEASUREMENT
/begin MEASUREMENT dataJ1939Inst_as[3].taskNxtPeriodicTxIdx_u16 "" UWORD CnvRule_NumberOneToOne 1 0 0 65535 ECU_ADDRESS 0x700147BC /end MEASUREMENT
/begin MEASUREMENT dataJ1939Inst_as[3].ownAddr_u8 "" UBYTE CnvRule_NumberOneToOne 1 0 0 255 ECU_ADDRESS 0x700147BE /end MEASUREMENT
/begin MEASUREMENT dataJ1939Inst_as[3].canChannel_u8 "" UBYTE CnvRule_NumberOneToOne 1 0 0 255 ECU_ADDRESS 0x700147BF /end MEASUREMENT
/begin MEASUREMENT dataJ1939Inst_as[3].nameMngSourceAddr_u8 "" UBYTE CnvRule_NumberOneToOne 1 0 0 255 ECU_ADDRESS 0x700147C0 /end MEASUREMENT
/begin MEASUREMENT dataJ1939Inst_as[3].usedDm13Port_u8 "" UBYTE CnvRule_NumberOneToOne 1 0 0 255 ECU_ADDRESS 0x700147C1 /end MEASUREMENT
/begin MEASUREMENT dataJ1939Inst_as[3].sendDm1Allowed_l "" UBYTE CnvRule_NumberOneToOne 1 0 0 1 ECU_ADDRESS 0x700147C2 /end MEASUREMENT
/begin MEASUREMENT dataJ1939Inst_as[3].dmLampStateJ1939_l "" UBYTE CnvRule_NumberOneToOne 1 0 0 1 ECU_ADDRESS 0x700147C3 /end MEASUREMENT
/begin MEASUREMENT dataJ1939Inst_as[4].prodSdgDataboxNum_u16 "" UWORD CnvRule_NumberOneToOne 1 0 0 65535 ECU_ADDRESS 0x700147EC /end MEASUREMENT
/begin MEASUREMENT dataJ1939Inst_as[4].addClaimInfoFunc_pf "" UWORD CnvRule_NumberOneToOne 1 0 0 65535 ECU_ADDRESS 0x700147F8 /end MEASUREMENT
/begin MEASUREMENT dataJ1939Inst_as[4].DM3func_pf "" UBYTE CnvRule_NumberOneToOne 1 0 0 1 ECU_ADDRESS 0x7001489C /end MEASUREMENT
/begin MEASUREMENT dataJ1939Inst_as[4].DM11func_pf "" UBYTE CnvRule_NumberOneToOne 1 0 0 1 ECU_ADDRESS 0x700148A0 /end MEASUREMENT
/begin MEASUREMENT dataJ1939Inst_as[4].ecuLoc_pas8 "" SBYTE CnvRule_NumberOneToOne 1 0 -128 127 ECU_ADDRESS 0x700148A4 /end MEASUREMENT
/begin MEASUREMENT dataJ1939Inst_as[4].ecuType_pas8 "" SBYTE CnvRule_NumberOneToOne 1 0 -128 127 ECU_ADDRESS 0x700148A8 /end MEASUREMENT
/begin MEASUREMENT dataJ1939Inst_as[4].ecuMan_pas8 "" SBYTE CnvRule_NumberOneToOne 1 0 -128 127 ECU_ADDRESS 0x700148AC /end MEASUREMENT
/begin MEASUREMENT dataJ1939Inst_as[4].applTask_pas8 "" SBYTE CnvRule_NumberOneToOne 1 0 -128 127 ECU_ADDRESS 0x700148B0 /end MEASUREMENT
/begin MEASUREMENT dataJ1939Inst_as[4].rxSysDatabox_as[1].data_pau8 "" UBYTE CnvRule_NumberOneToOne 1 0 0 255 ECU_ADDRESS 0x700148B8 /end MEASUREMENT
/begin MEASUREMENT dataJ1939Inst_as[4].rxSysDatabox_as[1].func_pf "" UBYTE CnvRule_NumberOneToOne 1 0 0 1 ECU_ADDRESS 0x700148BC /end MEASUREMENT
/begin MEASUREMENT dataJ1939Inst_as[4].rxSysDatabox_as[1].lenAct_u32 "" ULONG CnvRule_NumberOneToOne 1 0 0 4294967295 ECU_ADDRESS 0x700148C4 /end MEASUREMENT
/begin MEASUREMENT dataJ1939Inst_as[4].rxSysDatabox_as[1].lenRx_u32 "" ULONG CnvRule_NumberOneToOne 1 0 0 4294967295 ECU_ADDRESS 0x700148C8 /end MEASUREMENT
/begin MEASUREMENT dataJ1939Inst_as[4].rxSysDatabox_as[1].lenMax_u32 "" ULONG CnvRule_NumberOneToOne 1 0 0 4294967295 ECU_ADDRESS 0x700148CC /end MEASUREMENT
/begin MEASUREMENT dataJ1939Inst_as[4].rxSysDatabox_as[1].timeout_u16 "" UWORD CnvRule_NumberOneToOne 1 0 0 65535 ECU_ADDRESS 0x700148D0 /end MEASUREMENT
/begin MEASUREMENT dataJ1939Inst_as[4].rxSysDatabox_as[1].startTimeout_u16 "" UWORD CnvRule_NumberOneToOne 1 0 0 65535 ECU_ADDRESS 0x700148D2 /end MEASUREMENT
/begin MEASUREMENT dataJ1939Inst_as[4].rxSysDatabox_as[1].counter_u16 "" UWORD CnvRule_NumberOneToOne 1 0 0 65535 ECU_ADDRESS 0x700148D4 /end MEASUREMENT
/begin MEASUREMENT dataJ1939Inst_as[4].rxSysDatabox_as[1].status_u16 "" UWORD CnvRule_NumberOneToOne 1 0 0 65535 ECU_ADDRESS 0x700148D6 /end MEASUREMENT
/begin MEASUREMENT dataJ1939Inst_as[4].rxSysDatabox_as[1].action_u16 "" UWORD CnvRule_NumberOneToOne 1 0 0 65535 ECU_ADDRESS 0x700148D8 /end MEASUREMENT
/begin MEASUREMENT dataJ1939Inst_as[4].rxSysDatabox_as[1].internalBox_l "" UBYTE CnvRule_NumberOneToOne 1 0 0 1 ECU_ADDRESS 0x700148DA /end MEASUREMENT
/begin MEASUREMENT dataJ1939Inst_as[4].rxSysDatabox_as[2].data_pau8 "" UBYTE CnvRule_NumberOneToOne 1 0 0 255 ECU_ADDRESS 0x700148DC /end MEASUREMENT
/begin MEASUREMENT dataJ1939Inst_as[4].rxSysDatabox_as[2].func_pf "" UBYTE CnvRule_NumberOneToOne 1 0 0 1 ECU_ADDRESS 0x700148E0 /end MEASUREMENT
/begin MEASUREMENT dataJ1939Inst_as[4].rxSysDatabox_as[2].lenAct_u32 "" ULONG CnvRule_NumberOneToOne 1 0 0 4294967295 ECU_ADDRESS 0x700148E8 /end MEASUREMENT
/begin MEASUREMENT dataJ1939Inst_as[4].rxSysDatabox_as[2].lenRx_u32 "" ULONG CnvRule_NumberOneToOne 1 0 0 4294967295 ECU_ADDRESS 0x700148EC /end MEASUREMENT
/begin MEASUREMENT dataJ1939Inst_as[4].rxSysDatabox_as[2].lenMax_u32 "" ULONG CnvRule_NumberOneToOne 1 0 0 4294967295 ECU_ADDRESS 0x700148F0 /end MEASUREMENT
/begin MEASUREMENT dataJ1939Inst_as[4].rxSysDatabox_as[2].timeout_u16 "" UWORD CnvRule_NumberOneToOne 1 0 0 65535 ECU_ADDRESS 0x700148F4 /end MEASUREMENT
/begin MEASUREMENT dataJ1939Inst_as[4].rxSysDatabox_as[2].startTimeout_u16 "" UWORD CnvRule_NumberOneToOne 1 0 0 65535 ECU_ADDRESS 0x700148F6 /end MEASUREMENT
/begin MEASUREMENT dataJ1939Inst_as[4].rxSysDatabox_as[2].counter_u16 "" UWORD CnvRule_NumberOneToOne 1 0 0 65535 ECU_ADDRESS 0x700148F8 /end MEASUREMENT
/begin MEASUREMENT dataJ1939Inst_as[4].rxSysDatabox_as[2].status_u16 "" UWORD CnvRule_NumberOneToOne 1 0 0 65535 ECU_ADDRESS 0x700148FA /end MEASUREMENT
/begin MEASUREMENT dataJ1939Inst_as[4].rxSysDatabox_as[2].action_u16 "" UWORD CnvRule_NumberOneToOne 1 0 0 65535 ECU_ADDRESS 0x700148FC /end MEASUREMENT
/begin MEASUREMENT dataJ1939Inst_as[4].rxSysDatabox_as[2].internalBox_l "" UBYTE CnvRule_NumberOneToOne 1 0 0 1 ECU_ADDRESS 0x700148FE /end MEASUREMENT
/begin MEASUREMENT dataJ1939Inst_as[4].rxSysDatabox_as[3].data_pau8 "" UBYTE CnvRule_NumberOneToOne 1 0 0 255 ECU_ADDRESS 0x70014900 /end MEASUREMENT
/begin MEASUREMENT dataJ1939Inst_as[4].rxSysDatabox_as[3].func_pf "" UBYTE CnvRule_NumberOneToOne 1 0 0 1 ECU_ADDRESS 0x70014904 /end MEASUREMENT
/begin MEASUREMENT dataJ1939Inst_as[4].rxSysDatabox_as[3].lenAct_u32 "" ULONG CnvRule_NumberOneToOne 1 0 0 4294967295 ECU_ADDRESS 0x7001490C /end MEASUREMENT
/begin MEASUREMENT dataJ1939Inst_as[4].rxSysDatabox_as[3].lenRx_u32 "" ULONG CnvRule_NumberOneToOne 1 0 0 4294967295 ECU_ADDRESS 0x70014910 /end MEASUREMENT
/begin MEASUREMENT dataJ1939Inst_as[4].rxSysDatabox_as[3].lenMax_u32 "" ULONG CnvRule_NumberOneToOne 1 0 0 4294967295 ECU_ADDRESS 0x70014914 /end MEASUREMENT
/begin MEASUREMENT dataJ1939Inst_as[4].rxSysDatabox_as[3].timeout_u16 "" UWORD CnvRule_NumberOneToOne 1 0 0 65535 ECU_ADDRESS 0x70014918 /end MEASUREMENT
/begin MEASUREMENT dataJ1939Inst_as[4].rxSysDatabox_as[3].startTimeout_u16 "" UWORD CnvRule_NumberOneToOne 1 0 0 65535 ECU_ADDRESS 0x7001491A /end MEASUREMENT
/begin MEASUREMENT dataJ1939Inst_as[4].rxSysDatabox_as[3].counter_u16 "" UWORD CnvRule_NumberOneToOne 1 0 0 65535 ECU_ADDRESS 0x7001491C /end MEASUREMENT
/begin MEASUREMENT dataJ1939Inst_as[4].rxSysDatabox_as[3].status_u16 "" UWORD CnvRule_NumberOneToOne 1 0 0 65535 ECU_ADDRESS 0x7001491E /end MEASUREMENT
/begin MEASUREMENT dataJ1939Inst_as[4].rxSysDatabox_as[3].action_u16 "" UWORD CnvRule_NumberOneToOne 1 0 0 65535 ECU_ADDRESS 0x70014920 /end MEASUREMENT
/begin MEASUREMENT dataJ1939Inst_as[4].rxSysDatabox_as[3].internalBox_l "" UBYTE CnvRule_NumberOneToOne 1 0 0 1 ECU_ADDRESS 0x70014922 /end MEASUREMENT
/begin MEASUREMENT dataJ1939Inst_as[4].rxSysDatabox_as[4].data_pau8 "" UBYTE CnvRule_NumberOneToOne 1 0 0 255 ECU_ADDRESS 0x70014924 /end MEASUREMENT
/begin MEASUREMENT dataJ1939Inst_as[4].rxSysDatabox_as[4].func_pf "" UBYTE CnvRule_NumberOneToOne 1 0 0 1 ECU_ADDRESS 0x70014928 /end MEASUREMENT
/begin MEASUREMENT dataJ1939Inst_as[4].rxSysDatabox_as[4].lenAct_u32 "" ULONG CnvRule_NumberOneToOne 1 0 0 4294967295 ECU_ADDRESS 0x70014930 /end MEASUREMENT
/begin MEASUREMENT dataJ1939Inst_as[4].rxSysDatabox_as[4].lenRx_u32 "" ULONG CnvRule_NumberOneToOne 1 0 0 4294967295 ECU_ADDRESS 0x70014934 /end MEASUREMENT
/begin MEASUREMENT dataJ1939Inst_as[4].rxSysDatabox_as[4].lenMax_u32 "" ULONG CnvRule_NumberOneToOne 1 0 0 4294967295 ECU_ADDRESS 0x70014938 /end MEASUREMENT
/begin MEASUREMENT dataJ1939Inst_as[4].rxSysDatabox_as[4].timeout_u16 "" UWORD CnvRule_NumberOneToOne 1 0 0 65535 ECU_ADDRESS 0x7001493C /end MEASUREMENT
/begin MEASUREMENT dataJ1939Inst_as[4].rxSysDatabox_as[4].startTimeout_u16 "" UWORD CnvRule_NumberOneToOne 1 0 0 65535 ECU_ADDRESS 0x7001493E /end MEASUREMENT
/begin MEASUREMENT dataJ1939Inst_as[4].rxSysDatabox_as[4].counter_u16 "" UWORD CnvRule_NumberOneToOne 1 0 0 65535 ECU_ADDRESS 0x70014940 /end MEASUREMENT
/begin MEASUREMENT dataJ1939Inst_as[4].rxSysDatabox_as[4].status_u16 "" UWORD CnvRule_NumberOneToOne 1 0 0 65535 ECU_ADDRESS 0x70014942 /end MEASUREMENT
/begin MEASUREMENT dataJ1939Inst_as[4].rxSysDatabox_as[4].action_u16 "" UWORD CnvRule_NumberOneToOne 1 0 0 65535 ECU_ADDRESS 0x70014944 /end MEASUREMENT
/begin MEASUREMENT dataJ1939Inst_as[4].rxSysDatabox_as[4].internalBox_l "" UBYTE CnvRule_NumberOneToOne 1 0 0 1 ECU_ADDRESS 0x70014946 /end MEASUREMENT
/begin MEASUREMENT dataJ1939Inst_as[4].rxSysDatabox_as[5].data_pau8 "" UBYTE CnvRule_NumberOneToOne 1 0 0 255 ECU_ADDRESS 0x70014948 /end MEASUREMENT
/begin MEASUREMENT dataJ1939Inst_as[4].rxSysDatabox_as[5].func_pf "" UBYTE CnvRule_NumberOneToOne 1 0 0 1 ECU_ADDRESS 0x7001494C /end MEASUREMENT
/begin MEASUREMENT dataJ1939Inst_as[4].rxSysDatabox_as[5].lenAct_u32 "" ULONG CnvRule_NumberOneToOne 1 0 0 4294967295 ECU_ADDRESS 0x70014954 /end MEASUREMENT
/begin MEASUREMENT dataJ1939Inst_as[4].rxSysDatabox_as[5].lenRx_u32 "" ULONG CnvRule_NumberOneToOne 1 0 0 4294967295 ECU_ADDRESS 0x70014958 /end MEASUREMENT
/begin MEASUREMENT dataJ1939Inst_as[4].rxSysDatabox_as[5].lenMax_u32 "" ULONG CnvRule_NumberOneToOne 1 0 0 4294967295 ECU_ADDRESS 0x7001495C /end MEASUREMENT
/begin MEASUREMENT dataJ1939Inst_as[4].rxSysDatabox_as[5].timeout_u16 "" UWORD CnvRule_NumberOneToOne 1 0 0 65535 ECU_ADDRESS 0x70014960 /end MEASUREMENT
/begin MEASUREMENT dataJ1939Inst_as[4].rxSysDatabox_as[5].startTimeout_u16 "" UWORD CnvRule_NumberOneToOne 1 0 0 65535 ECU_ADDRESS 0x70014962 /end MEASUREMENT
/begin MEASUREMENT dataJ1939Inst_as[4].rxSysDatabox_as[5].counter_u16 "" UWORD CnvRule_NumberOneToOne 1 0 0 65535 ECU_ADDRESS 0x70014964 /end MEASUREMENT
/begin MEASUREMENT dataJ1939Inst_as[4].rxSysDatabox_as[5].status_u16 "" UWORD CnvRule_NumberOneToOne 1 0 0 65535 ECU_ADDRESS 0x70014966 /end MEASUREMENT
/begin MEASUREMENT dataJ1939Inst_as[4].rxSysDatabox_as[5].action_u16 "" UWORD CnvRule_NumberOneToOne 1 0 0 65535 ECU_ADDRESS 0x70014968 /end MEASUREMENT
/begin MEASUREMENT dataJ1939Inst_as[4].rxSysDatabox_as[5].internalBox_l "" UBYTE CnvRule_NumberOneToOne 1 0 0 1 ECU_ADDRESS 0x7001496A /end MEASUREMENT
/begin MEASUREMENT dataJ1939Inst_as[4].rxSysDatabox_as "" UBYTE CnvRule_NumberOneToOne 1 0 0 1 ECU_ADDRESS 0x700148B8 ARRAY_SIZE 180 /end MEASUREMENT
/begin MEASUREMENT dataJ1939Inst_as[4].txSysDatabox_as[1].data_pau8 "" UBYTE CnvRule_NumberOneToOne 1 0 0 255 ECU_ADDRESS 0x7001496C /end MEASUREMENT
/begin MEASUREMENT dataJ1939Inst_as[4].txSysDatabox_as[1].func_pf "" ULONG CnvRule_NumberOneToOne 1 0 0 4294967295 ECU_ADDRESS 0x70014970 /end MEASUREMENT
/begin MEASUREMENT dataJ1939Inst_as[4].txSysDatabox_as[1].lenMax_u32 "" ULONG CnvRule_NumberOneToOne 1 0 0 4294967295 ECU_ADDRESS 0x70014978 /end MEASUREMENT
/begin MEASUREMENT dataJ1939Inst_as[4].txSysDatabox_as[1].lenAct_u32 "" ULONG CnvRule_NumberOneToOne 1 0 0 4294967295 ECU_ADDRESS 0x7001497C /end MEASUREMENT
/begin MEASUREMENT dataJ1939Inst_as[4].txSysDatabox_as[1].cycle_u16 "" UWORD CnvRule_NumberOneToOne 1 0 0 65535 ECU_ADDRESS 0x70014980 /end MEASUREMENT
/begin MEASUREMENT dataJ1939Inst_as[4].txSysDatabox_as[1].counter_u16 "" UWORD CnvRule_NumberOneToOne 1 0 0 65535 ECU_ADDRESS 0x70014982 /end MEASUREMENT
/begin MEASUREMENT dataJ1939Inst_as[4].txSysDatabox_as[1].status_u16 "" UWORD CnvRule_NumberOneToOne 1 0 0 65535 ECU_ADDRESS 0x70014984 /end MEASUREMENT
/begin MEASUREMENT dataJ1939Inst_as[4].txSysDatabox_as[1].aperiodicdatabox_u16 "" UWORD CnvRule_NumberOneToOne 1 0 0 65535 ECU_ADDRESS 0x70014986 /end MEASUREMENT
/begin MEASUREMENT dataJ1939Inst_as[4].txSysDatabox_as[1].periodicdatabox_u16 "" UWORD CnvRule_NumberOneToOne 1 0 0 65535 ECU_ADDRESS 0x70014988 /end MEASUREMENT
/begin MEASUREMENT dataJ1939Inst_as[4].txSysDatabox_as "" ULONG CnvRule_NumberOneToOne 1 0 0 4294967295 ECU_ADDRESS 0x7001496C ARRAY_SIZE 32 /end MEASUREMENT
/begin MEASUREMENT dataJ1939Inst_as[4].rxDataRequPgn_au8 "" UBYTE CnvRule_NumberOneToOne 1 0 0 255 ECU_ADDRESS 0x7001498C ARRAY_SIZE 8 /end MEASUREMENT
/begin MEASUREMENT dataJ1939Inst_as[4].rxDataAddrClm_au8 "" UBYTE CnvRule_NumberOneToOne 1 0 0 255 ECU_ADDRESS 0x70014994 ARRAY_SIZE 8 /end MEASUREMENT
/begin MEASUREMENT dataJ1939Inst_as[4].rxDataCmdAddr_au8 "" UBYTE CnvRule_NumberOneToOne 1 0 0 255 ECU_ADDRESS 0x7001499C ARRAY_SIZE 9 /end MEASUREMENT
/begin MEASUREMENT dataJ1939Inst_as[4].rxDataNameNmt_au8 "" UBYTE CnvRule_NumberOneToOne 1 0 0 255 ECU_ADDRESS 0x700149A5 ARRAY_SIZE 8 /end MEASUREMENT
/begin MEASUREMENT dataJ1939Inst_as[4].rxDataDm13_au8 "" UBYTE CnvRule_NumberOneToOne 1 0 0 255 ECU_ADDRESS 0x700149AD ARRAY_SIZE 8 /end MEASUREMENT
/begin MEASUREMENT dataJ1939Inst_as[4].txDataRequPgn_au8 "" UBYTE CnvRule_NumberOneToOne 1 0 0 255 ECU_ADDRESS 0x700149B5 ARRAY_SIZE 300 /end MEASUREMENT
/begin MEASUREMENT dataJ1939Inst_as[4].dm1BuffDat_au8 "" UBYTE CnvRule_NumberOneToOne 1 0 0 255 ECU_ADDRESS 0x70014AE1 ARRAY_SIZE 130 /end MEASUREMENT
/begin MEASUREMENT dataJ1939Inst_as[4].dm2BuffDat_au8 "" UBYTE CnvRule_NumberOneToOne 1 0 0 255 ECU_ADDRESS 0x70014B63 ARRAY_SIZE 130 /end MEASUREMENT
/begin MEASUREMENT dataJ1939Inst_as[4].caStatus_u16 "" UWORD CnvRule_NumberOneToOne 1 0 0 65535 ECU_ADDRESS 0x70014BF8 /end MEASUREMENT
/begin MEASUREMENT dataJ1939Inst_as[4].addrClaimTimer_u16 "" UWORD CnvRule_NumberOneToOne 1 0 0 65535 ECU_ADDRESS 0x70014BFA /end MEASUREMENT
/begin MEASUREMENT dataJ1939Inst_as[4].taskNxtPeriodicTxIdx_u16 "" UWORD CnvRule_NumberOneToOne 1 0 0 65535 ECU_ADDRESS 0x70014BFC /end MEASUREMENT
/begin MEASUREMENT dataJ1939Inst_as[4].ownAddr_u8 "" UBYTE CnvRule_NumberOneToOne 1 0 0 255 ECU_ADDRESS 0x70014BFE /end MEASUREMENT
/begin MEASUREMENT dataJ1939Inst_as[4].canChannel_u8 "" UBYTE CnvRule_NumberOneToOne 1 0 0 255 ECU_ADDRESS 0x70014BFF /end MEASUREMENT
/begin MEASUREMENT dataJ1939Inst_as[4].nameMngSourceAddr_u8 "" UBYTE CnvRule_NumberOneToOne 1 0 0 255 ECU_ADDRESS 0x70014C00 /end MEASUREMENT
/begin MEASUREMENT dataJ1939Inst_as[4].usedDm13Port_u8 "" UBYTE CnvRule_NumberOneToOne 1 0 0 255 ECU_ADDRESS 0x70014C01 /end MEASUREMENT
/begin MEASUREMENT dataJ1939Inst_as[4].sendDm1Allowed_l "" UBYTE CnvRule_NumberOneToOne 1 0 0 1 ECU_ADDRESS 0x70014C02 /end MEASUREMENT
/begin MEASUREMENT dataJ1939Inst_as[4].dmLampStateJ1939_l "" UBYTE CnvRule_NumberOneToOne 1 0 0 1 ECU_ADDRESS 0x70014C03 /end MEASUREMENT
/begin MEASUREMENT dataTxBufDataBoxes1_as[1].data_pau8 "" UBYTE CnvRule_NumberOneToOne 1 0 0 255 ECU_ADDRESS 0x70014C0C /end MEASUREMENT
/begin MEASUREMENT dataTxBufDataBoxes1_as[1].func_pf "" ULONG CnvRule_NumberOneToOne 1 0 0 4294967295 ECU_ADDRESS 0x70014C10 /end MEASUREMENT
/begin MEASUREMENT dataTxBufDataBoxes1_as[1].lenMax_u32 "" ULONG CnvRule_NumberOneToOne 1 0 0 4294967295 ECU_ADDRESS 0x70014C18 /end MEASUREMENT
/begin MEASUREMENT dataTxBufDataBoxes1_as[1].lenAct_u32 "" ULONG CnvRule_NumberOneToOne 1 0 0 4294967295 ECU_ADDRESS 0x70014C1C /end MEASUREMENT
/begin MEASUREMENT dataTxBufDataBoxes1_as[1].cycle_u16 "" UWORD CnvRule_NumberOneToOne 1 0 0 65535 ECU_ADDRESS 0x70014C20 /end MEASUREMENT
/begin MEASUREMENT dataTxBufDataBoxes1_as[1].counter_u16 "" UWORD CnvRule_NumberOneToOne 1 0 0 65535 ECU_ADDRESS 0x70014C22 /end MEASUREMENT
/begin MEASUREMENT dataTxBufDataBoxes1_as[1].status_u16 "" UWORD CnvRule_NumberOneToOne 1 0 0 65535 ECU_ADDRESS 0x70014C24 /end MEASUREMENT
/begin MEASUREMENT dataTxBufDataBoxes1_as[1].aperiodicdatabox_u16 "" UWORD CnvRule_NumberOneToOne 1 0 0 65535 ECU_ADDRESS 0x70014C26 /end MEASUREMENT
/begin MEASUREMENT dataTxBufDataBoxes1_as[1].periodicdatabox_u16 "" UWORD CnvRule_NumberOneToOne 1 0 0 65535 ECU_ADDRESS 0x70014C28 /end MEASUREMENT
/begin MEASUREMENT dataTxBufDataBoxes1_as[2].data_pau8 "" UBYTE CnvRule_NumberOneToOne 1 0 0 255 ECU_ADDRESS 0x70014C2C /end MEASUREMENT
/begin MEASUREMENT dataTxBufDataBoxes1_as[2].func_pf "" ULONG CnvRule_NumberOneToOne 1 0 0 4294967295 ECU_ADDRESS 0x70014C30 /end MEASUREMENT
/begin MEASUREMENT dataTxBufDataBoxes1_as[2].lenMax_u32 "" ULONG CnvRule_NumberOneToOne 1 0 0 4294967295 ECU_ADDRESS 0x70014C38 /end MEASUREMENT
/begin MEASUREMENT dataTxBufDataBoxes1_as[2].lenAct_u32 "" ULONG CnvRule_NumberOneToOne 1 0 0 4294967295 ECU_ADDRESS 0x70014C3C /end MEASUREMENT
/begin MEASUREMENT dataTxBufDataBoxes1_as[2].cycle_u16 "" UWORD CnvRule_NumberOneToOne 1 0 0 65535 ECU_ADDRESS 0x70014C40 /end MEASUREMENT
/begin MEASUREMENT dataTxBufDataBoxes1_as[2].counter_u16 "" UWORD CnvRule_NumberOneToOne 1 0 0 65535 ECU_ADDRESS 0x70014C42 /end MEASUREMENT
/begin MEASUREMENT dataTxBufDataBoxes1_as[2].status_u16 "" UWORD CnvRule_NumberOneToOne 1 0 0 65535 ECU_ADDRESS 0x70014C44 /end MEASUREMENT
/begin MEASUREMENT dataTxBufDataBoxes1_as[2].aperiodicdatabox_u16 "" UWORD CnvRule_NumberOneToOne 1 0 0 65535 ECU_ADDRESS 0x70014C46 /end MEASUREMENT
/begin MEASUREMENT dataTxBufDataBoxes1_as[2].periodicdatabox_u16 "" UWORD CnvRule_NumberOneToOne 1 0 0 65535 ECU_ADDRESS 0x70014C48 /end MEASUREMENT
/begin MEASUREMENT dataTxBufDataBoxes1_as[3].data_pau8 "" UBYTE CnvRule_NumberOneToOne 1 0 0 255 ECU_ADDRESS 0x70014C4C /end MEASUREMENT
/begin MEASUREMENT dataTxBufDataBoxes1_as[3].func_pf "" ULONG CnvRule_NumberOneToOne 1 0 0 4294967295 ECU_ADDRESS 0x70014C50 /end MEASUREMENT
/begin MEASUREMENT dataTxBufDataBoxes1_as[3].lenMax_u32 "" ULONG CnvRule_NumberOneToOne 1 0 0 4294967295 ECU_ADDRESS 0x70014C58 /end MEASUREMENT
/begin MEASUREMENT dataTxBufDataBoxes1_as[3].lenAct_u32 "" ULONG CnvRule_NumberOneToOne 1 0 0 4294967295 ECU_ADDRESS 0x70014C5C /end MEASUREMENT
/begin MEASUREMENT dataTxBufDataBoxes1_as[3].cycle_u16 "" UWORD CnvRule_NumberOneToOne 1 0 0 65535 ECU_ADDRESS 0x70014C60 /end MEASUREMENT
/begin MEASUREMENT dataTxBufDataBoxes1_as[3].counter_u16 "" UWORD CnvRule_NumberOneToOne 1 0 0 65535 ECU_ADDRESS 0x70014C62 /end MEASUREMENT
/begin MEASUREMENT dataTxBufDataBoxes1_as[3].status_u16 "" UWORD CnvRule_NumberOneToOne 1 0 0 65535 ECU_ADDRESS 0x70014C64 /end MEASUREMENT
/begin MEASUREMENT dataTxBufDataBoxes1_as[3].aperiodicdatabox_u16 "" UWORD CnvRule_NumberOneToOne 1 0 0 65535 ECU_ADDRESS 0x70014C66 /end MEASUREMENT
/begin MEASUREMENT dataTxBufDataBoxes1_as[3].periodicdatabox_u16 "" UWORD CnvRule_NumberOneToOne 1 0 0 65535 ECU_ADDRESS 0x70014C68 /end MEASUREMENT
/begin MEASUREMENT dataTxBufDataBoxes1_as[4].data_pau8 "" UBYTE CnvRule_NumberOneToOne 1 0 0 255 ECU_ADDRESS 0x70014C6C /end MEASUREMENT
/begin MEASUREMENT dataTxBufDataBoxes1_as[4].func_pf "" ULONG CnvRule_NumberOneToOne 1 0 0 4294967295 ECU_ADDRESS 0x70014C70 /end MEASUREMENT
/begin MEASUREMENT dataTxBufDataBoxes1_as[4].lenMax_u32 "" ULONG CnvRule_NumberOneToOne 1 0 0 4294967295 ECU_ADDRESS 0x70014C78 /end MEASUREMENT
/begin MEASUREMENT dataTxBufDataBoxes1_as[4].lenAct_u32 "" ULONG CnvRule_NumberOneToOne 1 0 0 4294967295 ECU_ADDRESS 0x70014C7C /end MEASUREMENT
/begin MEASUREMENT dataTxBufDataBoxes1_as[4].cycle_u16 "" UWORD CnvRule_NumberOneToOne 1 0 0 65535 ECU_ADDRESS 0x70014C80 /end MEASUREMENT
/begin MEASUREMENT dataTxBufDataBoxes1_as[4].counter_u16 "" UWORD CnvRule_NumberOneToOne 1 0 0 65535 ECU_ADDRESS 0x70014C82 /end MEASUREMENT
/begin MEASUREMENT dataTxBufDataBoxes1_as[4].status_u16 "" UWORD CnvRule_NumberOneToOne 1 0 0 65535 ECU_ADDRESS 0x70014C84 /end MEASUREMENT
/begin MEASUREMENT dataTxBufDataBoxes1_as[4].aperiodicdatabox_u16 "" UWORD CnvRule_NumberOneToOne 1 0 0 65535 ECU_ADDRESS 0x70014C86 /end MEASUREMENT
/begin MEASUREMENT dataTxBufDataBoxes1_as[4].periodicdatabox_u16 "" UWORD CnvRule_NumberOneToOne 1 0 0 65535 ECU_ADDRESS 0x70014C88 /end MEASUREMENT
/begin MEASUREMENT dataTxBufDataBoxes1_as[5].data_pau8 "" UBYTE CnvRule_NumberOneToOne 1 0 0 255 ECU_ADDRESS 0x70014C8C /end MEASUREMENT
/begin MEASUREMENT dataTxBufDataBoxes1_as[5].func_pf "" ULONG CnvRule_NumberOneToOne 1 0 0 4294967295 ECU_ADDRESS 0x70014C90 /end MEASUREMENT
/begin MEASUREMENT dataTxBufDataBoxes1_as[5].lenMax_u32 "" ULONG CnvRule_NumberOneToOne 1 0 0 4294967295 ECU_ADDRESS 0x70014C98 /end MEASUREMENT
/begin MEASUREMENT dataTxBufDataBoxes1_as[5].lenAct_u32 "" ULONG CnvRule_NumberOneToOne 1 0 0 4294967295 ECU_ADDRESS 0x70014C9C /end MEASUREMENT
/begin MEASUREMENT dataTxBufDataBoxes1_as[5].cycle_u16 "" UWORD CnvRule_NumberOneToOne 1 0 0 65535 ECU_ADDRESS 0x70014CA0 /end MEASUREMENT
/begin MEASUREMENT dataTxBufDataBoxes1_as[5].counter_u16 "" UWORD CnvRule_NumberOneToOne 1 0 0 65535 ECU_ADDRESS 0x70014CA2 /end MEASUREMENT
/begin MEASUREMENT dataTxBufDataBoxes1_as[5].status_u16 "" UWORD CnvRule_NumberOneToOne 1 0 0 65535 ECU_ADDRESS 0x70014CA4 /end MEASUREMENT
/begin MEASUREMENT dataTxBufDataBoxes1_as[5].aperiodicdatabox_u16 "" UWORD CnvRule_NumberOneToOne 1 0 0 65535 ECU_ADDRESS 0x70014CA6 /end MEASUREMENT
/begin MEASUREMENT dataTxBufDataBoxes1_as[5].periodicdatabox_u16 "" UWORD CnvRule_NumberOneToOne 1 0 0 65535 ECU_ADDRESS 0x70014CA8 /end MEASUREMENT
/begin MEASUREMENT dataTxBufDataBoxes1_as[6].data_pau8 "" UBYTE CnvRule_NumberOneToOne 1 0 0 255 ECU_ADDRESS 0x70014CAC /end MEASUREMENT
/begin MEASUREMENT dataTxBufDataBoxes1_as[6].func_pf "" ULONG CnvRule_NumberOneToOne 1 0 0 4294967295 ECU_ADDRESS 0x70014CB0 /end MEASUREMENT
/begin MEASUREMENT dataTxBufDataBoxes1_as[6].lenMax_u32 "" ULONG CnvRule_NumberOneToOne 1 0 0 4294967295 ECU_ADDRESS 0x70014CB8 /end MEASUREMENT
/begin MEASUREMENT dataTxBufDataBoxes1_as[6].lenAct_u32 "" ULONG CnvRule_NumberOneToOne 1 0 0 4294967295 ECU_ADDRESS 0x70014CBC /end MEASUREMENT
/begin MEASUREMENT dataTxBufDataBoxes1_as[6].cycle_u16 "" UWORD CnvRule_NumberOneToOne 1 0 0 65535 ECU_ADDRESS 0x70014CC0 /end MEASUREMENT
/begin MEASUREMENT dataTxBufDataBoxes1_as[6].counter_u16 "" UWORD CnvRule_NumberOneToOne 1 0 0 65535 ECU_ADDRESS 0x70014CC2 /end MEASUREMENT
/begin MEASUREMENT dataTxBufDataBoxes1_as[6].status_u16 "" UWORD CnvRule_NumberOneToOne 1 0 0 65535 ECU_ADDRESS 0x70014CC4 /end MEASUREMENT
/begin MEASUREMENT dataTxBufDataBoxes1_as[6].aperiodicdatabox_u16 "" UWORD CnvRule_NumberOneToOne 1 0 0 65535 ECU_ADDRESS 0x70014CC6 /end MEASUREMENT
/begin MEASUREMENT dataTxBufDataBoxes1_as[6].periodicdatabox_u16 "" UWORD CnvRule_NumberOneToOne 1 0 0 65535 ECU_ADDRESS 0x70014CC8 /end MEASUREMENT
/begin MEASUREMENT dataRxBufDataBoxes1_as[1].data_pau8 "" UBYTE CnvRule_NumberOneToOne 1 0 0 255 ECU_ADDRESS 0x70014CCC /end MEASUREMENT
/begin MEASUREMENT dataRxBufDataBoxes1_as[1].func_pf "" UBYTE CnvRule_NumberOneToOne 1 0 0 1 ECU_ADDRESS 0x70014CD0 /end MEASUREMENT
/begin MEASUREMENT dataRxBufDataBoxes1_as[1].lenAct_u32 "" ULONG CnvRule_NumberOneToOne 1 0 0 4294967295 ECU_ADDRESS 0x70014CD8 /end MEASUREMENT
/begin MEASUREMENT dataRxBufDataBoxes1_as[1].lenRx_u32 "" ULONG CnvRule_NumberOneToOne 1 0 0 4294967295 ECU_ADDRESS 0x70014CDC /end MEASUREMENT
/begin MEASUREMENT dataRxBufDataBoxes1_as[1].lenMax_u32 "" ULONG CnvRule_NumberOneToOne 1 0 0 4294967295 ECU_ADDRESS 0x70014CE0 /end MEASUREMENT
/begin MEASUREMENT dataRxBufDataBoxes1_as[1].timeout_u16 "" UWORD CnvRule_NumberOneToOne 1 0 0 65535 ECU_ADDRESS 0x70014CE4 /end MEASUREMENT
/begin MEASUREMENT dataRxBufDataBoxes1_as[1].startTimeout_u16 "" UWORD CnvRule_NumberOneToOne 1 0 0 65535 ECU_ADDRESS 0x70014CE6 /end MEASUREMENT
/begin MEASUREMENT dataRxBufDataBoxes1_as[1].counter_u16 "" UWORD CnvRule_NumberOneToOne 1 0 0 65535 ECU_ADDRESS 0x70014CE8 /end MEASUREMENT
/begin MEASUREMENT dataRxBufDataBoxes1_as[1].status_u16 "" UWORD CnvRule_NumberOneToOne 1 0 0 65535 ECU_ADDRESS 0x70014CEA /end MEASUREMENT
/begin MEASUREMENT dataRxBufDataBoxes1_as[1].action_u16 "" UWORD CnvRule_NumberOneToOne 1 0 0 65535 ECU_ADDRESS 0x70014CEC /end MEASUREMENT
/begin MEASUREMENT dataRxBufDataBoxes1_as[1].internalBox_l "" UBYTE CnvRule_NumberOneToOne 1 0 0 1 ECU_ADDRESS 0x70014CEE /end MEASUREMENT
/begin MEASUREMENT dataRxBufDataBoxes1_as[2].data_pau8 "" UBYTE CnvRule_NumberOneToOne 1 0 0 255 ECU_ADDRESS 0x70014CF0 /end MEASUREMENT
/begin MEASUREMENT dataRxBufDataBoxes1_as[2].func_pf "" UBYTE CnvRule_NumberOneToOne 1 0 0 1 ECU_ADDRESS 0x70014CF4 /end MEASUREMENT
/begin MEASUREMENT dataRxBufDataBoxes1_as[2].lenAct_u32 "" ULONG CnvRule_NumberOneToOne 1 0 0 4294967295 ECU_ADDRESS 0x70014CFC /end MEASUREMENT
/begin MEASUREMENT dataRxBufDataBoxes1_as[2].lenRx_u32 "" ULONG CnvRule_NumberOneToOne 1 0 0 4294967295 ECU_ADDRESS 0x70014D00 /end MEASUREMENT
/begin MEASUREMENT dataRxBufDataBoxes1_as[2].lenMax_u32 "" ULONG CnvRule_NumberOneToOne 1 0 0 4294967295 ECU_ADDRESS 0x70014D04 /end MEASUREMENT
/begin MEASUREMENT dataRxBufDataBoxes1_as[2].timeout_u16 "" UWORD CnvRule_NumberOneToOne 1 0 0 65535 ECU_ADDRESS 0x70014D08 /end MEASUREMENT
/begin MEASUREMENT dataRxBufDataBoxes1_as[2].startTimeout_u16 "" UWORD CnvRule_NumberOneToOne 1 0 0 65535 ECU_ADDRESS 0x70014D0A /end MEASUREMENT
/begin MEASUREMENT dataRxBufDataBoxes1_as[2].counter_u16 "" UWORD CnvRule_NumberOneToOne 1 0 0 65535 ECU_ADDRESS 0x70014D0C /end MEASUREMENT
/begin MEASUREMENT dataRxBufDataBoxes1_as[2].status_u16 "" UWORD CnvRule_NumberOneToOne 1 0 0 65535 ECU_ADDRESS 0x70014D0E /end MEASUREMENT
/begin MEASUREMENT dataRxBufDataBoxes1_as[2].action_u16 "" UWORD CnvRule_NumberOneToOne 1 0 0 65535 ECU_ADDRESS 0x70014D10 /end MEASUREMENT
/begin MEASUREMENT dataRxBufDataBoxes1_as[2].internalBox_l "" UBYTE CnvRule_NumberOneToOne 1 0 0 1 ECU_ADDRESS 0x70014D12 /end MEASUREMENT
/begin MEASUREMENT dataRxBufDataBoxes1_as[3].data_pau8 "" UBYTE CnvRule_NumberOneToOne 1 0 0 255 ECU_ADDRESS 0x70014D14 /end MEASUREMENT
/begin MEASUREMENT dataRxBufDataBoxes1_as[3].func_pf "" UBYTE CnvRule_NumberOneToOne 1 0 0 1 ECU_ADDRESS 0x70014D18 /end MEASUREMENT
/begin MEASUREMENT dataRxBufDataBoxes1_as[3].lenAct_u32 "" ULONG CnvRule_NumberOneToOne 1 0 0 4294967295 ECU_ADDRESS 0x70014D20 /end MEASUREMENT
/begin MEASUREMENT dataRxBufDataBoxes1_as[3].lenRx_u32 "" ULONG CnvRule_NumberOneToOne 1 0 0 4294967295 ECU_ADDRESS 0x70014D24 /end MEASUREMENT
/begin MEASUREMENT dataRxBufDataBoxes1_as[3].lenMax_u32 "" ULONG CnvRule_NumberOneToOne 1 0 0 4294967295 ECU_ADDRESS 0x70014D28 /end MEASUREMENT
/begin MEASUREMENT dataRxBufDataBoxes1_as[3].timeout_u16 "" UWORD CnvRule_NumberOneToOne 1 0 0 65535 ECU_ADDRESS 0x70014D2C /end MEASUREMENT
/begin MEASUREMENT dataRxBufDataBoxes1_as[3].startTimeout_u16 "" UWORD CnvRule_NumberOneToOne 1 0 0 65535 ECU_ADDRESS 0x70014D2E /end MEASUREMENT
/begin MEASUREMENT dataRxBufDataBoxes1_as[3].counter_u16 "" UWORD CnvRule_NumberOneToOne 1 0 0 65535 ECU_ADDRESS 0x70014D30 /end MEASUREMENT
/begin MEASUREMENT dataRxBufDataBoxes1_as[3].status_u16 "" UWORD CnvRule_NumberOneToOne 1 0 0 65535 ECU_ADDRESS 0x70014D32 /end MEASUREMENT
/begin MEASUREMENT dataRxBufDataBoxes1_as[3].action_u16 "" UWORD CnvRule_NumberOneToOne 1 0 0 65535 ECU_ADDRESS 0x70014D34 /end MEASUREMENT
/begin MEASUREMENT dataRxBufDataBoxes1_as[3].internalBox_l "" UBYTE CnvRule_NumberOneToOne 1 0 0 1 ECU_ADDRESS 0x70014D36 /end MEASUREMENT
/begin MEASUREMENT dataRxBufDataBoxes1_as[4].data_pau8 "" UBYTE CnvRule_NumberOneToOne 1 0 0 255 ECU_ADDRESS 0x70014D38 /end MEASUREMENT
/begin MEASUREMENT dataRxBufDataBoxes1_as[4].func_pf "" UBYTE CnvRule_NumberOneToOne 1 0 0 1 ECU_ADDRESS 0x70014D3C /end MEASUREMENT
/begin MEASUREMENT dataRxBufDataBoxes1_as[4].lenAct_u32 "" ULONG CnvRule_NumberOneToOne 1 0 0 4294967295 ECU_ADDRESS 0x70014D44 /end MEASUREMENT
/begin MEASUREMENT dataRxBufDataBoxes1_as[4].lenRx_u32 "" ULONG CnvRule_NumberOneToOne 1 0 0 4294967295 ECU_ADDRESS 0x70014D48 /end MEASUREMENT
/begin MEASUREMENT dataRxBufDataBoxes1_as[4].lenMax_u32 "" ULONG CnvRule_NumberOneToOne 1 0 0 4294967295 ECU_ADDRESS 0x70014D4C /end MEASUREMENT
/begin MEASUREMENT dataRxBufDataBoxes1_as[4].timeout_u16 "" UWORD CnvRule_NumberOneToOne 1 0 0 65535 ECU_ADDRESS 0x70014D50 /end MEASUREMENT
/begin MEASUREMENT dataRxBufDataBoxes1_as[4].startTimeout_u16 "" UWORD CnvRule_NumberOneToOne 1 0 0 65535 ECU_ADDRESS 0x70014D52 /end MEASUREMENT
/begin MEASUREMENT dataRxBufDataBoxes1_as[4].counter_u16 "" UWORD CnvRule_NumberOneToOne 1 0 0 65535 ECU_ADDRESS 0x70014D54 /end MEASUREMENT
/begin MEASUREMENT dataRxBufDataBoxes1_as[4].status_u16 "" UWORD CnvRule_NumberOneToOne 1 0 0 65535 ECU_ADDRESS 0x70014D56 /end MEASUREMENT
/begin MEASUREMENT dataRxBufDataBoxes1_as[4].action_u16 "" UWORD CnvRule_NumberOneToOne 1 0 0 65535 ECU_ADDRESS 0x70014D58 /end MEASUREMENT
/begin MEASUREMENT dataRxBufDataBoxes1_as[4].internalBox_l "" UBYTE CnvRule_NumberOneToOne 1 0 0 1 ECU_ADDRESS 0x70014D5A /end MEASUREMENT
/begin MEASUREMENT dataTxBufDataBoxes2_as[1].data_pau8 "" UBYTE CnvRule_NumberOneToOne 1 0 0 255 ECU_ADDRESS 0x70014D5C /end MEASUREMENT
/begin MEASUREMENT dataTxBufDataBoxes2_as[1].func_pf "" ULONG CnvRule_NumberOneToOne 1 0 0 4294967295 ECU_ADDRESS 0x70014D60 /end MEASUREMENT
/begin MEASUREMENT dataTxBufDataBoxes2_as[1].lenMax_u32 "" ULONG CnvRule_NumberOneToOne 1 0 0 4294967295 ECU_ADDRESS 0x70014D68 /end MEASUREMENT
/begin MEASUREMENT dataTxBufDataBoxes2_as[1].lenAct_u32 "" ULONG CnvRule_NumberOneToOne 1 0 0 4294967295 ECU_ADDRESS 0x70014D6C /end MEASUREMENT
/begin MEASUREMENT dataTxBufDataBoxes2_as[1].cycle_u16 "" UWORD CnvRule_NumberOneToOne 1 0 0 65535 ECU_ADDRESS 0x70014D70 /end MEASUREMENT
/begin MEASUREMENT dataTxBufDataBoxes2_as[1].counter_u16 "" UWORD CnvRule_NumberOneToOne 1 0 0 65535 ECU_ADDRESS 0x70014D72 /end MEASUREMENT
/begin MEASUREMENT dataTxBufDataBoxes2_as[1].status_u16 "" UWORD CnvRule_NumberOneToOne 1 0 0 65535 ECU_ADDRESS 0x70014D74 /end MEASUREMENT
/begin MEASUREMENT dataTxBufDataBoxes2_as[1].aperiodicdatabox_u16 "" UWORD CnvRule_NumberOneToOne 1 0 0 65535 ECU_ADDRESS 0x70014D76 /end MEASUREMENT
/begin MEASUREMENT dataTxBufDataBoxes2_as[1].periodicdatabox_u16 "" UWORD CnvRule_NumberOneToOne 1 0 0 65535 ECU_ADDRESS 0x70014D78 /end MEASUREMENT
/begin MEASUREMENT dataTxBufDataBoxes2_as[2].data_pau8 "" UBYTE CnvRule_NumberOneToOne 1 0 0 255 ECU_ADDRESS 0x70014D7C /end MEASUREMENT
/begin MEASUREMENT dataTxBufDataBoxes2_as[2].func_pf "" ULONG CnvRule_NumberOneToOne 1 0 0 4294967295 ECU_ADDRESS 0x70014D80 /end MEASUREMENT
/begin MEASUREMENT dataTxBufDataBoxes2_as[2].lenMax_u32 "" ULONG CnvRule_NumberOneToOne 1 0 0 4294967295 ECU_ADDRESS 0x70014D88 /end MEASUREMENT
/begin MEASUREMENT dataTxBufDataBoxes2_as[2].lenAct_u32 "" ULONG CnvRule_NumberOneToOne 1 0 0 4294967295 ECU_ADDRESS 0x70014D8C /end MEASUREMENT
/begin MEASUREMENT dataTxBufDataBoxes2_as[2].cycle_u16 "" UWORD CnvRule_NumberOneToOne 1 0 0 65535 ECU_ADDRESS 0x70014D90 /end MEASUREMENT
/begin MEASUREMENT dataTxBufDataBoxes2_as[2].counter_u16 "" UWORD CnvRule_NumberOneToOne 1 0 0 65535 ECU_ADDRESS 0x70014D92 /end MEASUREMENT
/begin MEASUREMENT dataTxBufDataBoxes2_as[2].status_u16 "" UWORD CnvRule_NumberOneToOne 1 0 0 65535 ECU_ADDRESS 0x70014D94 /end MEASUREMENT
/begin MEASUREMENT dataTxBufDataBoxes2_as[2].aperiodicdatabox_u16 "" UWORD CnvRule_NumberOneToOne 1 0 0 65535 ECU_ADDRESS 0x70014D96 /end MEASUREMENT
/begin MEASUREMENT dataTxBufDataBoxes2_as[2].periodicdatabox_u16 "" UWORD CnvRule_NumberOneToOne 1 0 0 65535 ECU_ADDRESS 0x70014D98 /end MEASUREMENT
/begin MEASUREMENT dataTxBufDataBoxes2_as[3].data_pau8 "" UBYTE CnvRule_NumberOneToOne 1 0 0 255 ECU_ADDRESS 0x70014D9C /end MEASUREMENT
/begin MEASUREMENT dataTxBufDataBoxes2_as[3].func_pf "" ULONG CnvRule_NumberOneToOne 1 0 0 4294967295 ECU_ADDRESS 0x70014DA0 /end MEASUREMENT
/begin MEASUREMENT dataTxBufDataBoxes2_as[3].lenMax_u32 "" ULONG CnvRule_NumberOneToOne 1 0 0 4294967295 ECU_ADDRESS 0x70014DA8 /end MEASUREMENT
/begin MEASUREMENT dataTxBufDataBoxes2_as[3].lenAct_u32 "" ULONG CnvRule_NumberOneToOne 1 0 0 4294967295 ECU_ADDRESS 0x70014DAC /end MEASUREMENT
/begin MEASUREMENT dataTxBufDataBoxes2_as[3].cycle_u16 "" UWORD CnvRule_NumberOneToOne 1 0 0 65535 ECU_ADDRESS 0x70014DB0 /end MEASUREMENT
/begin MEASUREMENT dataTxBufDataBoxes2_as[3].counter_u16 "" UWORD CnvRule_NumberOneToOne 1 0 0 65535 ECU_ADDRESS 0x70014DB2 /end MEASUREMENT
/begin MEASUREMENT dataTxBufDataBoxes2_as[3].status_u16 "" UWORD CnvRule_NumberOneToOne 1 0 0 65535 ECU_ADDRESS 0x70014DB4 /end MEASUREMENT
/begin MEASUREMENT dataTxBufDataBoxes2_as[3].aperiodicdatabox_u16 "" UWORD CnvRule_NumberOneToOne 1 0 0 65535 ECU_ADDRESS 0x70014DB6 /end MEASUREMENT
/begin MEASUREMENT dataTxBufDataBoxes2_as[3].periodicdatabox_u16 "" UWORD CnvRule_NumberOneToOne 1 0 0 65535 ECU_ADDRESS 0x70014DB8 /end MEASUREMENT
/begin MEASUREMENT dataTxBufDataBoxes2_as[4].data_pau8 "" UBYTE CnvRule_NumberOneToOne 1 0 0 255 ECU_ADDRESS 0x70014DBC /end MEASUREMENT
/begin MEASUREMENT dataTxBufDataBoxes2_as[4].func_pf "" ULONG CnvRule_NumberOneToOne 1 0 0 4294967295 ECU_ADDRESS 0x70014DC0 /end MEASUREMENT
/begin MEASUREMENT dataTxBufDataBoxes2_as[4].lenMax_u32 "" ULONG CnvRule_NumberOneToOne 1 0 0 4294967295 ECU_ADDRESS 0x70014DC8 /end MEASUREMENT
/begin MEASUREMENT dataTxBufDataBoxes2_as[4].lenAct_u32 "" ULONG CnvRule_NumberOneToOne 1 0 0 4294967295 ECU_ADDRESS 0x70014DCC /end MEASUREMENT
/begin MEASUREMENT dataTxBufDataBoxes2_as[4].cycle_u16 "" UWORD CnvRule_NumberOneToOne 1 0 0 65535 ECU_ADDRESS 0x70014DD0 /end MEASUREMENT
/begin MEASUREMENT dataTxBufDataBoxes2_as[4].counter_u16 "" UWORD CnvRule_NumberOneToOne 1 0 0 65535 ECU_ADDRESS 0x70014DD2 /end MEASUREMENT
/begin MEASUREMENT dataTxBufDataBoxes2_as[4].status_u16 "" UWORD CnvRule_NumberOneToOne 1 0 0 65535 ECU_ADDRESS 0x70014DD4 /end MEASUREMENT
/begin MEASUREMENT dataTxBufDataBoxes2_as[4].aperiodicdatabox_u16 "" UWORD CnvRule_NumberOneToOne 1 0 0 65535 ECU_ADDRESS 0x70014DD6 /end MEASUREMENT
/begin MEASUREMENT dataTxBufDataBoxes2_as[4].periodicdatabox_u16 "" UWORD CnvRule_NumberOneToOne 1 0 0 65535 ECU_ADDRESS 0x70014DD8 /end MEASUREMENT
/begin MEASUREMENT dataRxBufDataBoxes2_as[1].data_pau8 "" UBYTE CnvRule_NumberOneToOne 1 0 0 255 ECU_ADDRESS 0x70014DDC /end MEASUREMENT
/begin MEASUREMENT dataRxBufDataBoxes2_as[1].func_pf "" UBYTE CnvRule_NumberOneToOne 1 0 0 1 ECU_ADDRESS 0x70014DE0 /end MEASUREMENT
/begin MEASUREMENT dataRxBufDataBoxes2_as[1].lenAct_u32 "" ULONG CnvRule_NumberOneToOne 1 0 0 4294967295 ECU_ADDRESS 0x70014DE8 /end MEASUREMENT
/begin MEASUREMENT dataRxBufDataBoxes2_as[1].lenRx_u32 "" ULONG CnvRule_NumberOneToOne 1 0 0 4294967295 ECU_ADDRESS 0x70014DEC /end MEASUREMENT
/begin MEASUREMENT dataRxBufDataBoxes2_as[1].lenMax_u32 "" ULONG CnvRule_NumberOneToOne 1 0 0 4294967295 ECU_ADDRESS 0x70014DF0 /end MEASUREMENT
/begin MEASUREMENT dataRxBufDataBoxes2_as[1].timeout_u16 "" UWORD CnvRule_NumberOneToOne 1 0 0 65535 ECU_ADDRESS 0x70014DF4 /end MEASUREMENT
/begin MEASUREMENT dataRxBufDataBoxes2_as[1].startTimeout_u16 "" UWORD CnvRule_NumberOneToOne 1 0 0 65535 ECU_ADDRESS 0x70014DF6 /end MEASUREMENT
/begin MEASUREMENT dataRxBufDataBoxes2_as[1].counter_u16 "" UWORD CnvRule_NumberOneToOne 1 0 0 65535 ECU_ADDRESS 0x70014DF8 /end MEASUREMENT
/begin MEASUREMENT dataRxBufDataBoxes2_as[1].status_u16 "" UWORD CnvRule_NumberOneToOne 1 0 0 65535 ECU_ADDRESS 0x70014DFA /end MEASUREMENT
/begin MEASUREMENT dataRxBufDataBoxes2_as[1].action_u16 "" UWORD CnvRule_NumberOneToOne 1 0 0 65535 ECU_ADDRESS 0x70014DFC /end MEASUREMENT
/begin MEASUREMENT dataRxBufDataBoxes2_as[1].internalBox_l "" UBYTE CnvRule_NumberOneToOne 1 0 0 1 ECU_ADDRESS 0x70014DFE /end MEASUREMENT
/begin MEASUREMENT dataRxBufDataBoxes2_as[2].data_pau8 "" UBYTE CnvRule_NumberOneToOne 1 0 0 255 ECU_ADDRESS 0x70014E00 /end MEASUREMENT
/begin MEASUREMENT dataRxBufDataBoxes2_as[2].func_pf "" UBYTE CnvRule_NumberOneToOne 1 0 0 1 ECU_ADDRESS 0x70014E04 /end MEASUREMENT
/begin MEASUREMENT dataRxBufDataBoxes2_as[2].lenAct_u32 "" ULONG CnvRule_NumberOneToOne 1 0 0 4294967295 ECU_ADDRESS 0x70014E0C /end MEASUREMENT
/begin MEASUREMENT dataRxBufDataBoxes2_as[2].lenRx_u32 "" ULONG CnvRule_NumberOneToOne 1 0 0 4294967295 ECU_ADDRESS 0x70014E10 /end MEASUREMENT
/begin MEASUREMENT dataRxBufDataBoxes2_as[2].lenMax_u32 "" ULONG CnvRule_NumberOneToOne 1 0 0 4294967295 ECU_ADDRESS 0x70014E14 /end MEASUREMENT
/begin MEASUREMENT dataRxBufDataBoxes2_as[2].timeout_u16 "" UWORD CnvRule_NumberOneToOne 1 0 0 65535 ECU_ADDRESS 0x70014E18 /end MEASUREMENT
/begin MEASUREMENT dataRxBufDataBoxes2_as[2].startTimeout_u16 "" UWORD CnvRule_NumberOneToOne 1 0 0 65535 ECU_ADDRESS 0x70014E1A /end MEASUREMENT
/begin MEASUREMENT dataRxBufDataBoxes2_as[2].counter_u16 "" UWORD CnvRule_NumberOneToOne 1 0 0 65535 ECU_ADDRESS 0x70014E1C /end MEASUREMENT
/begin MEASUREMENT dataRxBufDataBoxes2_as[2].status_u16 "" UWORD CnvRule_NumberOneToOne 1 0 0 65535 ECU_ADDRESS 0x70014E1E /end MEASUREMENT
/begin MEASUREMENT dataRxBufDataBoxes2_as[2].action_u16 "" UWORD CnvRule_NumberOneToOne 1 0 0 65535 ECU_ADDRESS 0x70014E20 /end MEASUREMENT
/begin MEASUREMENT dataRxBufDataBoxes2_as[2].internalBox_l "" UBYTE CnvRule_NumberOneToOne 1 0 0 1 ECU_ADDRESS 0x70014E22 /end MEASUREMENT
/begin MEASUREMENT dataRxBufDataBoxes2_as[3].data_pau8 "" UBYTE CnvRule_NumberOneToOne 1 0 0 255 ECU_ADDRESS 0x70014E24 /end MEASUREMENT
/begin MEASUREMENT dataRxBufDataBoxes2_as[3].func_pf "" UBYTE CnvRule_NumberOneToOne 1 0 0 1 ECU_ADDRESS 0x70014E28 /end MEASUREMENT
/begin MEASUREMENT dataRxBufDataBoxes2_as[3].lenAct_u32 "" ULONG CnvRule_NumberOneToOne 1 0 0 4294967295 ECU_ADDRESS 0x70014E30 /end MEASUREMENT
/begin MEASUREMENT dataRxBufDataBoxes2_as[3].lenRx_u32 "" ULONG CnvRule_NumberOneToOne 1 0 0 4294967295 ECU_ADDRESS 0x70014E34 /end MEASUREMENT
/begin MEASUREMENT dataRxBufDataBoxes2_as[3].lenMax_u32 "" ULONG CnvRule_NumberOneToOne 1 0 0 4294967295 ECU_ADDRESS 0x70014E38 /end MEASUREMENT
/begin MEASUREMENT dataRxBufDataBoxes2_as[3].timeout_u16 "" UWORD CnvRule_NumberOneToOne 1 0 0 65535 ECU_ADDRESS 0x70014E3C /end MEASUREMENT
/begin MEASUREMENT dataRxBufDataBoxes2_as[3].startTimeout_u16 "" UWORD CnvRule_NumberOneToOne 1 0 0 65535 ECU_ADDRESS 0x70014E3E /end MEASUREMENT
/begin MEASUREMENT dataRxBufDataBoxes2_as[3].counter_u16 "" UWORD CnvRule_NumberOneToOne 1 0 0 65535 ECU_ADDRESS 0x70014E40 /end MEASUREMENT
/begin MEASUREMENT dataRxBufDataBoxes2_as[3].status_u16 "" UWORD CnvRule_NumberOneToOne 1 0 0 65535 ECU_ADDRESS 0x70014E42 /end MEASUREMENT
/begin MEASUREMENT dataRxBufDataBoxes2_as[3].action_u16 "" UWORD CnvRule_NumberOneToOne 1 0 0 65535 ECU_ADDRESS 0x70014E44 /end MEASUREMENT
/begin MEASUREMENT dataRxBufDataBoxes2_as[3].internalBox_l "" UBYTE CnvRule_NumberOneToOne 1 0 0 1 ECU_ADDRESS 0x70014E46 /end MEASUREMENT
/begin MEASUREMENT dataRxBufDataBoxes2_as[4].data_pau8 "" UBYTE CnvRule_NumberOneToOne 1 0 0 255 ECU_ADDRESS 0x70014E48 /end MEASUREMENT
/begin MEASUREMENT dataRxBufDataBoxes2_as[4].func_pf "" UBYTE CnvRule_NumberOneToOne 1 0 0 1 ECU_ADDRESS 0x70014E4C /end MEASUREMENT
/begin MEASUREMENT dataRxBufDataBoxes2_as[4].lenAct_u32 "" ULONG CnvRule_NumberOneToOne 1 0 0 4294967295 ECU_ADDRESS 0x70014E54 /end MEASUREMENT
/begin MEASUREMENT dataRxBufDataBoxes2_as[4].lenRx_u32 "" ULONG CnvRule_NumberOneToOne 1 0 0 4294967295 ECU_ADDRESS 0x70014E58 /end MEASUREMENT
/begin MEASUREMENT dataRxBufDataBoxes2_as[4].lenMax_u32 "" ULONG CnvRule_NumberOneToOne 1 0 0 4294967295 ECU_ADDRESS 0x70014E5C /end MEASUREMENT
/begin MEASUREMENT dataRxBufDataBoxes2_as[4].timeout_u16 "" UWORD CnvRule_NumberOneToOne 1 0 0 65535 ECU_ADDRESS 0x70014E60 /end MEASUREMENT
/begin MEASUREMENT dataRxBufDataBoxes2_as[4].startTimeout_u16 "" UWORD CnvRule_NumberOneToOne 1 0 0 65535 ECU_ADDRESS 0x70014E62 /end MEASUREMENT
/begin MEASUREMENT dataRxBufDataBoxes2_as[4].counter_u16 "" UWORD CnvRule_NumberOneToOne 1 0 0 65535 ECU_ADDRESS 0x70014E64 /end MEASUREMENT
/begin MEASUREMENT dataRxBufDataBoxes2_as[4].status_u16 "" UWORD CnvRule_NumberOneToOne 1 0 0 65535 ECU_ADDRESS 0x70014E66 /end MEASUREMENT
/begin MEASUREMENT dataRxBufDataBoxes2_as[4].action_u16 "" UWORD CnvRule_NumberOneToOne 1 0 0 65535 ECU_ADDRESS 0x70014E68 /end MEASUREMENT
/begin MEASUREMENT dataRxBufDataBoxes2_as[4].internalBox_l "" UBYTE CnvRule_NumberOneToOne 1 0 0 1 ECU_ADDRESS 0x70014E6A /end MEASUREMENT
/begin MEASUREMENT dataTxBufDataBoxes3_as[1].data_pau8 "" UBYTE CnvRule_NumberOneToOne 1 0 0 255 ECU_ADDRESS 0x70014E6C /end MEASUREMENT
/begin MEASUREMENT dataTxBufDataBoxes3_as[1].func_pf "" ULONG CnvRule_NumberOneToOne 1 0 0 4294967295 ECU_ADDRESS 0x70014E70 /end MEASUREMENT
/begin MEASUREMENT dataTxBufDataBoxes3_as[1].lenMax_u32 "" ULONG CnvRule_NumberOneToOne 1 0 0 4294967295 ECU_ADDRESS 0x70014E78 /end MEASUREMENT
/begin MEASUREMENT dataTxBufDataBoxes3_as[1].lenAct_u32 "" ULONG CnvRule_NumberOneToOne 1 0 0 4294967295 ECU_ADDRESS 0x70014E7C /end MEASUREMENT
/begin MEASUREMENT dataTxBufDataBoxes3_as[1].cycle_u16 "" UWORD CnvRule_NumberOneToOne 1 0 0 65535 ECU_ADDRESS 0x70014E80 /end MEASUREMENT
/begin MEASUREMENT dataTxBufDataBoxes3_as[1].counter_u16 "" UWORD CnvRule_NumberOneToOne 1 0 0 65535 ECU_ADDRESS 0x70014E82 /end MEASUREMENT
/begin MEASUREMENT dataTxBufDataBoxes3_as[1].status_u16 "" UWORD CnvRule_NumberOneToOne 1 0 0 65535 ECU_ADDRESS 0x70014E84 /end MEASUREMENT
/begin MEASUREMENT dataTxBufDataBoxes3_as[1].aperiodicdatabox_u16 "" UWORD CnvRule_NumberOneToOne 1 0 0 65535 ECU_ADDRESS 0x70014E86 /end MEASUREMENT
/begin MEASUREMENT dataTxBufDataBoxes3_as[1].periodicdatabox_u16 "" UWORD CnvRule_NumberOneToOne 1 0 0 65535 ECU_ADDRESS 0x70014E88 /end MEASUREMENT
/begin MEASUREMENT dataTxBufDataBoxes3_as[2].data_pau8 "" UBYTE CnvRule_NumberOneToOne 1 0 0 255 ECU_ADDRESS 0x70014E8C /end MEASUREMENT
/begin MEASUREMENT dataTxBufDataBoxes3_as[2].func_pf "" ULONG CnvRule_NumberOneToOne 1 0 0 4294967295 ECU_ADDRESS 0x70014E90 /end MEASUREMENT
/begin MEASUREMENT dataTxBufDataBoxes3_as[2].lenMax_u32 "" ULONG CnvRule_NumberOneToOne 1 0 0 4294967295 ECU_ADDRESS 0x70014E98 /end MEASUREMENT
/begin MEASUREMENT dataTxBufDataBoxes3_as[2].lenAct_u32 "" ULONG CnvRule_NumberOneToOne 1 0 0 4294967295 ECU_ADDRESS 0x70014E9C /end MEASUREMENT
/begin MEASUREMENT dataTxBufDataBoxes3_as[2].cycle_u16 "" UWORD CnvRule_NumberOneToOne 1 0 0 65535 ECU_ADDRESS 0x70014EA0 /end MEASUREMENT
/begin MEASUREMENT dataTxBufDataBoxes3_as[2].counter_u16 "" UWORD CnvRule_NumberOneToOne 1 0 0 65535 ECU_ADDRESS 0x70014EA2 /end MEASUREMENT
/begin MEASUREMENT dataTxBufDataBoxes3_as[2].status_u16 "" UWORD CnvRule_NumberOneToOne 1 0 0 65535 ECU_ADDRESS 0x70014EA4 /end MEASUREMENT
/begin MEASUREMENT dataTxBufDataBoxes3_as[2].aperiodicdatabox_u16 "" UWORD CnvRule_NumberOneToOne 1 0 0 65535 ECU_ADDRESS 0x70014EA6 /end MEASUREMENT
/begin MEASUREMENT dataTxBufDataBoxes3_as[2].periodicdatabox_u16 "" UWORD CnvRule_NumberOneToOne 1 0 0 65535 ECU_ADDRESS 0x70014EA8 /end MEASUREMENT
/begin MEASUREMENT dataTxBufDataBoxes3_as[3].data_pau8 "" UBYTE CnvRule_NumberOneToOne 1 0 0 255 ECU_ADDRESS 0x70014EAC /end MEASUREMENT
/begin MEASUREMENT dataTxBufDataBoxes3_as[3].func_pf "" ULONG CnvRule_NumberOneToOne 1 0 0 4294967295 ECU_ADDRESS 0x70014EB0 /end MEASUREMENT
/begin MEASUREMENT dataTxBufDataBoxes3_as[3].lenMax_u32 "" ULONG CnvRule_NumberOneToOne 1 0 0 4294967295 ECU_ADDRESS 0x70014EB8 /end MEASUREMENT
/begin MEASUREMENT dataTxBufDataBoxes3_as[3].lenAct_u32 "" ULONG CnvRule_NumberOneToOne 1 0 0 4294967295 ECU_ADDRESS 0x70014EBC /end MEASUREMENT
/begin MEASUREMENT dataTxBufDataBoxes3_as[3].cycle_u16 "" UWORD CnvRule_NumberOneToOne 1 0 0 65535 ECU_ADDRESS 0x70014EC0 /end MEASUREMENT
/begin MEASUREMENT dataTxBufDataBoxes3_as[3].counter_u16 "" UWORD CnvRule_NumberOneToOne 1 0 0 65535 ECU_ADDRESS 0x70014EC2 /end MEASUREMENT
/begin MEASUREMENT dataTxBufDataBoxes3_as[3].status_u16 "" UWORD CnvRule_NumberOneToOne 1 0 0 65535 ECU_ADDRESS 0x70014EC4 /end MEASUREMENT
/begin MEASUREMENT dataTxBufDataBoxes3_as[3].aperiodicdatabox_u16 "" UWORD CnvRule_NumberOneToOne 1 0 0 65535 ECU_ADDRESS 0x70014EC6 /end MEASUREMENT
/begin MEASUREMENT dataTxBufDataBoxes3_as[3].periodicdatabox_u16 "" UWORD CnvRule_NumberOneToOne 1 0 0 65535 ECU_ADDRESS 0x70014EC8 /end MEASUREMENT
/begin MEASUREMENT dataTxBufDataBoxes3_as[4].data_pau8 "" UBYTE CnvRule_NumberOneToOne 1 0 0 255 ECU_ADDRESS 0x70014ECC /end MEASUREMENT
/begin MEASUREMENT dataTxBufDataBoxes3_as[4].func_pf "" ULONG CnvRule_NumberOneToOne 1 0 0 4294967295 ECU_ADDRESS 0x70014ED0 /end MEASUREMENT
/begin MEASUREMENT dataTxBufDataBoxes3_as[4].lenMax_u32 "" ULONG CnvRule_NumberOneToOne 1 0 0 4294967295 ECU_ADDRESS 0x70014ED8 /end MEASUREMENT
/begin MEASUREMENT dataTxBufDataBoxes3_as[4].lenAct_u32 "" ULONG CnvRule_NumberOneToOne 1 0 0 4294967295 ECU_ADDRESS 0x70014EDC /end MEASUREMENT
/begin MEASUREMENT dataTxBufDataBoxes3_as[4].cycle_u16 "" UWORD CnvRule_NumberOneToOne 1 0 0 65535 ECU_ADDRESS 0x70014EE0 /end MEASUREMENT
/begin MEASUREMENT dataTxBufDataBoxes3_as[4].counter_u16 "" UWORD CnvRule_NumberOneToOne 1 0 0 65535 ECU_ADDRESS 0x70014EE2 /end MEASUREMENT
/begin MEASUREMENT dataTxBufDataBoxes3_as[4].status_u16 "" UWORD CnvRule_NumberOneToOne 1 0 0 65535 ECU_ADDRESS 0x70014EE4 /end MEASUREMENT
/begin MEASUREMENT dataTxBufDataBoxes3_as[4].aperiodicdatabox_u16 "" UWORD CnvRule_NumberOneToOne 1 0 0 65535 ECU_ADDRESS 0x70014EE6 /end MEASUREMENT
/begin MEASUREMENT dataTxBufDataBoxes3_as[4].periodicdatabox_u16 "" UWORD CnvRule_NumberOneToOne 1 0 0 65535 ECU_ADDRESS 0x70014EE8 /end MEASUREMENT
/begin MEASUREMENT dataRxBufDataBoxes3_as[1].data_pau8 "" UBYTE CnvRule_NumberOneToOne 1 0 0 255 ECU_ADDRESS 0x70014EEC /end MEASUREMENT
/begin MEASUREMENT dataRxBufDataBoxes3_as[1].func_pf "" UBYTE CnvRule_NumberOneToOne 1 0 0 1 ECU_ADDRESS 0x70014EF0 /end MEASUREMENT
/begin MEASUREMENT dataRxBufDataBoxes3_as[1].lenAct_u32 "" ULONG CnvRule_NumberOneToOne 1 0 0 4294967295 ECU_ADDRESS 0x70014EF8 /end MEASUREMENT
/begin MEASUREMENT dataRxBufDataBoxes3_as[1].lenRx_u32 "" ULONG CnvRule_NumberOneToOne 1 0 0 4294967295 ECU_ADDRESS 0x70014EFC /end MEASUREMENT
/begin MEASUREMENT dataRxBufDataBoxes3_as[1].lenMax_u32 "" ULONG CnvRule_NumberOneToOne 1 0 0 4294967295 ECU_ADDRESS 0x70014F00 /end MEASUREMENT
/begin MEASUREMENT dataRxBufDataBoxes3_as[1].timeout_u16 "" UWORD CnvRule_NumberOneToOne 1 0 0 65535 ECU_ADDRESS 0x70014F04 /end MEASUREMENT
/begin MEASUREMENT dataRxBufDataBoxes3_as[1].startTimeout_u16 "" UWORD CnvRule_NumberOneToOne 1 0 0 65535 ECU_ADDRESS 0x70014F06 /end MEASUREMENT
/begin MEASUREMENT dataRxBufDataBoxes3_as[1].counter_u16 "" UWORD CnvRule_NumberOneToOne 1 0 0 65535 ECU_ADDRESS 0x70014F08 /end MEASUREMENT
/begin MEASUREMENT dataRxBufDataBoxes3_as[1].status_u16 "" UWORD CnvRule_NumberOneToOne 1 0 0 65535 ECU_ADDRESS 0x70014F0A /end MEASUREMENT
/begin MEASUREMENT dataRxBufDataBoxes3_as[1].action_u16 "" UWORD CnvRule_NumberOneToOne 1 0 0 65535 ECU_ADDRESS 0x70014F0C /end MEASUREMENT
/begin MEASUREMENT dataRxBufDataBoxes3_as[1].internalBox_l "" UBYTE CnvRule_NumberOneToOne 1 0 0 1 ECU_ADDRESS 0x70014F0E /end MEASUREMENT
/begin MEASUREMENT dataRxBufDataBoxes3_as[2].data_pau8 "" UBYTE CnvRule_NumberOneToOne 1 0 0 255 ECU_ADDRESS 0x70014F10 /end MEASUREMENT
/begin MEASUREMENT dataRxBufDataBoxes3_as[2].func_pf "" UBYTE CnvRule_NumberOneToOne 1 0 0 1 ECU_ADDRESS 0x70014F14 /end MEASUREMENT
/begin MEASUREMENT dataRxBufDataBoxes3_as[2].lenAct_u32 "" ULONG CnvRule_NumberOneToOne 1 0 0 4294967295 ECU_ADDRESS 0x70014F1C /end MEASUREMENT
/begin MEASUREMENT dataRxBufDataBoxes3_as[2].lenRx_u32 "" ULONG CnvRule_NumberOneToOne 1 0 0 4294967295 ECU_ADDRESS 0x70014F20 /end MEASUREMENT
/begin MEASUREMENT dataRxBufDataBoxes3_as[2].lenMax_u32 "" ULONG CnvRule_NumberOneToOne 1 0 0 4294967295 ECU_ADDRESS 0x70014F24 /end MEASUREMENT
/begin MEASUREMENT dataRxBufDataBoxes3_as[2].timeout_u16 "" UWORD CnvRule_NumberOneToOne 1 0 0 65535 ECU_ADDRESS 0x70014F28 /end MEASUREMENT
/begin MEASUREMENT dataRxBufDataBoxes3_as[2].startTimeout_u16 "" UWORD CnvRule_NumberOneToOne 1 0 0 65535 ECU_ADDRESS 0x70014F2A /end MEASUREMENT
/begin MEASUREMENT dataRxBufDataBoxes3_as[2].counter_u16 "" UWORD CnvRule_NumberOneToOne 1 0 0 65535 ECU_ADDRESS 0x70014F2C /end MEASUREMENT
/begin MEASUREMENT dataRxBufDataBoxes3_as[2].status_u16 "" UWORD CnvRule_NumberOneToOne 1 0 0 65535 ECU_ADDRESS 0x70014F2E /end MEASUREMENT
/begin MEASUREMENT dataRxBufDataBoxes3_as[2].action_u16 "" UWORD CnvRule_NumberOneToOne 1 0 0 65535 ECU_ADDRESS 0x70014F30 /end MEASUREMENT
/begin MEASUREMENT dataRxBufDataBoxes3_as[2].internalBox_l "" UBYTE CnvRule_NumberOneToOne 1 0 0 1 ECU_ADDRESS 0x70014F32 /end MEASUREMENT
/begin MEASUREMENT dataRxBufDataBoxes3_as[3].data_pau8 "" UBYTE CnvRule_NumberOneToOne 1 0 0 255 ECU_ADDRESS 0x70014F34 /end MEASUREMENT
/begin MEASUREMENT dataRxBufDataBoxes3_as[3].func_pf "" UBYTE CnvRule_NumberOneToOne 1 0 0 1 ECU_ADDRESS 0x70014F38 /end MEASUREMENT
/begin MEASUREMENT dataRxBufDataBoxes3_as[3].lenAct_u32 "" ULONG CnvRule_NumberOneToOne 1 0 0 4294967295 ECU_ADDRESS 0x70014F40 /end MEASUREMENT
/begin MEASUREMENT dataRxBufDataBoxes3_as[3].lenRx_u32 "" ULONG CnvRule_NumberOneToOne 1 0 0 4294967295 ECU_ADDRESS 0x70014F44 /end MEASUREMENT
/begin MEASUREMENT dataRxBufDataBoxes3_as[3].lenMax_u32 "" ULONG CnvRule_NumberOneToOne 1 0 0 4294967295 ECU_ADDRESS 0x70014F48 /end MEASUREMENT
/begin MEASUREMENT dataRxBufDataBoxes3_as[3].timeout_u16 "" UWORD CnvRule_NumberOneToOne 1 0 0 65535 ECU_ADDRESS 0x70014F4C /end MEASUREMENT
/begin MEASUREMENT dataRxBufDataBoxes3_as[3].startTimeout_u16 "" UWORD CnvRule_NumberOneToOne 1 0 0 65535 ECU_ADDRESS 0x70014F4E /end MEASUREMENT
/begin MEASUREMENT dataRxBufDataBoxes3_as[3].counter_u16 "" UWORD CnvRule_NumberOneToOne 1 0 0 65535 ECU_ADDRESS 0x70014F50 /end MEASUREMENT
/begin MEASUREMENT dataRxBufDataBoxes3_as[3].status_u16 "" UWORD CnvRule_NumberOneToOne 1 0 0 65535 ECU_ADDRESS 0x70014F52 /end MEASUREMENT
/begin MEASUREMENT dataRxBufDataBoxes3_as[3].action_u16 "" UWORD CnvRule_NumberOneToOne 1 0 0 65535 ECU_ADDRESS 0x70014F54 /end MEASUREMENT
/begin MEASUREMENT dataRxBufDataBoxes3_as[3].internalBox_l "" UBYTE CnvRule_NumberOneToOne 1 0 0 1 ECU_ADDRESS 0x70014F56 /end MEASUREMENT
/begin MEASUREMENT dataRxBufDataBoxes3_as[4].data_pau8 "" UBYTE CnvRule_NumberOneToOne 1 0 0 255 ECU_ADDRESS 0x70014F58 /end MEASUREMENT
/begin MEASUREMENT dataRxBufDataBoxes3_as[4].func_pf "" UBYTE CnvRule_NumberOneToOne 1 0 0 1 ECU_ADDRESS 0x70014F5C /end MEASUREMENT
/begin MEASUREMENT dataRxBufDataBoxes3_as[4].lenAct_u32 "" ULONG CnvRule_NumberOneToOne 1 0 0 4294967295 ECU_ADDRESS 0x70014F64 /end MEASUREMENT
/begin MEASUREMENT dataRxBufDataBoxes3_as[4].lenRx_u32 "" ULONG CnvRule_NumberOneToOne 1 0 0 4294967295 ECU_ADDRESS 0x70014F68 /end MEASUREMENT
/begin MEASUREMENT dataRxBufDataBoxes3_as[4].lenMax_u32 "" ULONG CnvRule_NumberOneToOne 1 0 0 4294967295 ECU_ADDRESS 0x70014F6C /end MEASUREMENT
/begin MEASUREMENT dataRxBufDataBoxes3_as[4].timeout_u16 "" UWORD CnvRule_NumberOneToOne 1 0 0 65535 ECU_ADDRESS 0x70014F70 /end MEASUREMENT
/begin MEASUREMENT dataRxBufDataBoxes3_as[4].startTimeout_u16 "" UWORD CnvRule_NumberOneToOne 1 0 0 65535 ECU_ADDRESS 0x70014F72 /end MEASUREMENT
/begin MEASUREMENT dataRxBufDataBoxes3_as[4].counter_u16 "" UWORD CnvRule_NumberOneToOne 1 0 0 65535 ECU_ADDRESS 0x70014F74 /end MEASUREMENT
/begin MEASUREMENT dataRxBufDataBoxes3_as[4].status_u16 "" UWORD CnvRule_NumberOneToOne 1 0 0 65535 ECU_ADDRESS 0x70014F76 /end MEASUREMENT
/begin MEASUREMENT dataRxBufDataBoxes3_as[4].action_u16 "" UWORD CnvRule_NumberOneToOne 1 0 0 65535 ECU_ADDRESS 0x70014F78 /end MEASUREMENT
/begin MEASUREMENT dataRxBufDataBoxes3_as[4].internalBox_l "" UBYTE CnvRule_NumberOneToOne 1 0 0 1 ECU_ADDRESS 0x70014F7A /end MEASUREMENT
/begin MEASUREMENT dataJ1939Dm1Failrs_as[1].dtc_as[1].spn_u32 "" ULONG CnvRule_NumberOneToOne 1 0 0 4294967295 ECU_ADDRESS 0x70014F80 /end MEASUREMENT
/begin MEASUREMENT dataJ1939Dm1Failrs_as[1].dtc_as[1].fmi_u8 "" UBYTE CnvRule_NumberOneToOne 1 0 0 255 ECU_ADDRESS 0x70014F84 /end MEASUREMENT
/begin MEASUREMENT dataJ1939Dm1Failrs_as[1].dtc_as[1].occ_u8 "" UBYTE CnvRule_NumberOneToOne 1 0 0 255 ECU_ADDRESS 0x70014F85 /end MEASUREMENT
/begin MEASUREMENT dataJ1939Dm1Failrs_as[1].dtc_as[2].spn_u32 "" ULONG CnvRule_NumberOneToOne 1 0 0 4294967295 ECU_ADDRESS 0x70014F88 /end MEASUREMENT
/begin MEASUREMENT dataJ1939Dm1Failrs_as[1].dtc_as[2].fmi_u8 "" UBYTE CnvRule_NumberOneToOne 1 0 0 255 ECU_ADDRESS 0x70014F8C /end MEASUREMENT
/begin MEASUREMENT dataJ1939Dm1Failrs_as[1].dtc_as[2].occ_u8 "" UBYTE CnvRule_NumberOneToOne 1 0 0 255 ECU_ADDRESS 0x70014F8D /end MEASUREMENT
/begin MEASUREMENT dataJ1939Dm1Failrs_as[1].dtc_as[3].spn_u32 "" ULONG CnvRule_NumberOneToOne 1 0 0 4294967295 ECU_ADDRESS 0x70014F90 /end MEASUREMENT
/begin MEASUREMENT dataJ1939Dm1Failrs_as[1].dtc_as[3].fmi_u8 "" UBYTE CnvRule_NumberOneToOne 1 0 0 255 ECU_ADDRESS 0x70014F94 /end MEASUREMENT
/begin MEASUREMENT dataJ1939Dm1Failrs_as[1].dtc_as[3].occ_u8 "" UBYTE CnvRule_NumberOneToOne 1 0 0 255 ECU_ADDRESS 0x70014F95 /end MEASUREMENT
/begin MEASUREMENT dataJ1939Dm1Failrs_as[1].dtc_as[4].spn_u32 "" ULONG CnvRule_NumberOneToOne 1 0 0 4294967295 ECU_ADDRESS 0x70014F98 /end MEASUREMENT
/begin MEASUREMENT dataJ1939Dm1Failrs_as[1].dtc_as[4].fmi_u8 "" UBYTE CnvRule_NumberOneToOne 1 0 0 255 ECU_ADDRESS 0x70014F9C /end MEASUREMENT
/begin MEASUREMENT dataJ1939Dm1Failrs_as[1].dtc_as[4].occ_u8 "" UBYTE CnvRule_NumberOneToOne 1 0 0 255 ECU_ADDRESS 0x70014F9D /end MEASUREMENT
/begin MEASUREMENT dataJ1939Dm1Failrs_as[1].dtc_as[5].spn_u32 "" ULONG CnvRule_NumberOneToOne 1 0 0 4294967295 ECU_ADDRESS 0x70014FA0 /end MEASUREMENT
/begin MEASUREMENT dataJ1939Dm1Failrs_as[1].dtc_as[5].fmi_u8 "" UBYTE CnvRule_NumberOneToOne 1 0 0 255 ECU_ADDRESS 0x70014FA4 /end MEASUREMENT
/begin MEASUREMENT dataJ1939Dm1Failrs_as[1].dtc_as[5].occ_u8 "" UBYTE CnvRule_NumberOneToOne 1 0 0 255 ECU_ADDRESS 0x70014FA5 /end MEASUREMENT
/begin MEASUREMENT dataJ1939Dm1Failrs_as[1].dtc_as[6].spn_u32 "" ULONG CnvRule_NumberOneToOne 1 0 0 4294967295 ECU_ADDRESS 0x70014FA8 /end MEASUREMENT
/begin MEASUREMENT dataJ1939Dm1Failrs_as[1].dtc_as[6].fmi_u8 "" UBYTE CnvRule_NumberOneToOne 1 0 0 255 ECU_ADDRESS 0x70014FAC /end MEASUREMENT
/begin MEASUREMENT dataJ1939Dm1Failrs_as[1].dtc_as[6].occ_u8 "" UBYTE CnvRule_NumberOneToOne 1 0 0 255 ECU_ADDRESS 0x70014FAD /end MEASUREMENT
/begin MEASUREMENT dataJ1939Dm1Failrs_as[1].dtc_as[7].spn_u32 "" ULONG CnvRule_NumberOneToOne 1 0 0 4294967295 ECU_ADDRESS 0x70014FB0 /end MEASUREMENT
/begin MEASUREMENT dataJ1939Dm1Failrs_as[1].dtc_as[7].fmi_u8 "" UBYTE CnvRule_NumberOneToOne 1 0 0 255 ECU_ADDRESS 0x70014FB4 /end MEASUREMENT
/begin MEASUREMENT dataJ1939Dm1Failrs_as[1].dtc_as[7].occ_u8 "" UBYTE CnvRule_NumberOneToOne 1 0 0 255 ECU_ADDRESS 0x70014FB5 /end MEASUREMENT
/begin MEASUREMENT dataJ1939Dm1Failrs_as[1].dtc_as[8].spn_u32 "" ULONG CnvRule_NumberOneToOne 1 0 0 4294967295 ECU_ADDRESS 0x70014FB8 /end MEASUREMENT
/begin MEASUREMENT dataJ1939Dm1Failrs_as[1].dtc_as[8].fmi_u8 "" UBYTE CnvRule_NumberOneToOne 1 0 0 255 ECU_ADDRESS 0x70014FBC /end MEASUREMENT
/begin MEASUREMENT dataJ1939Dm1Failrs_as[1].dtc_as[8].occ_u8 "" UBYTE CnvRule_NumberOneToOne 1 0 0 255 ECU_ADDRESS 0x70014FBD /end MEASUREMENT
/begin MEASUREMENT dataJ1939Dm1Failrs_as[1].dtc_as[9].spn_u32 "" ULONG CnvRule_NumberOneToOne 1 0 0 4294967295 ECU_ADDRESS 0x70014FC0 /end MEASUREMENT
/begin MEASUREMENT dataJ1939Dm1Failrs_as[1].dtc_as[9].fmi_u8 "" UBYTE CnvRule_NumberOneToOne 1 0 0 255 ECU_ADDRESS 0x70014FC4 /end MEASUREMENT
/begin MEASUREMENT dataJ1939Dm1Failrs_as[1].dtc_as[9].occ_u8 "" UBYTE CnvRule_NumberOneToOne 1 0 0 255 ECU_ADDRESS 0x70014FC5 /end MEASUREMENT
/begin MEASUREMENT dataJ1939Dm1Failrs_as[1].dtc_as[10].spn_u32 "" ULONG CnvRule_NumberOneToOne 1 0 0 4294967295 ECU_ADDRESS 0x70014FC8 /end MEASUREMENT
/begin MEASUREMENT dataJ1939Dm1Failrs_as[1].dtc_as[10].fmi_u8 "" UBYTE CnvRule_NumberOneToOne 1 0 0 255 ECU_ADDRESS 0x70014FCC /end MEASUREMENT
/begin MEASUREMENT dataJ1939Dm1Failrs_as[1].dtc_as[10].occ_u8 "" UBYTE CnvRule_NumberOneToOne 1 0 0 255 ECU_ADDRESS 0x70014FCD /end MEASUREMENT
/begin MEASUREMENT dataJ1939Dm1Failrs_as[1].dtc_as[11].spn_u32 "" ULONG CnvRule_NumberOneToOne 1 0 0 4294967295 ECU_ADDRESS 0x70014FD0 /end MEASUREMENT
/begin MEASUREMENT dataJ1939Dm1Failrs_as[1].dtc_as[11].fmi_u8 "" UBYTE CnvRule_NumberOneToOne 1 0 0 255 ECU_ADDRESS 0x70014FD4 /end MEASUREMENT
/begin MEASUREMENT dataJ1939Dm1Failrs_as[1].dtc_as[11].occ_u8 "" UBYTE CnvRule_NumberOneToOne 1 0 0 255 ECU_ADDRESS 0x70014FD5 /end MEASUREMENT
/begin MEASUREMENT dataJ1939Dm1Failrs_as[1].dtc_as[12].spn_u32 "" ULONG CnvRule_NumberOneToOne 1 0 0 4294967295 ECU_ADDRESS 0x70014FD8 /end MEASUREMENT
/begin MEASUREMENT dataJ1939Dm1Failrs_as[1].dtc_as[12].fmi_u8 "" UBYTE CnvRule_NumberOneToOne 1 0 0 255 ECU_ADDRESS 0x70014FDC /end MEASUREMENT
/begin MEASUREMENT dataJ1939Dm1Failrs_as[1].dtc_as[12].occ_u8 "" UBYTE CnvRule_NumberOneToOne 1 0 0 255 ECU_ADDRESS 0x70014FDD /end MEASUREMENT
/begin MEASUREMENT dataJ1939Dm1Failrs_as[1].dtc_as[13].spn_u32 "" ULONG CnvRule_NumberOneToOne 1 0 0 4294967295 ECU_ADDRESS 0x70014FE0 /end MEASUREMENT
/begin MEASUREMENT dataJ1939Dm1Failrs_as[1].dtc_as[13].fmi_u8 "" UBYTE CnvRule_NumberOneToOne 1 0 0 255 ECU_ADDRESS 0x70014FE4 /end MEASUREMENT
/begin MEASUREMENT dataJ1939Dm1Failrs_as[1].dtc_as[13].occ_u8 "" UBYTE CnvRule_NumberOneToOne 1 0 0 255 ECU_ADDRESS 0x70014FE5 /end MEASUREMENT
/begin MEASUREMENT dataJ1939Dm1Failrs_as[1].dtc_as[14].spn_u32 "" ULONG CnvRule_NumberOneToOne 1 0 0 4294967295 ECU_ADDRESS 0x70014FE8 /end MEASUREMENT
/begin MEASUREMENT dataJ1939Dm1Failrs_as[1].dtc_as[14].fmi_u8 "" UBYTE CnvRule_NumberOneToOne 1 0 0 255 ECU_ADDRESS 0x70014FEC /end MEASUREMENT
/begin MEASUREMENT dataJ1939Dm1Failrs_as[1].dtc_as[14].occ_u8 "" UBYTE CnvRule_NumberOneToOne 1 0 0 255 ECU_ADDRESS 0x70014FED /end MEASUREMENT
/begin MEASUREMENT dataJ1939Dm1Failrs_as[1].dtc_as[15].spn_u32 "" ULONG CnvRule_NumberOneToOne 1 0 0 4294967295 ECU_ADDRESS 0x70014FF0 /end MEASUREMENT
/begin MEASUREMENT dataJ1939Dm1Failrs_as[1].dtc_as[15].fmi_u8 "" UBYTE CnvRule_NumberOneToOne 1 0 0 255 ECU_ADDRESS 0x70014FF4 /end MEASUREMENT
/begin MEASUREMENT dataJ1939Dm1Failrs_as[1].dtc_as[15].occ_u8 "" UBYTE CnvRule_NumberOneToOne 1 0 0 255 ECU_ADDRESS 0x70014FF5 /end MEASUREMENT
/begin MEASUREMENT dataJ1939Dm1Failrs_as[1].dtc_as[16].spn_u32 "" ULONG CnvRule_NumberOneToOne 1 0 0 4294967295 ECU_ADDRESS 0x70014FF8 /end MEASUREMENT
/begin MEASUREMENT dataJ1939Dm1Failrs_as[1].dtc_as[16].fmi_u8 "" UBYTE CnvRule_NumberOneToOne 1 0 0 255 ECU_ADDRESS 0x70014FFC /end MEASUREMENT
/begin MEASUREMENT dataJ1939Dm1Failrs_as[1].dtc_as[16].occ_u8 "" UBYTE CnvRule_NumberOneToOne 1 0 0 255 ECU_ADDRESS 0x70014FFD /end MEASUREMENT
/begin MEASUREMENT dataJ1939Dm1Failrs_as[1].dtc_as[17].spn_u32 "" ULONG CnvRule_NumberOneToOne 1 0 0 4294967295 ECU_ADDRESS 0x70015000 /end MEASUREMENT
/begin MEASUREMENT dataJ1939Dm1Failrs_as[1].dtc_as[17].fmi_u8 "" UBYTE CnvRule_NumberOneToOne 1 0 0 255 ECU_ADDRESS 0x70015004 /end MEASUREMENT
/begin MEASUREMENT dataJ1939Dm1Failrs_as[1].dtc_as[17].occ_u8 "" UBYTE CnvRule_NumberOneToOne 1 0 0 255 ECU_ADDRESS 0x70015005 /end MEASUREMENT
/begin MEASUREMENT dataJ1939Dm1Failrs_as[1].dtc_as[18].spn_u32 "" ULONG CnvRule_NumberOneToOne 1 0 0 4294967295 ECU_ADDRESS 0x70015008 /end MEASUREMENT
/begin MEASUREMENT dataJ1939Dm1Failrs_as[1].dtc_as[18].fmi_u8 "" UBYTE CnvRule_NumberOneToOne 1 0 0 255 ECU_ADDRESS 0x7001500C /end MEASUREMENT
/begin MEASUREMENT dataJ1939Dm1Failrs_as[1].dtc_as[18].occ_u8 "" UBYTE CnvRule_NumberOneToOne 1 0 0 255 ECU_ADDRESS 0x7001500D /end MEASUREMENT
/begin MEASUREMENT dataJ1939Dm1Failrs_as[1].dtc_as[19].spn_u32 "" ULONG CnvRule_NumberOneToOne 1 0 0 4294967295 ECU_ADDRESS 0x70015010 /end MEASUREMENT
/begin MEASUREMENT dataJ1939Dm1Failrs_as[1].dtc_as[19].fmi_u8 "" UBYTE CnvRule_NumberOneToOne 1 0 0 255 ECU_ADDRESS 0x70015014 /end MEASUREMENT
/begin MEASUREMENT dataJ1939Dm1Failrs_as[1].dtc_as[19].occ_u8 "" UBYTE CnvRule_NumberOneToOne 1 0 0 255 ECU_ADDRESS 0x70015015 /end MEASUREMENT
/begin MEASUREMENT dataJ1939Dm1Failrs_as[1].dtc_as[20].spn_u32 "" ULONG CnvRule_NumberOneToOne 1 0 0 4294967295 ECU_ADDRESS 0x70015018 /end MEASUREMENT
/begin MEASUREMENT dataJ1939Dm1Failrs_as[1].dtc_as[20].fmi_u8 "" UBYTE CnvRule_NumberOneToOne 1 0 0 255 ECU_ADDRESS 0x7001501C /end MEASUREMENT
/begin MEASUREMENT dataJ1939Dm1Failrs_as[1].dtc_as[20].occ_u8 "" UBYTE CnvRule_NumberOneToOne 1 0 0 255 ECU_ADDRESS 0x7001501D /end MEASUREMENT
/begin MEASUREMENT dataJ1939Dm1Failrs_as[1].dtc_as "" UBYTE CnvRule_NumberOneToOne 1 0 0 255 ECU_ADDRESS 0x70014F80 ARRAY_SIZE 160 /end MEASUREMENT
/begin MEASUREMENT dataJ1939Dm1Failrs_as[2].dtc_as[1].spn_u32 "" ULONG CnvRule_NumberOneToOne 1 0 0 4294967295 ECU_ADDRESS 0x70015024 /end MEASUREMENT
/begin MEASUREMENT dataJ1939Dm1Failrs_as[2].dtc_as[1].fmi_u8 "" UBYTE CnvRule_NumberOneToOne 1 0 0 255 ECU_ADDRESS 0x70015028 /end MEASUREMENT
/begin MEASUREMENT dataJ1939Dm1Failrs_as[2].dtc_as[1].occ_u8 "" UBYTE CnvRule_NumberOneToOne 1 0 0 255 ECU_ADDRESS 0x70015029 /end MEASUREMENT
/begin MEASUREMENT dataJ1939Dm1Failrs_as[2].dtc_as[2].spn_u32 "" ULONG CnvRule_NumberOneToOne 1 0 0 4294967295 ECU_ADDRESS 0x7001502C /end MEASUREMENT
/begin MEASUREMENT dataJ1939Dm1Failrs_as[2].dtc_as[2].fmi_u8 "" UBYTE CnvRule_NumberOneToOne 1 0 0 255 ECU_ADDRESS 0x70015030 /end MEASUREMENT
/begin MEASUREMENT dataJ1939Dm1Failrs_as[2].dtc_as[2].occ_u8 "" UBYTE CnvRule_NumberOneToOne 1 0 0 255 ECU_ADDRESS 0x70015031 /end MEASUREMENT
/begin MEASUREMENT dataJ1939Dm1Failrs_as[2].dtc_as[3].spn_u32 "" ULONG CnvRule_NumberOneToOne 1 0 0 4294967295 ECU_ADDRESS 0x70015034 /end MEASUREMENT
/begin MEASUREMENT dataJ1939Dm1Failrs_as[2].dtc_as[3].fmi_u8 "" UBYTE CnvRule_NumberOneToOne 1 0 0 255 ECU_ADDRESS 0x70015038 /end MEASUREMENT
/begin MEASUREMENT dataJ1939Dm1Failrs_as[2].dtc_as[3].occ_u8 "" UBYTE CnvRule_NumberOneToOne 1 0 0 255 ECU_ADDRESS 0x70015039 /end MEASUREMENT
/begin MEASUREMENT dataJ1939Dm1Failrs_as[2].dtc_as[4].spn_u32 "" ULONG CnvRule_NumberOneToOne 1 0 0 4294967295 ECU_ADDRESS 0x7001503C /end MEASUREMENT
/begin MEASUREMENT dataJ1939Dm1Failrs_as[2].dtc_as[4].fmi_u8 "" UBYTE CnvRule_NumberOneToOne 1 0 0 255 ECU_ADDRESS 0x70015040 /end MEASUREMENT
/begin MEASUREMENT dataJ1939Dm1Failrs_as[2].dtc_as[4].occ_u8 "" UBYTE CnvRule_NumberOneToOne 1 0 0 255 ECU_ADDRESS 0x70015041 /end MEASUREMENT
/begin MEASUREMENT dataJ1939Dm1Failrs_as[2].dtc_as[5].spn_u32 "" ULONG CnvRule_NumberOneToOne 1 0 0 4294967295 ECU_ADDRESS 0x70015044 /end MEASUREMENT
/begin MEASUREMENT dataJ1939Dm1Failrs_as[2].dtc_as[5].fmi_u8 "" UBYTE CnvRule_NumberOneToOne 1 0 0 255 ECU_ADDRESS 0x70015048 /end MEASUREMENT
/begin MEASUREMENT dataJ1939Dm1Failrs_as[2].dtc_as[5].occ_u8 "" UBYTE CnvRule_NumberOneToOne 1 0 0 255 ECU_ADDRESS 0x70015049 /end MEASUREMENT
/begin MEASUREMENT dataJ1939Dm1Failrs_as[2].dtc_as[6].spn_u32 "" ULONG CnvRule_NumberOneToOne 1 0 0 4294967295 ECU_ADDRESS 0x7001504C /end MEASUREMENT
/begin MEASUREMENT dataJ1939Dm1Failrs_as[2].dtc_as[6].fmi_u8 "" UBYTE CnvRule_NumberOneToOne 1 0 0 255 ECU_ADDRESS 0x70015050 /end MEASUREMENT
/begin MEASUREMENT dataJ1939Dm1Failrs_as[2].dtc_as[6].occ_u8 "" UBYTE CnvRule_NumberOneToOne 1 0 0 255 ECU_ADDRESS 0x70015051 /end MEASUREMENT
/begin MEASUREMENT dataJ1939Dm1Failrs_as[2].dtc_as[7].spn_u32 "" ULONG CnvRule_NumberOneToOne 1 0 0 4294967295 ECU_ADDRESS 0x70015054 /end MEASUREMENT
/begin MEASUREMENT dataJ1939Dm1Failrs_as[2].dtc_as[7].fmi_u8 "" UBYTE CnvRule_NumberOneToOne 1 0 0 255 ECU_ADDRESS 0x70015058 /end MEASUREMENT
/begin MEASUREMENT dataJ1939Dm1Failrs_as[2].dtc_as[7].occ_u8 "" UBYTE CnvRule_NumberOneToOne 1 0 0 255 ECU_ADDRESS 0x70015059 /end MEASUREMENT
/begin MEASUREMENT dataJ1939Dm1Failrs_as[2].dtc_as[8].spn_u32 "" ULONG CnvRule_NumberOneToOne 1 0 0 4294967295 ECU_ADDRESS 0x7001505C /end MEASUREMENT
/begin MEASUREMENT dataJ1939Dm1Failrs_as[2].dtc_as[8].fmi_u8 "" UBYTE CnvRule_NumberOneToOne 1 0 0 255 ECU_ADDRESS 0x70015060 /end MEASUREMENT
/begin MEASUREMENT dataJ1939Dm1Failrs_as[2].dtc_as[8].occ_u8 "" UBYTE CnvRule_NumberOneToOne 1 0 0 255 ECU_ADDRESS 0x70015061 /end MEASUREMENT
/begin MEASUREMENT dataJ1939Dm1Failrs_as[2].dtc_as[9].spn_u32 "" ULONG CnvRule_NumberOneToOne 1 0 0 4294967295 ECU_ADDRESS 0x70015064 /end MEASUREMENT
/begin MEASUREMENT dataJ1939Dm1Failrs_as[2].dtc_as[9].fmi_u8 "" UBYTE CnvRule_NumberOneToOne 1 0 0 255 ECU_ADDRESS 0x70015068 /end MEASUREMENT
/begin MEASUREMENT dataJ1939Dm1Failrs_as[2].dtc_as[9].occ_u8 "" UBYTE CnvRule_NumberOneToOne 1 0 0 255 ECU_ADDRESS 0x70015069 /end MEASUREMENT
/begin MEASUREMENT dataJ1939Dm1Failrs_as[2].dtc_as[10].spn_u32 "" ULONG CnvRule_NumberOneToOne 1 0 0 4294967295 ECU_ADDRESS 0x7001506C /end MEASUREMENT
/begin MEASUREMENT dataJ1939Dm1Failrs_as[2].dtc_as[10].fmi_u8 "" UBYTE CnvRule_NumberOneToOne 1 0 0 255 ECU_ADDRESS 0x70015070 /end MEASUREMENT
/begin MEASUREMENT dataJ1939Dm1Failrs_as[2].dtc_as[10].occ_u8 "" UBYTE CnvRule_NumberOneToOne 1 0 0 255 ECU_ADDRESS 0x70015071 /end MEASUREMENT
/begin MEASUREMENT dataJ1939Dm1Failrs_as[2].dtc_as[11].spn_u32 "" ULONG CnvRule_NumberOneToOne 1 0 0 4294967295 ECU_ADDRESS 0x70015074 /end MEASUREMENT
/begin MEASUREMENT dataJ1939Dm1Failrs_as[2].dtc_as[11].fmi_u8 "" UBYTE CnvRule_NumberOneToOne 1 0 0 255 ECU_ADDRESS 0x70015078 /end MEASUREMENT
/begin MEASUREMENT dataJ1939Dm1Failrs_as[2].dtc_as[11].occ_u8 "" UBYTE CnvRule_NumberOneToOne 1 0 0 255 ECU_ADDRESS 0x70015079 /end MEASUREMENT
/begin MEASUREMENT dataJ1939Dm1Failrs_as[2].dtc_as[12].spn_u32 "" ULONG CnvRule_NumberOneToOne 1 0 0 4294967295 ECU_ADDRESS 0x7001507C /end MEASUREMENT
/begin MEASUREMENT dataJ1939Dm1Failrs_as[2].dtc_as[12].fmi_u8 "" UBYTE CnvRule_NumberOneToOne 1 0 0 255 ECU_ADDRESS 0x70015080 /end MEASUREMENT
/begin MEASUREMENT dataJ1939Dm1Failrs_as[2].dtc_as[12].occ_u8 "" UBYTE CnvRule_NumberOneToOne 1 0 0 255 ECU_ADDRESS 0x70015081 /end MEASUREMENT
/begin MEASUREMENT dataJ1939Dm1Failrs_as[2].dtc_as[13].spn_u32 "" ULONG CnvRule_NumberOneToOne 1 0 0 4294967295 ECU_ADDRESS 0x70015084 /end MEASUREMENT
/begin MEASUREMENT dataJ1939Dm1Failrs_as[2].dtc_as[13].fmi_u8 "" UBYTE CnvRule_NumberOneToOne 1 0 0 255 ECU_ADDRESS 0x70015088 /end MEASUREMENT
/begin MEASUREMENT dataJ1939Dm1Failrs_as[2].dtc_as[13].occ_u8 "" UBYTE CnvRule_NumberOneToOne 1 0 0 255 ECU_ADDRESS 0x70015089 /end MEASUREMENT
/begin MEASUREMENT dataJ1939Dm1Failrs_as[2].dtc_as[14].spn_u32 "" ULONG CnvRule_NumberOneToOne 1 0 0 4294967295 ECU_ADDRESS 0x7001508C /end MEASUREMENT
/begin MEASUREMENT dataJ1939Dm1Failrs_as[2].dtc_as[14].fmi_u8 "" UBYTE CnvRule_NumberOneToOne 1 0 0 255 ECU_ADDRESS 0x70015090 /end MEASUREMENT
/begin MEASUREMENT dataJ1939Dm1Failrs_as[2].dtc_as[14].occ_u8 "" UBYTE CnvRule_NumberOneToOne 1 0 0 255 ECU_ADDRESS 0x70015091 /end MEASUREMENT
/begin MEASUREMENT dataJ1939Dm1Failrs_as[2].dtc_as[15].spn_u32 "" ULONG CnvRule_NumberOneToOne 1 0 0 4294967295 ECU_ADDRESS 0x70015094 /end MEASUREMENT
/begin MEASUREMENT dataJ1939Dm1Failrs_as[2].dtc_as[15].fmi_u8 "" UBYTE CnvRule_NumberOneToOne 1 0 0 255 ECU_ADDRESS 0x70015098 /end MEASUREMENT
/begin MEASUREMENT dataJ1939Dm1Failrs_as[2].dtc_as[15].occ_u8 "" UBYTE CnvRule_NumberOneToOne 1 0 0 255 ECU_ADDRESS 0x70015099 /end MEASUREMENT
/begin MEASUREMENT dataJ1939Dm1Failrs_as[2].dtc_as[16].spn_u32 "" ULONG CnvRule_NumberOneToOne 1 0 0 4294967295 ECU_ADDRESS 0x7001509C /end MEASUREMENT
/begin MEASUREMENT dataJ1939Dm1Failrs_as[2].dtc_as[16].fmi_u8 "" UBYTE CnvRule_NumberOneToOne 1 0 0 255 ECU_ADDRESS 0x700150A0 /end MEASUREMENT
/begin MEASUREMENT dataJ1939Dm1Failrs_as[2].dtc_as[16].occ_u8 "" UBYTE CnvRule_NumberOneToOne 1 0 0 255 ECU_ADDRESS 0x700150A1 /end MEASUREMENT
/begin MEASUREMENT dataJ1939Dm1Failrs_as[2].dtc_as[17].spn_u32 "" ULONG CnvRule_NumberOneToOne 1 0 0 4294967295 ECU_ADDRESS 0x700150A4 /end MEASUREMENT
/begin MEASUREMENT dataJ1939Dm1Failrs_as[2].dtc_as[17].fmi_u8 "" UBYTE CnvRule_NumberOneToOne 1 0 0 255 ECU_ADDRESS 0x700150A8 /end MEASUREMENT
/begin MEASUREMENT dataJ1939Dm1Failrs_as[2].dtc_as[17].occ_u8 "" UBYTE CnvRule_NumberOneToOne 1 0 0 255 ECU_ADDRESS 0x700150A9 /end MEASUREMENT
/begin MEASUREMENT dataJ1939Dm1Failrs_as[2].dtc_as[18].spn_u32 "" ULONG CnvRule_NumberOneToOne 1 0 0 4294967295 ECU_ADDRESS 0x700150AC /end MEASUREMENT
/begin MEASUREMENT dataJ1939Dm1Failrs_as[2].dtc_as[18].fmi_u8 "" UBYTE CnvRule_NumberOneToOne 1 0 0 255 ECU_ADDRESS 0x700150B0 /end MEASUREMENT
/begin MEASUREMENT dataJ1939Dm1Failrs_as[2].dtc_as[18].occ_u8 "" UBYTE CnvRule_NumberOneToOne 1 0 0 255 ECU_ADDRESS 0x700150B1 /end MEASUREMENT
/begin MEASUREMENT dataJ1939Dm1Failrs_as[2].dtc_as[19].spn_u32 "" ULONG CnvRule_NumberOneToOne 1 0 0 4294967295 ECU_ADDRESS 0x700150B4 /end MEASUREMENT
/begin MEASUREMENT dataJ1939Dm1Failrs_as[2].dtc_as[19].fmi_u8 "" UBYTE CnvRule_NumberOneToOne 1 0 0 255 ECU_ADDRESS 0x700150B8 /end MEASUREMENT
/begin MEASUREMENT dataJ1939Dm1Failrs_as[2].dtc_as[19].occ_u8 "" UBYTE CnvRule_NumberOneToOne 1 0 0 255 ECU_ADDRESS 0x700150B9 /end MEASUREMENT
/begin MEASUREMENT dataJ1939Dm1Failrs_as[2].dtc_as[20].spn_u32 "" ULONG CnvRule_NumberOneToOne 1 0 0 4294967295 ECU_ADDRESS 0x700150BC /end MEASUREMENT
/begin MEASUREMENT dataJ1939Dm1Failrs_as[2].dtc_as[20].fmi_u8 "" UBYTE CnvRule_NumberOneToOne 1 0 0 255 ECU_ADDRESS 0x700150C0 /end MEASUREMENT
/begin MEASUREMENT dataJ1939Dm1Failrs_as[2].dtc_as[20].occ_u8 "" UBYTE CnvRule_NumberOneToOne 1 0 0 255 ECU_ADDRESS 0x700150C1 /end MEASUREMENT
/begin MEASUREMENT dataJ1939Dm1Failrs_as[2].dtc_as "" UBYTE CnvRule_NumberOneToOne 1 0 0 255 ECU_ADDRESS 0x70015024 ARRAY_SIZE 160 /end MEASUREMENT
/begin MEASUREMENT dataJ1939Dm1Failrs_as[3].dtc_as[1].spn_u32 "" ULONG CnvRule_NumberOneToOne 1 0 0 4294967295 ECU_ADDRESS 0x700150C8 /end MEASUREMENT
/begin MEASUREMENT dataJ1939Dm1Failrs_as[3].dtc_as[1].fmi_u8 "" UBYTE CnvRule_NumberOneToOne 1 0 0 255 ECU_ADDRESS 0x700150CC /end MEASUREMENT
/begin MEASUREMENT dataJ1939Dm1Failrs_as[3].dtc_as[1].occ_u8 "" UBYTE CnvRule_NumberOneToOne 1 0 0 255 ECU_ADDRESS 0x700150CD /end MEASUREMENT
/begin MEASUREMENT dataJ1939Dm1Failrs_as[3].dtc_as[2].spn_u32 "" ULONG CnvRule_NumberOneToOne 1 0 0 4294967295 ECU_ADDRESS 0x700150D0 /end MEASUREMENT
/begin MEASUREMENT dataJ1939Dm1Failrs_as[3].dtc_as[2].fmi_u8 "" UBYTE CnvRule_NumberOneToOne 1 0 0 255 ECU_ADDRESS 0x700150D4 /end MEASUREMENT
/begin MEASUREMENT dataJ1939Dm1Failrs_as[3].dtc_as[2].occ_u8 "" UBYTE CnvRule_NumberOneToOne 1 0 0 255 ECU_ADDRESS 0x700150D5 /end MEASUREMENT
/begin MEASUREMENT dataJ1939Dm1Failrs_as[3].dtc_as[3].spn_u32 "" ULONG CnvRule_NumberOneToOne 1 0 0 4294967295 ECU_ADDRESS 0x700150D8 /end MEASUREMENT
/begin MEASUREMENT dataJ1939Dm1Failrs_as[3].dtc_as[3].fmi_u8 "" UBYTE CnvRule_NumberOneToOne 1 0 0 255 ECU_ADDRESS 0x700150DC /end MEASUREMENT
/begin MEASUREMENT dataJ1939Dm1Failrs_as[3].dtc_as[3].occ_u8 "" UBYTE CnvRule_NumberOneToOne 1 0 0 255 ECU_ADDRESS 0x700150DD /end MEASUREMENT
/begin MEASUREMENT dataJ1939Dm1Failrs_as[3].dtc_as[4].spn_u32 "" ULONG CnvRule_NumberOneToOne 1 0 0 4294967295 ECU_ADDRESS 0x700150E0 /end MEASUREMENT
/begin MEASUREMENT dataJ1939Dm1Failrs_as[3].dtc_as[4].fmi_u8 "" UBYTE CnvRule_NumberOneToOne 1 0 0 255 ECU_ADDRESS 0x700150E4 /end MEASUREMENT
/begin MEASUREMENT dataJ1939Dm1Failrs_as[3].dtc_as[4].occ_u8 "" UBYTE CnvRule_NumberOneToOne 1 0 0 255 ECU_ADDRESS 0x700150E5 /end MEASUREMENT
/begin MEASUREMENT dataJ1939Dm1Failrs_as[3].dtc_as[5].spn_u32 "" ULONG CnvRule_NumberOneToOne 1 0 0 4294967295 ECU_ADDRESS 0x700150E8 /end MEASUREMENT
/begin MEASUREMENT dataJ1939Dm1Failrs_as[3].dtc_as[5].fmi_u8 "" UBYTE CnvRule_NumberOneToOne 1 0 0 255 ECU_ADDRESS 0x700150EC /end MEASUREMENT
/begin MEASUREMENT dataJ1939Dm1Failrs_as[3].dtc_as[5].occ_u8 "" UBYTE CnvRule_NumberOneToOne 1 0 0 255 ECU_ADDRESS 0x700150ED /end MEASUREMENT
/begin MEASUREMENT dataJ1939Dm1Failrs_as[3].dtc_as[6].spn_u32 "" ULONG CnvRule_NumberOneToOne 1 0 0 4294967295 ECU_ADDRESS 0x700150F0 /end MEASUREMENT
/begin MEASUREMENT dataJ1939Dm1Failrs_as[3].dtc_as[6].fmi_u8 "" UBYTE CnvRule_NumberOneToOne 1 0 0 255 ECU_ADDRESS 0x700150F4 /end MEASUREMENT
/begin MEASUREMENT dataJ1939Dm1Failrs_as[3].dtc_as[6].occ_u8 "" UBYTE CnvRule_NumberOneToOne 1 0 0 255 ECU_ADDRESS 0x700150F5 /end MEASUREMENT
/begin MEASUREMENT dataJ1939Dm1Failrs_as[3].dtc_as[7].spn_u32 "" ULONG CnvRule_NumberOneToOne 1 0 0 4294967295 ECU_ADDRESS 0x700150F8 /end MEASUREMENT
/begin MEASUREMENT dataJ1939Dm1Failrs_as[3].dtc_as[7].fmi_u8 "" UBYTE CnvRule_NumberOneToOne 1 0 0 255 ECU_ADDRESS 0x700150FC /end MEASUREMENT
/begin MEASUREMENT dataJ1939Dm1Failrs_as[3].dtc_as[7].occ_u8 "" UBYTE CnvRule_NumberOneToOne 1 0 0 255 ECU_ADDRESS 0x700150FD /end MEASUREMENT
/begin MEASUREMENT dataJ1939Dm1Failrs_as[3].dtc_as[8].spn_u32 "" ULONG CnvRule_NumberOneToOne 1 0 0 4294967295 ECU_ADDRESS 0x70015100 /end MEASUREMENT
/begin MEASUREMENT dataJ1939Dm1Failrs_as[3].dtc_as[8].fmi_u8 "" UBYTE CnvRule_NumberOneToOne 1 0 0 255 ECU_ADDRESS 0x70015104 /end MEASUREMENT
/begin MEASUREMENT dataJ1939Dm1Failrs_as[3].dtc_as[8].occ_u8 "" UBYTE CnvRule_NumberOneToOne 1 0 0 255 ECU_ADDRESS 0x70015105 /end MEASUREMENT
/begin MEASUREMENT dataJ1939Dm1Failrs_as[3].dtc_as[9].spn_u32 "" ULONG CnvRule_NumberOneToOne 1 0 0 4294967295 ECU_ADDRESS 0x70015108 /end MEASUREMENT
/begin MEASUREMENT dataJ1939Dm1Failrs_as[3].dtc_as[9].fmi_u8 "" UBYTE CnvRule_NumberOneToOne 1 0 0 255 ECU_ADDRESS 0x7001510C /end MEASUREMENT
/begin MEASUREMENT dataJ1939Dm1Failrs_as[3].dtc_as[9].occ_u8 "" UBYTE CnvRule_NumberOneToOne 1 0 0 255 ECU_ADDRESS 0x7001510D /end MEASUREMENT
/begin MEASUREMENT dataJ1939Dm1Failrs_as[3].dtc_as[10].spn_u32 "" ULONG CnvRule_NumberOneToOne 1 0 0 4294967295 ECU_ADDRESS 0x70015110 /end MEASUREMENT
/begin MEASUREMENT dataJ1939Dm1Failrs_as[3].dtc_as[10].fmi_u8 "" UBYTE CnvRule_NumberOneToOne 1 0 0 255 ECU_ADDRESS 0x70015114 /end MEASUREMENT
/begin MEASUREMENT dataJ1939Dm1Failrs_as[3].dtc_as[10].occ_u8 "" UBYTE CnvRule_NumberOneToOne 1 0 0 255 ECU_ADDRESS 0x70015115 /end MEASUREMENT
/begin MEASUREMENT dataJ1939Dm1Failrs_as[3].dtc_as[11].spn_u32 "" ULONG CnvRule_NumberOneToOne 1 0 0 4294967295 ECU_ADDRESS 0x70015118 /end MEASUREMENT
/begin MEASUREMENT dataJ1939Dm1Failrs_as[3].dtc_as[11].fmi_u8 "" UBYTE CnvRule_NumberOneToOne 1 0 0 255 ECU_ADDRESS 0x7001511C /end MEASUREMENT
/begin MEASUREMENT dataJ1939Dm1Failrs_as[3].dtc_as[11].occ_u8 "" UBYTE CnvRule_NumberOneToOne 1 0 0 255 ECU_ADDRESS 0x7001511D /end MEASUREMENT
/begin MEASUREMENT dataJ1939Dm1Failrs_as[3].dtc_as[12].spn_u32 "" ULONG CnvRule_NumberOneToOne 1 0 0 4294967295 ECU_ADDRESS 0x70015120 /end MEASUREMENT
/begin MEASUREMENT dataJ1939Dm1Failrs_as[3].dtc_as[12].fmi_u8 "" UBYTE CnvRule_NumberOneToOne 1 0 0 255 ECU_ADDRESS 0x70015124 /end MEASUREMENT
/begin MEASUREMENT dataJ1939Dm1Failrs_as[3].dtc_as[12].occ_u8 "" UBYTE CnvRule_NumberOneToOne 1 0 0 255 ECU_ADDRESS 0x70015125 /end MEASUREMENT
/begin MEASUREMENT dataJ1939Dm1Failrs_as[3].dtc_as[13].spn_u32 "" ULONG CnvRule_NumberOneToOne 1 0 0 4294967295 ECU_ADDRESS 0x70015128 /end MEASUREMENT
/begin MEASUREMENT dataJ1939Dm1Failrs_as[3].dtc_as[13].fmi_u8 "" UBYTE CnvRule_NumberOneToOne 1 0 0 255 ECU_ADDRESS 0x7001512C /end MEASUREMENT
/begin MEASUREMENT dataJ1939Dm1Failrs_as[3].dtc_as[13].occ_u8 "" UBYTE CnvRule_NumberOneToOne 1 0 0 255 ECU_ADDRESS 0x7001512D /end MEASUREMENT
/begin MEASUREMENT dataJ1939Dm1Failrs_as[3].dtc_as[14].spn_u32 "" ULONG CnvRule_NumberOneToOne 1 0 0 4294967295 ECU_ADDRESS 0x70015130 /end MEASUREMENT
/begin MEASUREMENT dataJ1939Dm1Failrs_as[3].dtc_as[14].fmi_u8 "" UBYTE CnvRule_NumberOneToOne 1 0 0 255 ECU_ADDRESS 0x70015134 /end MEASUREMENT
/begin MEASUREMENT dataJ1939Dm1Failrs_as[3].dtc_as[14].occ_u8 "" UBYTE CnvRule_NumberOneToOne 1 0 0 255 ECU_ADDRESS 0x70015135 /end MEASUREMENT
/begin MEASUREMENT dataJ1939Dm1Failrs_as[3].dtc_as[15].spn_u32 "" ULONG CnvRule_NumberOneToOne 1 0 0 4294967295 ECU_ADDRESS 0x70015138 /end MEASUREMENT
/begin MEASUREMENT dataJ1939Dm1Failrs_as[3].dtc_as[15].fmi_u8 "" UBYTE CnvRule_NumberOneToOne 1 0 0 255 ECU_ADDRESS 0x7001513C /end MEASUREMENT
/begin MEASUREMENT dataJ1939Dm1Failrs_as[3].dtc_as[15].occ_u8 "" UBYTE CnvRule_NumberOneToOne 1 0 0 255 ECU_ADDRESS 0x7001513D /end MEASUREMENT
/begin MEASUREMENT dataJ1939Dm1Failrs_as[3].dtc_as[16].spn_u32 "" ULONG CnvRule_NumberOneToOne 1 0 0 4294967295 ECU_ADDRESS 0x70015140 /end MEASUREMENT
/begin MEASUREMENT dataJ1939Dm1Failrs_as[3].dtc_as[16].fmi_u8 "" UBYTE CnvRule_NumberOneToOne 1 0 0 255 ECU_ADDRESS 0x70015144 /end MEASUREMENT
/begin MEASUREMENT dataJ1939Dm1Failrs_as[3].dtc_as[16].occ_u8 "" UBYTE CnvRule_NumberOneToOne 1 0 0 255 ECU_ADDRESS 0x70015145 /end MEASUREMENT
/begin MEASUREMENT dataJ1939Dm1Failrs_as[3].dtc_as[17].spn_u32 "" ULONG CnvRule_NumberOneToOne 1 0 0 4294967295 ECU_ADDRESS 0x70015148 /end MEASUREMENT
/begin MEASUREMENT dataJ1939Dm1Failrs_as[3].dtc_as[17].fmi_u8 "" UBYTE CnvRule_NumberOneToOne 1 0 0 255 ECU_ADDRESS 0x7001514C /end MEASUREMENT
/begin MEASUREMENT dataJ1939Dm1Failrs_as[3].dtc_as[17].occ_u8 "" UBYTE CnvRule_NumberOneToOne 1 0 0 255 ECU_ADDRESS 0x7001514D /end MEASUREMENT
/begin MEASUREMENT dataJ1939Dm1Failrs_as[3].dtc_as[18].spn_u32 "" ULONG CnvRule_NumberOneToOne 1 0 0 4294967295 ECU_ADDRESS 0x70015150 /end MEASUREMENT
/begin MEASUREMENT dataJ1939Dm1Failrs_as[3].dtc_as[18].fmi_u8 "" UBYTE CnvRule_NumberOneToOne 1 0 0 255 ECU_ADDRESS 0x70015154 /end MEASUREMENT
/begin MEASUREMENT dataJ1939Dm1Failrs_as[3].dtc_as[18].occ_u8 "" UBYTE CnvRule_NumberOneToOne 1 0 0 255 ECU_ADDRESS 0x70015155 /end MEASUREMENT
/begin MEASUREMENT dataJ1939Dm1Failrs_as[3].dtc_as[19].spn_u32 "" ULONG CnvRule_NumberOneToOne 1 0 0 4294967295 ECU_ADDRESS 0x70015158 /end MEASUREMENT
/begin MEASUREMENT dataJ1939Dm1Failrs_as[3].dtc_as[19].fmi_u8 "" UBYTE CnvRule_NumberOneToOne 1 0 0 255 ECU_ADDRESS 0x7001515C /end MEASUREMENT
/begin MEASUREMENT dataJ1939Dm1Failrs_as[3].dtc_as[19].occ_u8 "" UBYTE CnvRule_NumberOneToOne 1 0 0 255 ECU_ADDRESS 0x7001515D /end MEASUREMENT
/begin MEASUREMENT dataJ1939Dm1Failrs_as[3].dtc_as[20].spn_u32 "" ULONG CnvRule_NumberOneToOne 1 0 0 4294967295 ECU_ADDRESS 0x70015160 /end MEASUREMENT
/begin MEASUREMENT dataJ1939Dm1Failrs_as[3].dtc_as[20].fmi_u8 "" UBYTE CnvRule_NumberOneToOne 1 0 0 255 ECU_ADDRESS 0x70015164 /end MEASUREMENT
/begin MEASUREMENT dataJ1939Dm1Failrs_as[3].dtc_as[20].occ_u8 "" UBYTE CnvRule_NumberOneToOne 1 0 0 255 ECU_ADDRESS 0x70015165 /end MEASUREMENT
/begin MEASUREMENT dataJ1939Dm1Failrs_as[3].dtc_as "" UBYTE CnvRule_NumberOneToOne 1 0 0 255 ECU_ADDRESS 0x700150C8 ARRAY_SIZE 160 /end MEASUREMENT
/begin MEASUREMENT dataJ1939Dm1Failrs_as[4].dtc_as[1].spn_u32 "" ULONG CnvRule_NumberOneToOne 1 0 0 4294967295 ECU_ADDRESS 0x7001516C /end MEASUREMENT
/begin MEASUREMENT dataJ1939Dm1Failrs_as[4].dtc_as[1].fmi_u8 "" UBYTE CnvRule_NumberOneToOne 1 0 0 255 ECU_ADDRESS 0x70015170 /end MEASUREMENT
/begin MEASUREMENT dataJ1939Dm1Failrs_as[4].dtc_as[1].occ_u8 "" UBYTE CnvRule_NumberOneToOne 1 0 0 255 ECU_ADDRESS 0x70015171 /end MEASUREMENT
/begin MEASUREMENT dataJ1939Dm1Failrs_as[4].dtc_as[2].spn_u32 "" ULONG CnvRule_NumberOneToOne 1 0 0 4294967295 ECU_ADDRESS 0x70015174 /end MEASUREMENT
/begin MEASUREMENT dataJ1939Dm1Failrs_as[4].dtc_as[2].fmi_u8 "" UBYTE CnvRule_NumberOneToOne 1 0 0 255 ECU_ADDRESS 0x70015178 /end MEASUREMENT
/begin MEASUREMENT dataJ1939Dm1Failrs_as[4].dtc_as[2].occ_u8 "" UBYTE CnvRule_NumberOneToOne 1 0 0 255 ECU_ADDRESS 0x70015179 /end MEASUREMENT
/begin MEASUREMENT dataJ1939Dm1Failrs_as[4].dtc_as[3].spn_u32 "" ULONG CnvRule_NumberOneToOne 1 0 0 4294967295 ECU_ADDRESS 0x7001517C /end MEASUREMENT
/begin MEASUREMENT dataJ1939Dm1Failrs_as[4].dtc_as[3].fmi_u8 "" UBYTE CnvRule_NumberOneToOne 1 0 0 255 ECU_ADDRESS 0x70015180 /end MEASUREMENT
/begin MEASUREMENT dataJ1939Dm1Failrs_as[4].dtc_as[3].occ_u8 "" UBYTE CnvRule_NumberOneToOne 1 0 0 255 ECU_ADDRESS 0x70015181 /end MEASUREMENT
/begin MEASUREMENT dataJ1939Dm1Failrs_as[4].dtc_as[4].spn_u32 "" ULONG CnvRule_NumberOneToOne 1 0 0 4294967295 ECU_ADDRESS 0x70015184 /end MEASUREMENT
/begin MEASUREMENT dataJ1939Dm1Failrs_as[4].dtc_as[4].fmi_u8 "" UBYTE CnvRule_NumberOneToOne 1 0 0 255 ECU_ADDRESS 0x70015188 /end MEASUREMENT
/begin MEASUREMENT dataJ1939Dm1Failrs_as[4].dtc_as[4].occ_u8 "" UBYTE CnvRule_NumberOneToOne 1 0 0 255 ECU_ADDRESS 0x70015189 /end MEASUREMENT
/begin MEASUREMENT dataJ1939Dm1Failrs_as[4].dtc_as[5].spn_u32 "" ULONG CnvRule_NumberOneToOne 1 0 0 4294967295 ECU_ADDRESS 0x7001518C /end MEASUREMENT
/begin MEASUREMENT dataJ1939Dm1Failrs_as[4].dtc_as[5].fmi_u8 "" UBYTE CnvRule_NumberOneToOne 1 0 0 255 ECU_ADDRESS 0x70015190 /end MEASUREMENT
/begin MEASUREMENT dataJ1939Dm1Failrs_as[4].dtc_as[5].occ_u8 "" UBYTE CnvRule_NumberOneToOne 1 0 0 255 ECU_ADDRESS 0x70015191 /end MEASUREMENT
/begin MEASUREMENT dataJ1939Dm1Failrs_as[4].dtc_as[6].spn_u32 "" ULONG CnvRule_NumberOneToOne 1 0 0 4294967295 ECU_ADDRESS 0x70015194 /end MEASUREMENT
/begin MEASUREMENT dataJ1939Dm1Failrs_as[4].dtc_as[6].fmi_u8 "" UBYTE CnvRule_NumberOneToOne 1 0 0 255 ECU_ADDRESS 0x70015198 /end MEASUREMENT
/begin MEASUREMENT dataJ1939Dm1Failrs_as[4].dtc_as[6].occ_u8 "" UBYTE CnvRule_NumberOneToOne 1 0 0 255 ECU_ADDRESS 0x70015199 /end MEASUREMENT
/begin MEASUREMENT dataJ1939Dm1Failrs_as[4].dtc_as[7].spn_u32 "" ULONG CnvRule_NumberOneToOne 1 0 0 4294967295 ECU_ADDRESS 0x7001519C /end MEASUREMENT
/begin MEASUREMENT dataJ1939Dm1Failrs_as[4].dtc_as[7].fmi_u8 "" UBYTE CnvRule_NumberOneToOne 1 0 0 255 ECU_ADDRESS 0x700151A0 /end MEASUREMENT
/begin MEASUREMENT dataJ1939Dm1Failrs_as[4].dtc_as[7].occ_u8 "" UBYTE CnvRule_NumberOneToOne 1 0 0 255 ECU_ADDRESS 0x700151A1 /end MEASUREMENT
/begin MEASUREMENT dataJ1939Dm1Failrs_as[4].dtc_as[8].spn_u32 "" ULONG CnvRule_NumberOneToOne 1 0 0 4294967295 ECU_ADDRESS 0x700151A4 /end MEASUREMENT
/begin MEASUREMENT dataJ1939Dm1Failrs_as[4].dtc_as[8].fmi_u8 "" UBYTE CnvRule_NumberOneToOne 1 0 0 255 ECU_ADDRESS 0x700151A8 /end MEASUREMENT
/begin MEASUREMENT dataJ1939Dm1Failrs_as[4].dtc_as[8].occ_u8 "" UBYTE CnvRule_NumberOneToOne 1 0 0 255 ECU_ADDRESS 0x700151A9 /end MEASUREMENT
/begin MEASUREMENT dataJ1939Dm1Failrs_as[4].dtc_as[9].spn_u32 "" ULONG CnvRule_NumberOneToOne 1 0 0 4294967295 ECU_ADDRESS 0x700151AC /end MEASUREMENT
/begin MEASUREMENT dataJ1939Dm1Failrs_as[4].dtc_as[9].fmi_u8 "" UBYTE CnvRule_NumberOneToOne 1 0 0 255 ECU_ADDRESS 0x700151B0 /end MEASUREMENT
/begin MEASUREMENT dataJ1939Dm1Failrs_as[4].dtc_as[9].occ_u8 "" UBYTE CnvRule_NumberOneToOne 1 0 0 255 ECU_ADDRESS 0x700151B1 /end MEASUREMENT
/begin MEASUREMENT dataJ1939Dm1Failrs_as[4].dtc_as[10].spn_u32 "" ULONG CnvRule_NumberOneToOne 1 0 0 4294967295 ECU_ADDRESS 0x700151B4 /end MEASUREMENT
/begin MEASUREMENT dataJ1939Dm1Failrs_as[4].dtc_as[10].fmi_u8 "" UBYTE CnvRule_NumberOneToOne 1 0 0 255 ECU_ADDRESS 0x700151B8 /end MEASUREMENT
/begin MEASUREMENT dataJ1939Dm1Failrs_as[4].dtc_as[10].occ_u8 "" UBYTE CnvRule_NumberOneToOne 1 0 0 255 ECU_ADDRESS 0x700151B9 /end MEASUREMENT
/begin MEASUREMENT dataJ1939Dm1Failrs_as[4].dtc_as[11].spn_u32 "" ULONG CnvRule_NumberOneToOne 1 0 0 4294967295 ECU_ADDRESS 0x700151BC /end MEASUREMENT
/begin MEASUREMENT dataJ1939Dm1Failrs_as[4].dtc_as[11].fmi_u8 "" UBYTE CnvRule_NumberOneToOne 1 0 0 255 ECU_ADDRESS 0x700151C0 /end MEASUREMENT
/begin MEASUREMENT dataJ1939Dm1Failrs_as[4].dtc_as[11].occ_u8 "" UBYTE CnvRule_NumberOneToOne 1 0 0 255 ECU_ADDRESS 0x700151C1 /end MEASUREMENT
/begin MEASUREMENT dataJ1939Dm1Failrs_as[4].dtc_as[12].spn_u32 "" ULONG CnvRule_NumberOneToOne 1 0 0 4294967295 ECU_ADDRESS 0x700151C4 /end MEASUREMENT
/begin MEASUREMENT dataJ1939Dm1Failrs_as[4].dtc_as[12].fmi_u8 "" UBYTE CnvRule_NumberOneToOne 1 0 0 255 ECU_ADDRESS 0x700151C8 /end MEASUREMENT
/begin MEASUREMENT dataJ1939Dm1Failrs_as[4].dtc_as[12].occ_u8 "" UBYTE CnvRule_NumberOneToOne 1 0 0 255 ECU_ADDRESS 0x700151C9 /end MEASUREMENT
/begin MEASUREMENT dataJ1939Dm1Failrs_as[4].dtc_as[13].spn_u32 "" ULONG CnvRule_NumberOneToOne 1 0 0 4294967295 ECU_ADDRESS 0x700151CC /end MEASUREMENT
/begin MEASUREMENT dataJ1939Dm1Failrs_as[4].dtc_as[13].fmi_u8 "" UBYTE CnvRule_NumberOneToOne 1 0 0 255 ECU_ADDRESS 0x700151D0 /end MEASUREMENT
/begin MEASUREMENT dataJ1939Dm1Failrs_as[4].dtc_as[13].occ_u8 "" UBYTE CnvRule_NumberOneToOne 1 0 0 255 ECU_ADDRESS 0x700151D1 /end MEASUREMENT
/begin MEASUREMENT dataJ1939Dm1Failrs_as[4].dtc_as[14].spn_u32 "" ULONG CnvRule_NumberOneToOne 1 0 0 4294967295 ECU_ADDRESS 0x700151D4 /end MEASUREMENT
/begin MEASUREMENT dataJ1939Dm1Failrs_as[4].dtc_as[14].fmi_u8 "" UBYTE CnvRule_NumberOneToOne 1 0 0 255 ECU_ADDRESS 0x700151D8 /end MEASUREMENT
/begin MEASUREMENT dataJ1939Dm1Failrs_as[4].dtc_as[14].occ_u8 "" UBYTE CnvRule_NumberOneToOne 1 0 0 255 ECU_ADDRESS 0x700151D9 /end MEASUREMENT
/begin MEASUREMENT dataJ1939Dm1Failrs_as[4].dtc_as[15].spn_u32 "" ULONG CnvRule_NumberOneToOne 1 0 0 4294967295 ECU_ADDRESS 0x700151DC /end MEASUREMENT
/begin MEASUREMENT dataJ1939Dm1Failrs_as[4].dtc_as[15].fmi_u8 "" UBYTE CnvRule_NumberOneToOne 1 0 0 255 ECU_ADDRESS 0x700151E0 /end MEASUREMENT
/begin MEASUREMENT dataJ1939Dm1Failrs_as[4].dtc_as[15].occ_u8 "" UBYTE CnvRule_NumberOneToOne 1 0 0 255 ECU_ADDRESS 0x700151E1 /end MEASUREMENT
/begin MEASUREMENT dataJ1939Dm1Failrs_as[4].dtc_as[16].spn_u32 "" ULONG CnvRule_NumberOneToOne 1 0 0 4294967295 ECU_ADDRESS 0x700151E4 /end MEASUREMENT
/begin MEASUREMENT dataJ1939Dm1Failrs_as[4].dtc_as[16].fmi_u8 "" UBYTE CnvRule_NumberOneToOne 1 0 0 255 ECU_ADDRESS 0x700151E8 /end MEASUREMENT
/begin MEASUREMENT dataJ1939Dm1Failrs_as[4].dtc_as[16].occ_u8 "" UBYTE CnvRule_NumberOneToOne 1 0 0 255 ECU_ADDRESS 0x700151E9 /end MEASUREMENT
/begin MEASUREMENT dataJ1939Dm1Failrs_as[4].dtc_as[17].spn_u32 "" ULONG CnvRule_NumberOneToOne 1 0 0 4294967295 ECU_ADDRESS 0x700151EC /end MEASUREMENT
/begin MEASUREMENT dataJ1939Dm1Failrs_as[4].dtc_as[17].fmi_u8 "" UBYTE CnvRule_NumberOneToOne 1 0 0 255 ECU_ADDRESS 0x700151F0 /end MEASUREMENT
/begin MEASUREMENT dataJ1939Dm1Failrs_as[4].dtc_as[17].occ_u8 "" UBYTE CnvRule_NumberOneToOne 1 0 0 255 ECU_ADDRESS 0x700151F1 /end MEASUREMENT
/begin MEASUREMENT dataJ1939Dm1Failrs_as[4].dtc_as[18].spn_u32 "" ULONG CnvRule_NumberOneToOne 1 0 0 4294967295 ECU_ADDRESS 0x700151F4 /end MEASUREMENT
/begin MEASUREMENT dataJ1939Dm1Failrs_as[4].dtc_as[18].fmi_u8 "" UBYTE CnvRule_NumberOneToOne 1 0 0 255 ECU_ADDRESS 0x700151F8 /end MEASUREMENT
/begin MEASUREMENT dataJ1939Dm1Failrs_as[4].dtc_as[18].occ_u8 "" UBYTE CnvRule_NumberOneToOne 1 0 0 255 ECU_ADDRESS 0x700151F9 /end MEASUREMENT
/begin MEASUREMENT dataJ1939Dm1Failrs_as[4].dtc_as[19].spn_u32 "" ULONG CnvRule_NumberOneToOne 1 0 0 4294967295 ECU_ADDRESS 0x700151FC /end MEASUREMENT
/begin MEASUREMENT dataJ1939Dm1Failrs_as[4].dtc_as[19].fmi_u8 "" UBYTE CnvRule_NumberOneToOne 1 0 0 255 ECU_ADDRESS 0x70015200 /end MEASUREMENT
/begin MEASUREMENT dataJ1939Dm1Failrs_as[4].dtc_as[19].occ_u8 "" UBYTE CnvRule_NumberOneToOne 1 0 0 255 ECU_ADDRESS 0x70015201 /end MEASUREMENT
/begin MEASUREMENT dataJ1939Dm1Failrs_as[4].dtc_as[20].spn_u32 "" ULONG CnvRule_NumberOneToOne 1 0 0 4294967295 ECU_ADDRESS 0x70015204 /end MEASUREMENT
/begin MEASUREMENT dataJ1939Dm1Failrs_as[4].dtc_as[20].fmi_u8 "" UBYTE CnvRule_NumberOneToOne 1 0 0 255 ECU_ADDRESS 0x70015208 /end MEASUREMENT
/begin MEASUREMENT dataJ1939Dm1Failrs_as[4].dtc_as[20].occ_u8 "" UBYTE CnvRule_NumberOneToOne 1 0 0 255 ECU_ADDRESS 0x70015209 /end MEASUREMENT
/begin MEASUREMENT dataJ1939Dm1Failrs_as[4].dtc_as "" UBYTE CnvRule_NumberOneToOne 1 0 0 255 ECU_ADDRESS 0x7001516C ARRAY_SIZE 160 /end MEASUREMENT
/begin MEASUREMENT dataJ1939Dm1Failrs_as[5].dtc_as[1].spn_u32 "" ULONG CnvRule_NumberOneToOne 1 0 0 4294967295 ECU_ADDRESS 0x70015210 /end MEASUREMENT
/begin MEASUREMENT dataJ1939Dm1Failrs_as[5].dtc_as[1].fmi_u8 "" UBYTE CnvRule_NumberOneToOne 1 0 0 255 ECU_ADDRESS 0x70015214 /end MEASUREMENT
/begin MEASUREMENT dataJ1939Dm1Failrs_as[5].dtc_as[1].occ_u8 "" UBYTE CnvRule_NumberOneToOne 1 0 0 255 ECU_ADDRESS 0x70015215 /end MEASUREMENT
/begin MEASUREMENT dataJ1939Dm1Failrs_as[5].dtc_as[2].spn_u32 "" ULONG CnvRule_NumberOneToOne 1 0 0 4294967295 ECU_ADDRESS 0x70015218 /end MEASUREMENT
/begin MEASUREMENT dataJ1939Dm1Failrs_as[5].dtc_as[2].fmi_u8 "" UBYTE CnvRule_NumberOneToOne 1 0 0 255 ECU_ADDRESS 0x7001521C /end MEASUREMENT
/begin MEASUREMENT dataJ1939Dm1Failrs_as[5].dtc_as[2].occ_u8 "" UBYTE CnvRule_NumberOneToOne 1 0 0 255 ECU_ADDRESS 0x7001521D /end MEASUREMENT
/begin MEASUREMENT dataJ1939Dm1Failrs_as[5].dtc_as[3].spn_u32 "" ULONG CnvRule_NumberOneToOne 1 0 0 4294967295 ECU_ADDRESS 0x70015220 /end MEASUREMENT
/begin MEASUREMENT dataJ1939Dm1Failrs_as[5].dtc_as[3].fmi_u8 "" UBYTE CnvRule_NumberOneToOne 1 0 0 255 ECU_ADDRESS 0x70015224 /end MEASUREMENT
/begin MEASUREMENT dataJ1939Dm1Failrs_as[5].dtc_as[3].occ_u8 "" UBYTE CnvRule_NumberOneToOne 1 0 0 255 ECU_ADDRESS 0x70015225 /end MEASUREMENT
/begin MEASUREMENT dataJ1939Dm1Failrs_as[5].dtc_as[4].spn_u32 "" ULONG CnvRule_NumberOneToOne 1 0 0 4294967295 ECU_ADDRESS 0x70015228 /end MEASUREMENT
/begin MEASUREMENT dataJ1939Dm1Failrs_as[5].dtc_as[4].fmi_u8 "" UBYTE CnvRule_NumberOneToOne 1 0 0 255 ECU_ADDRESS 0x7001522C /end MEASUREMENT
/begin MEASUREMENT dataJ1939Dm1Failrs_as[5].dtc_as[4].occ_u8 "" UBYTE CnvRule_NumberOneToOne 1 0 0 255 ECU_ADDRESS 0x7001522D /end MEASUREMENT
/begin MEASUREMENT dataJ1939Dm1Failrs_as[5].dtc_as[5].spn_u32 "" ULONG CnvRule_NumberOneToOne 1 0 0 4294967295 ECU_ADDRESS 0x70015230 /end MEASUREMENT
/begin MEASUREMENT dataJ1939Dm1Failrs_as[5].dtc_as[5].fmi_u8 "" UBYTE CnvRule_NumberOneToOne 1 0 0 255 ECU_ADDRESS 0x70015234 /end MEASUREMENT
/begin MEASUREMENT dataJ1939Dm1Failrs_as[5].dtc_as[5].occ_u8 "" UBYTE CnvRule_NumberOneToOne 1 0 0 255 ECU_ADDRESS 0x70015235 /end MEASUREMENT
/begin MEASUREMENT dataJ1939Dm1Failrs_as[5].dtc_as[6].spn_u32 "" ULONG CnvRule_NumberOneToOne 1 0 0 4294967295 ECU_ADDRESS 0x70015238 /end MEASUREMENT
/begin MEASUREMENT dataJ1939Dm1Failrs_as[5].dtc_as[6].fmi_u8 "" UBYTE CnvRule_NumberOneToOne 1 0 0 255 ECU_ADDRESS 0x7001523C /end MEASUREMENT
/begin MEASUREMENT dataJ1939Dm1Failrs_as[5].dtc_as[6].occ_u8 "" UBYTE CnvRule_NumberOneToOne 1 0 0 255 ECU_ADDRESS 0x7001523D /end MEASUREMENT
/begin MEASUREMENT dataJ1939Dm1Failrs_as[5].dtc_as[7].spn_u32 "" ULONG CnvRule_NumberOneToOne 1 0 0 4294967295 ECU_ADDRESS 0x70015240 /end MEASUREMENT
/begin MEASUREMENT dataJ1939Dm1Failrs_as[5].dtc_as[7].fmi_u8 "" UBYTE CnvRule_NumberOneToOne 1 0 0 255 ECU_ADDRESS 0x70015244 /end MEASUREMENT
/begin MEASUREMENT dataJ1939Dm1Failrs_as[5].dtc_as[7].occ_u8 "" UBYTE CnvRule_NumberOneToOne 1 0 0 255 ECU_ADDRESS 0x70015245 /end MEASUREMENT
/begin MEASUREMENT dataJ1939Dm1Failrs_as[5].dtc_as[8].spn_u32 "" ULONG CnvRule_NumberOneToOne 1 0 0 4294967295 ECU_ADDRESS 0x70015248 /end MEASUREMENT
/begin MEASUREMENT dataJ1939Dm1Failrs_as[5].dtc_as[8].fmi_u8 "" UBYTE CnvRule_NumberOneToOne 1 0 0 255 ECU_ADDRESS 0x7001524C /end MEASUREMENT
/begin MEASUREMENT dataJ1939Dm1Failrs_as[5].dtc_as[8].occ_u8 "" UBYTE CnvRule_NumberOneToOne 1 0 0 255 ECU_ADDRESS 0x7001524D /end MEASUREMENT
/begin MEASUREMENT dataJ1939Dm1Failrs_as[5].dtc_as[9].spn_u32 "" ULONG CnvRule_NumberOneToOne 1 0 0 4294967295 ECU_ADDRESS 0x70015250 /end MEASUREMENT
/begin MEASUREMENT dataJ1939Dm1Failrs_as[5].dtc_as[9].fmi_u8 "" UBYTE CnvRule_NumberOneToOne 1 0 0 255 ECU_ADDRESS 0x70015254 /end MEASUREMENT
/begin MEASUREMENT dataJ1939Dm1Failrs_as[5].dtc_as[9].occ_u8 "" UBYTE CnvRule_NumberOneToOne 1 0 0 255 ECU_ADDRESS 0x70015255 /end MEASUREMENT
/begin MEASUREMENT dataJ1939Dm1Failrs_as[5].dtc_as[10].spn_u32 "" ULONG CnvRule_NumberOneToOne 1 0 0 4294967295 ECU_ADDRESS 0x70015258 /end MEASUREMENT
/begin MEASUREMENT dataJ1939Dm1Failrs_as[5].dtc_as[10].fmi_u8 "" UBYTE CnvRule_NumberOneToOne 1 0 0 255 ECU_ADDRESS 0x7001525C /end MEASUREMENT
/begin MEASUREMENT dataJ1939Dm1Failrs_as[5].dtc_as[10].occ_u8 "" UBYTE CnvRule_NumberOneToOne 1 0 0 255 ECU_ADDRESS 0x7001525D /end MEASUREMENT
/begin MEASUREMENT dataJ1939Dm1Failrs_as[5].dtc_as[11].spn_u32 "" ULONG CnvRule_NumberOneToOne 1 0 0 4294967295 ECU_ADDRESS 0x70015260 /end MEASUREMENT
/begin MEASUREMENT dataJ1939Dm1Failrs_as[5].dtc_as[11].fmi_u8 "" UBYTE CnvRule_NumberOneToOne 1 0 0 255 ECU_ADDRESS 0x70015264 /end MEASUREMENT
/begin MEASUREMENT dataJ1939Dm1Failrs_as[5].dtc_as[11].occ_u8 "" UBYTE CnvRule_NumberOneToOne 1 0 0 255 ECU_ADDRESS 0x70015265 /end MEASUREMENT
/begin MEASUREMENT dataJ1939Dm1Failrs_as[5].dtc_as[12].spn_u32 "" ULONG CnvRule_NumberOneToOne 1 0 0 4294967295 ECU_ADDRESS 0x70015268 /end MEASUREMENT
/begin MEASUREMENT dataJ1939Dm1Failrs_as[5].dtc_as[12].fmi_u8 "" UBYTE CnvRule_NumberOneToOne 1 0 0 255 ECU_ADDRESS 0x7001526C /end MEASUREMENT
/begin MEASUREMENT dataJ1939Dm1Failrs_as[5].dtc_as[12].occ_u8 "" UBYTE CnvRule_NumberOneToOne 1 0 0 255 ECU_ADDRESS 0x7001526D /end MEASUREMENT
/begin MEASUREMENT dataJ1939Dm1Failrs_as[5].dtc_as[13].spn_u32 "" ULONG CnvRule_NumberOneToOne 1 0 0 4294967295 ECU_ADDRESS 0x70015270 /end MEASUREMENT
/begin MEASUREMENT dataJ1939Dm1Failrs_as[5].dtc_as[13].fmi_u8 "" UBYTE CnvRule_NumberOneToOne 1 0 0 255 ECU_ADDRESS 0x70015274 /end MEASUREMENT
/begin MEASUREMENT dataJ1939Dm1Failrs_as[5].dtc_as[13].occ_u8 "" UBYTE CnvRule_NumberOneToOne 1 0 0 255 ECU_ADDRESS 0x70015275 /end MEASUREMENT
/begin MEASUREMENT dataJ1939Dm1Failrs_as[5].dtc_as[14].spn_u32 "" ULONG CnvRule_NumberOneToOne 1 0 0 4294967295 ECU_ADDRESS 0x70015278 /end MEASUREMENT
/begin MEASUREMENT dataJ1939Dm1Failrs_as[5].dtc_as[14].fmi_u8 "" UBYTE CnvRule_NumberOneToOne 1 0 0 255 ECU_ADDRESS 0x7001527C /end MEASUREMENT
/begin MEASUREMENT dataJ1939Dm1Failrs_as[5].dtc_as[14].occ_u8 "" UBYTE CnvRule_NumberOneToOne 1 0 0 255 ECU_ADDRESS 0x7001527D /end MEASUREMENT
/begin MEASUREMENT dataJ1939Dm1Failrs_as[5].dtc_as[15].spn_u32 "" ULONG CnvRule_NumberOneToOne 1 0 0 4294967295 ECU_ADDRESS 0x70015280 /end MEASUREMENT
/begin MEASUREMENT dataJ1939Dm1Failrs_as[5].dtc_as[15].fmi_u8 "" UBYTE CnvRule_NumberOneToOne 1 0 0 255 ECU_ADDRESS 0x70015284 /end MEASUREMENT
/begin MEASUREMENT dataJ1939Dm1Failrs_as[5].dtc_as[15].occ_u8 "" UBYTE CnvRule_NumberOneToOne 1 0 0 255 ECU_ADDRESS 0x70015285 /end MEASUREMENT
/begin MEASUREMENT dataJ1939Dm1Failrs_as[5].dtc_as[16].spn_u32 "" ULONG CnvRule_NumberOneToOne 1 0 0 4294967295 ECU_ADDRESS 0x70015288 /end MEASUREMENT
/begin MEASUREMENT dataJ1939Dm1Failrs_as[5].dtc_as[16].fmi_u8 "" UBYTE CnvRule_NumberOneToOne 1 0 0 255 ECU_ADDRESS 0x7001528C /end MEASUREMENT
/begin MEASUREMENT dataJ1939Dm1Failrs_as[5].dtc_as[16].occ_u8 "" UBYTE CnvRule_NumberOneToOne 1 0 0 255 ECU_ADDRESS 0x7001528D /end MEASUREMENT
/begin MEASUREMENT dataJ1939Dm1Failrs_as[5].dtc_as[17].spn_u32 "" ULONG CnvRule_NumberOneToOne 1 0 0 4294967295 ECU_ADDRESS 0x70015290 /end MEASUREMENT
/begin MEASUREMENT dataJ1939Dm1Failrs_as[5].dtc_as[17].fmi_u8 "" UBYTE CnvRule_NumberOneToOne 1 0 0 255 ECU_ADDRESS 0x70015294 /end MEASUREMENT
/begin MEASUREMENT dataJ1939Dm1Failrs_as[5].dtc_as[17].occ_u8 "" UBYTE CnvRule_NumberOneToOne 1 0 0 255 ECU_ADDRESS 0x70015295 /end MEASUREMENT
/begin MEASUREMENT dataJ1939Dm1Failrs_as[5].dtc_as[18].spn_u32 "" ULONG CnvRule_NumberOneToOne 1 0 0 4294967295 ECU_ADDRESS 0x70015298 /end MEASUREMENT
/begin MEASUREMENT dataJ1939Dm1Failrs_as[5].dtc_as[18].fmi_u8 "" UBYTE CnvRule_NumberOneToOne 1 0 0 255 ECU_ADDRESS 0x7001529C /end MEASUREMENT
/begin MEASUREMENT dataJ1939Dm1Failrs_as[5].dtc_as[18].occ_u8 "" UBYTE CnvRule_NumberOneToOne 1 0 0 255 ECU_ADDRESS 0x7001529D /end MEASUREMENT
/begin MEASUREMENT dataJ1939Dm1Failrs_as[5].dtc_as[19].spn_u32 "" ULONG CnvRule_NumberOneToOne 1 0 0 4294967295 ECU_ADDRESS 0x700152A0 /end MEASUREMENT
/begin MEASUREMENT dataJ1939Dm1Failrs_as[5].dtc_as[19].fmi_u8 "" UBYTE CnvRule_NumberOneToOne 1 0 0 255 ECU_ADDRESS 0x700152A4 /end MEASUREMENT
/begin MEASUREMENT dataJ1939Dm1Failrs_as[5].dtc_as[19].occ_u8 "" UBYTE CnvRule_NumberOneToOne 1 0 0 255 ECU_ADDRESS 0x700152A5 /end MEASUREMENT
/begin MEASUREMENT dataJ1939Dm1Failrs_as[5].dtc_as[20].spn_u32 "" ULONG CnvRule_NumberOneToOne 1 0 0 4294967295 ECU_ADDRESS 0x700152A8 /end MEASUREMENT
/begin MEASUREMENT dataJ1939Dm1Failrs_as[5].dtc_as[20].fmi_u8 "" UBYTE CnvRule_NumberOneToOne 1 0 0 255 ECU_ADDRESS 0x700152AC /end MEASUREMENT
/begin MEASUREMENT dataJ1939Dm1Failrs_as[5].dtc_as[20].occ_u8 "" UBYTE CnvRule_NumberOneToOne 1 0 0 255 ECU_ADDRESS 0x700152AD /end MEASUREMENT
/begin MEASUREMENT dataJ1939Dm1Failrs_as[5].dtc_as "" UBYTE CnvRule_NumberOneToOne 1 0 0 255 ECU_ADDRESS 0x70015210 ARRAY_SIZE 160 /end MEASUREMENT
/begin MEASUREMENT dataJ1939Dm1Failrs_as[6].dtc_as[1].spn_u32 "" ULONG CnvRule_NumberOneToOne 1 0 0 4294967295 ECU_ADDRESS 0x700152B4 /end MEASUREMENT
/begin MEASUREMENT dataJ1939Dm1Failrs_as[6].dtc_as[1].fmi_u8 "" UBYTE CnvRule_NumberOneToOne 1 0 0 255 ECU_ADDRESS 0x700152B8 /end MEASUREMENT
/begin MEASUREMENT dataJ1939Dm1Failrs_as[6].dtc_as[1].occ_u8 "" UBYTE CnvRule_NumberOneToOne 1 0 0 255 ECU_ADDRESS 0x700152B9 /end MEASUREMENT
/begin MEASUREMENT dataJ1939Dm1Failrs_as[6].dtc_as[2].spn_u32 "" ULONG CnvRule_NumberOneToOne 1 0 0 4294967295 ECU_ADDRESS 0x700152BC /end MEASUREMENT
/begin MEASUREMENT dataJ1939Dm1Failrs_as[6].dtc_as[2].fmi_u8 "" UBYTE CnvRule_NumberOneToOne 1 0 0 255 ECU_ADDRESS 0x700152C0 /end MEASUREMENT
/begin MEASUREMENT dataJ1939Dm1Failrs_as[6].dtc_as[2].occ_u8 "" UBYTE CnvRule_NumberOneToOne 1 0 0 255 ECU_ADDRESS 0x700152C1 /end MEASUREMENT
/begin MEASUREMENT dataJ1939Dm1Failrs_as[6].dtc_as[3].spn_u32 "" ULONG CnvRule_NumberOneToOne 1 0 0 4294967295 ECU_ADDRESS 0x700152C4 /end MEASUREMENT
/begin MEASUREMENT dataJ1939Dm1Failrs_as[6].dtc_as[3].fmi_u8 "" UBYTE CnvRule_NumberOneToOne 1 0 0 255 ECU_ADDRESS 0x700152C8 /end MEASUREMENT
/begin MEASUREMENT dataJ1939Dm1Failrs_as[6].dtc_as[3].occ_u8 "" UBYTE CnvRule_NumberOneToOne 1 0 0 255 ECU_ADDRESS 0x700152C9 /end MEASUREMENT
/begin MEASUREMENT dataJ1939Dm1Failrs_as[6].dtc_as[4].spn_u32 "" ULONG CnvRule_NumberOneToOne 1 0 0 4294967295 ECU_ADDRESS 0x700152CC /end MEASUREMENT
/begin MEASUREMENT dataJ1939Dm1Failrs_as[6].dtc_as[4].fmi_u8 "" UBYTE CnvRule_NumberOneToOne 1 0 0 255 ECU_ADDRESS 0x700152D0 /end MEASUREMENT
/begin MEASUREMENT dataJ1939Dm1Failrs_as[6].dtc_as[4].occ_u8 "" UBYTE CnvRule_NumberOneToOne 1 0 0 255 ECU_ADDRESS 0x700152D1 /end MEASUREMENT
/begin MEASUREMENT dataJ1939Dm1Failrs_as[6].dtc_as[5].spn_u32 "" ULONG CnvRule_NumberOneToOne 1 0 0 4294967295 ECU_ADDRESS 0x700152D4 /end MEASUREMENT
/begin MEASUREMENT dataJ1939Dm1Failrs_as[6].dtc_as[5].fmi_u8 "" UBYTE CnvRule_NumberOneToOne 1 0 0 255 ECU_ADDRESS 0x700152D8 /end MEASUREMENT
/begin MEASUREMENT dataJ1939Dm1Failrs_as[6].dtc_as[5].occ_u8 "" UBYTE CnvRule_NumberOneToOne 1 0 0 255 ECU_ADDRESS 0x700152D9 /end MEASUREMENT
/begin MEASUREMENT dataJ1939Dm1Failrs_as[6].dtc_as[6].spn_u32 "" ULONG CnvRule_NumberOneToOne 1 0 0 4294967295 ECU_ADDRESS 0x700152DC /end MEASUREMENT
/begin MEASUREMENT dataJ1939Dm1Failrs_as[6].dtc_as[6].fmi_u8 "" UBYTE CnvRule_NumberOneToOne 1 0 0 255 ECU_ADDRESS 0x700152E0 /end MEASUREMENT
/begin MEASUREMENT dataJ1939Dm1Failrs_as[6].dtc_as[6].occ_u8 "" UBYTE CnvRule_NumberOneToOne 1 0 0 255 ECU_ADDRESS 0x700152E1 /end MEASUREMENT
/begin MEASUREMENT dataJ1939Dm1Failrs_as[6].dtc_as[7].spn_u32 "" ULONG CnvRule_NumberOneToOne 1 0 0 4294967295 ECU_ADDRESS 0x700152E4 /end MEASUREMENT
/begin MEASUREMENT dataJ1939Dm1Failrs_as[6].dtc_as[7].fmi_u8 "" UBYTE CnvRule_NumberOneToOne 1 0 0 255 ECU_ADDRESS 0x700152E8 /end MEASUREMENT
/begin MEASUREMENT dataJ1939Dm1Failrs_as[6].dtc_as[7].occ_u8 "" UBYTE CnvRule_NumberOneToOne 1 0 0 255 ECU_ADDRESS 0x700152E9 /end MEASUREMENT
/begin MEASUREMENT dataJ1939Dm1Failrs_as[6].dtc_as[8].spn_u32 "" ULONG CnvRule_NumberOneToOne 1 0 0 4294967295 ECU_ADDRESS 0x700152EC /end MEASUREMENT
/begin MEASUREMENT dataJ1939Dm1Failrs_as[6].dtc_as[8].fmi_u8 "" UBYTE CnvRule_NumberOneToOne 1 0 0 255 ECU_ADDRESS 0x700152F0 /end MEASUREMENT
/begin MEASUREMENT dataJ1939Dm1Failrs_as[6].dtc_as[8].occ_u8 "" UBYTE CnvRule_NumberOneToOne 1 0 0 255 ECU_ADDRESS 0x700152F1 /end MEASUREMENT
/begin MEASUREMENT dataJ1939Dm1Failrs_as[6].dtc_as[9].spn_u32 "" ULONG CnvRule_NumberOneToOne 1 0 0 4294967295 ECU_ADDRESS 0x700152F4 /end MEASUREMENT
/begin MEASUREMENT dataJ1939Dm1Failrs_as[6].dtc_as[9].fmi_u8 "" UBYTE CnvRule_NumberOneToOne 1 0 0 255 ECU_ADDRESS 0x700152F8 /end MEASUREMENT
/begin MEASUREMENT dataJ1939Dm1Failrs_as[6].dtc_as[9].occ_u8 "" UBYTE CnvRule_NumberOneToOne 1 0 0 255 ECU_ADDRESS 0x700152F9 /end MEASUREMENT
/begin MEASUREMENT dataJ1939Dm1Failrs_as[6].dtc_as[10].spn_u32 "" ULONG CnvRule_NumberOneToOne 1 0 0 4294967295 ECU_ADDRESS 0x700152FC /end MEASUREMENT
/begin MEASUREMENT dataJ1939Dm1Failrs_as[6].dtc_as[10].fmi_u8 "" UBYTE CnvRule_NumberOneToOne 1 0 0 255 ECU_ADDRESS 0x70015300 /end MEASUREMENT
/begin MEASUREMENT dataJ1939Dm1Failrs_as[6].dtc_as[10].occ_u8 "" UBYTE CnvRule_NumberOneToOne 1 0 0 255 ECU_ADDRESS 0x70015301 /end MEASUREMENT
/begin MEASUREMENT dataJ1939Dm1Failrs_as[6].dtc_as[11].spn_u32 "" ULONG CnvRule_NumberOneToOne 1 0 0 4294967295 ECU_ADDRESS 0x70015304 /end MEASUREMENT
/begin MEASUREMENT dataJ1939Dm1Failrs_as[6].dtc_as[11].fmi_u8 "" UBYTE CnvRule_NumberOneToOne 1 0 0 255 ECU_ADDRESS 0x70015308 /end MEASUREMENT
/begin MEASUREMENT dataJ1939Dm1Failrs_as[6].dtc_as[11].occ_u8 "" UBYTE CnvRule_NumberOneToOne 1 0 0 255 ECU_ADDRESS 0x70015309 /end MEASUREMENT
/begin MEASUREMENT dataJ1939Dm1Failrs_as[6].dtc_as[12].spn_u32 "" ULONG CnvRule_NumberOneToOne 1 0 0 4294967295 ECU_ADDRESS 0x7001530C /end MEASUREMENT
/begin MEASUREMENT dataJ1939Dm1Failrs_as[6].dtc_as[12].fmi_u8 "" UBYTE CnvRule_NumberOneToOne 1 0 0 255 ECU_ADDRESS 0x70015310 /end MEASUREMENT
/begin MEASUREMENT dataJ1939Dm1Failrs_as[6].dtc_as[12].occ_u8 "" UBYTE CnvRule_NumberOneToOne 1 0 0 255 ECU_ADDRESS 0x70015311 /end MEASUREMENT
/begin MEASUREMENT dataJ1939Dm1Failrs_as[6].dtc_as[13].spn_u32 "" ULONG CnvRule_NumberOneToOne 1 0 0 4294967295 ECU_ADDRESS 0x70015314 /end MEASUREMENT
/begin MEASUREMENT dataJ1939Dm1Failrs_as[6].dtc_as[13].fmi_u8 "" UBYTE CnvRule_NumberOneToOne 1 0 0 255 ECU_ADDRESS 0x70015318 /end MEASUREMENT
/begin MEASUREMENT dataJ1939Dm1Failrs_as[6].dtc_as[13].occ_u8 "" UBYTE CnvRule_NumberOneToOne 1 0 0 255 ECU_ADDRESS 0x70015319 /end MEASUREMENT
/begin MEASUREMENT dataJ1939Dm1Failrs_as[6].dtc_as[14].spn_u32 "" ULONG CnvRule_NumberOneToOne 1 0 0 4294967295 ECU_ADDRESS 0x7001531C /end MEASUREMENT
/begin MEASUREMENT dataJ1939Dm1Failrs_as[6].dtc_as[14].fmi_u8 "" UBYTE CnvRule_NumberOneToOne 1 0 0 255 ECU_ADDRESS 0x70015320 /end MEASUREMENT
/begin MEASUREMENT dataJ1939Dm1Failrs_as[6].dtc_as[14].occ_u8 "" UBYTE CnvRule_NumberOneToOne 1 0 0 255 ECU_ADDRESS 0x70015321 /end MEASUREMENT
/begin MEASUREMENT dataJ1939Dm1Failrs_as[6].dtc_as[15].spn_u32 "" ULONG CnvRule_NumberOneToOne 1 0 0 4294967295 ECU_ADDRESS 0x70015324 /end MEASUREMENT
/begin MEASUREMENT dataJ1939Dm1Failrs_as[6].dtc_as[15].fmi_u8 "" UBYTE CnvRule_NumberOneToOne 1 0 0 255 ECU_ADDRESS 0x70015328 /end MEASUREMENT
/begin MEASUREMENT dataJ1939Dm1Failrs_as[6].dtc_as[15].occ_u8 "" UBYTE CnvRule_NumberOneToOne 1 0 0 255 ECU_ADDRESS 0x70015329 /end MEASUREMENT
/begin MEASUREMENT dataJ1939Dm1Failrs_as[6].dtc_as[16].spn_u32 "" ULONG CnvRule_NumberOneToOne 1 0 0 4294967295 ECU_ADDRESS 0x7001532C /end MEASUREMENT
/begin MEASUREMENT dataJ1939Dm1Failrs_as[6].dtc_as[16].fmi_u8 "" UBYTE CnvRule_NumberOneToOne 1 0 0 255 ECU_ADDRESS 0x70015330 /end MEASUREMENT
/begin MEASUREMENT dataJ1939Dm1Failrs_as[6].dtc_as[16].occ_u8 "" UBYTE CnvRule_NumberOneToOne 1 0 0 255 ECU_ADDRESS 0x70015331 /end MEASUREMENT
/begin MEASUREMENT dataJ1939Dm1Failrs_as[6].dtc_as[17].spn_u32 "" ULONG CnvRule_NumberOneToOne 1 0 0 4294967295 ECU_ADDRESS 0x70015334 /end MEASUREMENT
/begin MEASUREMENT dataJ1939Dm1Failrs_as[6].dtc_as[17].fmi_u8 "" UBYTE CnvRule_NumberOneToOne 1 0 0 255 ECU_ADDRESS 0x70015338 /end MEASUREMENT
/begin MEASUREMENT dataJ1939Dm1Failrs_as[6].dtc_as[17].occ_u8 "" UBYTE CnvRule_NumberOneToOne 1 0 0 255 ECU_ADDRESS 0x70015339 /end MEASUREMENT
/begin MEASUREMENT dataJ1939Dm1Failrs_as[6].dtc_as[18].spn_u32 "" ULONG CnvRule_NumberOneToOne 1 0 0 4294967295 ECU_ADDRESS 0x7001533C /end MEASUREMENT
/begin MEASUREMENT dataJ1939Dm1Failrs_as[6].dtc_as[18].fmi_u8 "" UBYTE CnvRule_NumberOneToOne 1 0 0 255 ECU_ADDRESS 0x70015340 /end MEASUREMENT
/begin MEASUREMENT dataJ1939Dm1Failrs_as[6].dtc_as[18].occ_u8 "" UBYTE CnvRule_NumberOneToOne 1 0 0 255 ECU_ADDRESS 0x70015341 /end MEASUREMENT
/begin MEASUREMENT dataJ1939Dm1Failrs_as[6].dtc_as[19].spn_u32 "" ULONG CnvRule_NumberOneToOne 1 0 0 4294967295 ECU_ADDRESS 0x70015344 /end MEASUREMENT
/begin MEASUREMENT dataJ1939Dm1Failrs_as[6].dtc_as[19].fmi_u8 "" UBYTE CnvRule_NumberOneToOne 1 0 0 255 ECU_ADDRESS 0x70015348 /end MEASUREMENT
/begin MEASUREMENT dataJ1939Dm1Failrs_as[6].dtc_as[19].occ_u8 "" UBYTE CnvRule_NumberOneToOne 1 0 0 255 ECU_ADDRESS 0x70015349 /end MEASUREMENT
/begin MEASUREMENT dataJ1939Dm1Failrs_as[6].dtc_as[20].spn_u32 "" ULONG CnvRule_NumberOneToOne 1 0 0 4294967295 ECU_ADDRESS 0x7001534C /end MEASUREMENT
/begin MEASUREMENT dataJ1939Dm1Failrs_as[6].dtc_as[20].fmi_u8 "" UBYTE CnvRule_NumberOneToOne 1 0 0 255 ECU_ADDRESS 0x70015350 /end MEASUREMENT
/begin MEASUREMENT dataJ1939Dm1Failrs_as[6].dtc_as[20].occ_u8 "" UBYTE CnvRule_NumberOneToOne 1 0 0 255 ECU_ADDRESS 0x70015351 /end MEASUREMENT
/begin MEASUREMENT dataJ1939Dm1Failrs_as[6].dtc_as "" UBYTE CnvRule_NumberOneToOne 1 0 0 255 ECU_ADDRESS 0x700152B4 ARRAY_SIZE 160 /end MEASUREMENT
/begin MEASUREMENT dataJ1939Dm1Failrs_as[7].dtc_as[1].spn_u32 "" ULONG CnvRule_NumberOneToOne 1 0 0 4294967295 ECU_ADDRESS 0x70015358 /end MEASUREMENT
/begin MEASUREMENT dataJ1939Dm1Failrs_as[7].dtc_as[1].fmi_u8 "" UBYTE CnvRule_NumberOneToOne 1 0 0 255 ECU_ADDRESS 0x7001535C /end MEASUREMENT
/begin MEASUREMENT dataJ1939Dm1Failrs_as[7].dtc_as[1].occ_u8 "" UBYTE CnvRule_NumberOneToOne 1 0 0 255 ECU_ADDRESS 0x7001535D /end MEASUREMENT
/begin MEASUREMENT dataJ1939Dm1Failrs_as[7].dtc_as[2].spn_u32 "" ULONG CnvRule_NumberOneToOne 1 0 0 4294967295 ECU_ADDRESS 0x70015360 /end MEASUREMENT
/begin MEASUREMENT dataJ1939Dm1Failrs_as[7].dtc_as[2].fmi_u8 "" UBYTE CnvRule_NumberOneToOne 1 0 0 255 ECU_ADDRESS 0x70015364 /end MEASUREMENT
/begin MEASUREMENT dataJ1939Dm1Failrs_as[7].dtc_as[2].occ_u8 "" UBYTE CnvRule_NumberOneToOne 1 0 0 255 ECU_ADDRESS 0x70015365 /end MEASUREMENT
/begin MEASUREMENT dataJ1939Dm1Failrs_as[7].dtc_as[3].spn_u32 "" ULONG CnvRule_NumberOneToOne 1 0 0 4294967295 ECU_ADDRESS 0x70015368 /end MEASUREMENT
/begin MEASUREMENT dataJ1939Dm1Failrs_as[7].dtc_as[3].fmi_u8 "" UBYTE CnvRule_NumberOneToOne 1 0 0 255 ECU_ADDRESS 0x7001536C /end MEASUREMENT
/begin MEASUREMENT dataJ1939Dm1Failrs_as[7].dtc_as[3].occ_u8 "" UBYTE CnvRule_NumberOneToOne 1 0 0 255 ECU_ADDRESS 0x7001536D /end MEASUREMENT
/begin MEASUREMENT dataJ1939Dm1Failrs_as[7].dtc_as[4].spn_u32 "" ULONG CnvRule_NumberOneToOne 1 0 0 4294967295 ECU_ADDRESS 0x70015370 /end MEASUREMENT
/begin MEASUREMENT dataJ1939Dm1Failrs_as[7].dtc_as[4].fmi_u8 "" UBYTE CnvRule_NumberOneToOne 1 0 0 255 ECU_ADDRESS 0x70015374 /end MEASUREMENT
/begin MEASUREMENT dataJ1939Dm1Failrs_as[7].dtc_as[4].occ_u8 "" UBYTE CnvRule_NumberOneToOne 1 0 0 255 ECU_ADDRESS 0x70015375 /end MEASUREMENT
/begin MEASUREMENT dataJ1939Dm1Failrs_as[7].dtc_as[5].spn_u32 "" ULONG CnvRule_NumberOneToOne 1 0 0 4294967295 ECU_ADDRESS 0x70015378 /end MEASUREMENT
/begin MEASUREMENT dataJ1939Dm1Failrs_as[7].dtc_as[5].fmi_u8 "" UBYTE CnvRule_NumberOneToOne 1 0 0 255 ECU_ADDRESS 0x7001537C /end MEASUREMENT
/begin MEASUREMENT dataJ1939Dm1Failrs_as[7].dtc_as[5].occ_u8 "" UBYTE CnvRule_NumberOneToOne 1 0 0 255 ECU_ADDRESS 0x7001537D /end MEASUREMENT
/begin MEASUREMENT dataJ1939Dm1Failrs_as[7].dtc_as[6].spn_u32 "" ULONG CnvRule_NumberOneToOne 1 0 0 4294967295 ECU_ADDRESS 0x70015380 /end MEASUREMENT
/begin MEASUREMENT dataJ1939Dm1Failrs_as[7].dtc_as[6].fmi_u8 "" UBYTE CnvRule_NumberOneToOne 1 0 0 255 ECU_ADDRESS 0x70015384 /end MEASUREMENT
/begin MEASUREMENT dataJ1939Dm1Failrs_as[7].dtc_as[6].occ_u8 "" UBYTE CnvRule_NumberOneToOne 1 0 0 255 ECU_ADDRESS 0x70015385 /end MEASUREMENT
/begin MEASUREMENT dataJ1939Dm1Failrs_as[7].dtc_as[7].spn_u32 "" ULONG CnvRule_NumberOneToOne 1 0 0 4294967295 ECU_ADDRESS 0x70015388 /end MEASUREMENT
/begin MEASUREMENT dataJ1939Dm1Failrs_as[7].dtc_as[7].fmi_u8 "" UBYTE CnvRule_NumberOneToOne 1 0 0 255 ECU_ADDRESS 0x7001538C /end MEASUREMENT
/begin MEASUREMENT dataJ1939Dm1Failrs_as[7].dtc_as[7].occ_u8 "" UBYTE CnvRule_NumberOneToOne 1 0 0 255 ECU_ADDRESS 0x7001538D /end MEASUREMENT
/begin MEASUREMENT dataJ1939Dm1Failrs_as[7].dtc_as[8].spn_u32 "" ULONG CnvRule_NumberOneToOne 1 0 0 4294967295 ECU_ADDRESS 0x70015390 /end MEASUREMENT
/begin MEASUREMENT dataJ1939Dm1Failrs_as[7].dtc_as[8].fmi_u8 "" UBYTE CnvRule_NumberOneToOne 1 0 0 255 ECU_ADDRESS 0x70015394 /end MEASUREMENT
/begin MEASUREMENT dataJ1939Dm1Failrs_as[7].dtc_as[8].occ_u8 "" UBYTE CnvRule_NumberOneToOne 1 0 0 255 ECU_ADDRESS 0x70015395 /end MEASUREMENT
/begin MEASUREMENT dataJ1939Dm1Failrs_as[7].dtc_as[9].spn_u32 "" ULONG CnvRule_NumberOneToOne 1 0 0 4294967295 ECU_ADDRESS 0x70015398 /end MEASUREMENT
/begin MEASUREMENT dataJ1939Dm1Failrs_as[7].dtc_as[9].fmi_u8 "" UBYTE CnvRule_NumberOneToOne 1 0 0 255 ECU_ADDRESS 0x7001539C /end MEASUREMENT
/begin MEASUREMENT dataJ1939Dm1Failrs_as[7].dtc_as[9].occ_u8 "" UBYTE CnvRule_NumberOneToOne 1 0 0 255 ECU_ADDRESS 0x7001539D /end MEASUREMENT
/begin MEASUREMENT dataJ1939Dm1Failrs_as[7].dtc_as[10].spn_u32 "" ULONG CnvRule_NumberOneToOne 1 0 0 4294967295 ECU_ADDRESS 0x700153A0 /end MEASUREMENT
/begin MEASUREMENT dataJ1939Dm1Failrs_as[7].dtc_as[10].fmi_u8 "" UBYTE CnvRule_NumberOneToOne 1 0 0 255 ECU_ADDRESS 0x700153A4 /end MEASUREMENT
/begin MEASUREMENT dataJ1939Dm1Failrs_as[7].dtc_as[10].occ_u8 "" UBYTE CnvRule_NumberOneToOne 1 0 0 255 ECU_ADDRESS 0x700153A5 /end MEASUREMENT
/begin MEASUREMENT dataJ1939Dm1Failrs_as[7].dtc_as[11].spn_u32 "" ULONG CnvRule_NumberOneToOne 1 0 0 4294967295 ECU_ADDRESS 0x700153A8 /end MEASUREMENT
/begin MEASUREMENT dataJ1939Dm1Failrs_as[7].dtc_as[11].fmi_u8 "" UBYTE CnvRule_NumberOneToOne 1 0 0 255 ECU_ADDRESS 0x700153AC /end MEASUREMENT
/begin MEASUREMENT dataJ1939Dm1Failrs_as[7].dtc_as[11].occ_u8 "" UBYTE CnvRule_NumberOneToOne 1 0 0 255 ECU_ADDRESS 0x700153AD /end MEASUREMENT
/begin MEASUREMENT dataJ1939Dm1Failrs_as[7].dtc_as[12].spn_u32 "" ULONG CnvRule_NumberOneToOne 1 0 0 4294967295 ECU_ADDRESS 0x700153B0 /end MEASUREMENT
/begin MEASUREMENT dataJ1939Dm1Failrs_as[7].dtc_as[12].fmi_u8 "" UBYTE CnvRule_NumberOneToOne 1 0 0 255 ECU_ADDRESS 0x700153B4 /end MEASUREMENT
/begin MEASUREMENT dataJ1939Dm1Failrs_as[7].dtc_as[12].occ_u8 "" UBYTE CnvRule_NumberOneToOne 1 0 0 255 ECU_ADDRESS 0x700153B5 /end MEASUREMENT
/begin MEASUREMENT dataJ1939Dm1Failrs_as[7].dtc_as[13].spn_u32 "" ULONG CnvRule_NumberOneToOne 1 0 0 4294967295 ECU_ADDRESS 0x700153B8 /end MEASUREMENT
/begin MEASUREMENT dataJ1939Dm1Failrs_as[7].dtc_as[13].fmi_u8 "" UBYTE CnvRule_NumberOneToOne 1 0 0 255 ECU_ADDRESS 0x700153BC /end MEASUREMENT
/begin MEASUREMENT dataJ1939Dm1Failrs_as[7].dtc_as[13].occ_u8 "" UBYTE CnvRule_NumberOneToOne 1 0 0 255 ECU_ADDRESS 0x700153BD /end MEASUREMENT
/begin MEASUREMENT dataJ1939Dm1Failrs_as[7].dtc_as[14].spn_u32 "" ULONG CnvRule_NumberOneToOne 1 0 0 4294967295 ECU_ADDRESS 0x700153C0 /end MEASUREMENT
/begin MEASUREMENT dataJ1939Dm1Failrs_as[7].dtc_as[14].fmi_u8 "" UBYTE CnvRule_NumberOneToOne 1 0 0 255 ECU_ADDRESS 0x700153C4 /end MEASUREMENT
/begin MEASUREMENT dataJ1939Dm1Failrs_as[7].dtc_as[14].occ_u8 "" UBYTE CnvRule_NumberOneToOne 1 0 0 255 ECU_ADDRESS 0x700153C5 /end MEASUREMENT
/begin MEASUREMENT dataJ1939Dm1Failrs_as[7].dtc_as[15].spn_u32 "" ULONG CnvRule_NumberOneToOne 1 0 0 4294967295 ECU_ADDRESS 0x700153C8 /end MEASUREMENT
/begin MEASUREMENT dataJ1939Dm1Failrs_as[7].dtc_as[15].fmi_u8 "" UBYTE CnvRule_NumberOneToOne 1 0 0 255 ECU_ADDRESS 0x700153CC /end MEASUREMENT
/begin MEASUREMENT dataJ1939Dm1Failrs_as[7].dtc_as[15].occ_u8 "" UBYTE CnvRule_NumberOneToOne 1 0 0 255 ECU_ADDRESS 0x700153CD /end MEASUREMENT
/begin MEASUREMENT dataJ1939Dm1Failrs_as[7].dtc_as[16].spn_u32 "" ULONG CnvRule_NumberOneToOne 1 0 0 4294967295 ECU_ADDRESS 0x700153D0 /end MEASUREMENT
/begin MEASUREMENT dataJ1939Dm1Failrs_as[7].dtc_as[16].fmi_u8 "" UBYTE CnvRule_NumberOneToOne 1 0 0 255 ECU_ADDRESS 0x700153D4 /end MEASUREMENT
/begin MEASUREMENT dataJ1939Dm1Failrs_as[7].dtc_as[16].occ_u8 "" UBYTE CnvRule_NumberOneToOne 1 0 0 255 ECU_ADDRESS 0x700153D5 /end MEASUREMENT
/begin MEASUREMENT dataJ1939Dm1Failrs_as[7].dtc_as[17].spn_u32 "" ULONG CnvRule_NumberOneToOne 1 0 0 4294967295 ECU_ADDRESS 0x700153D8 /end MEASUREMENT
/begin MEASUREMENT dataJ1939Dm1Failrs_as[7].dtc_as[17].fmi_u8 "" UBYTE CnvRule_NumberOneToOne 1 0 0 255 ECU_ADDRESS 0x700153DC /end MEASUREMENT
/begin MEASUREMENT dataJ1939Dm1Failrs_as[7].dtc_as[17].occ_u8 "" UBYTE CnvRule_NumberOneToOne 1 0 0 255 ECU_ADDRESS 0x700153DD /end MEASUREMENT
/begin MEASUREMENT dataJ1939Dm1Failrs_as[7].dtc_as[18].spn_u32 "" ULONG CnvRule_NumberOneToOne 1 0 0 4294967295 ECU_ADDRESS 0x700153E0 /end MEASUREMENT
/begin MEASUREMENT dataJ1939Dm1Failrs_as[7].dtc_as[18].fmi_u8 "" UBYTE CnvRule_NumberOneToOne 1 0 0 255 ECU_ADDRESS 0x700153E4 /end MEASUREMENT
/begin MEASUREMENT dataJ1939Dm1Failrs_as[7].dtc_as[18].occ_u8 "" UBYTE CnvRule_NumberOneToOne 1 0 0 255 ECU_ADDRESS 0x700153E5 /end MEASUREMENT
/begin MEASUREMENT dataJ1939Dm1Failrs_as[7].dtc_as[19].spn_u32 "" ULONG CnvRule_NumberOneToOne 1 0 0 4294967295 ECU_ADDRESS 0x700153E8 /end MEASUREMENT
/begin MEASUREMENT dataJ1939Dm1Failrs_as[7].dtc_as[19].fmi_u8 "" UBYTE CnvRule_NumberOneToOne 1 0 0 255 ECU_ADDRESS 0x700153EC /end MEASUREMENT
/begin MEASUREMENT dataJ1939Dm1Failrs_as[7].dtc_as[19].occ_u8 "" UBYTE CnvRule_NumberOneToOne 1 0 0 255 ECU_ADDRESS 0x700153ED /end MEASUREMENT
/begin MEASUREMENT dataJ1939Dm1Failrs_as[7].dtc_as[20].spn_u32 "" ULONG CnvRule_NumberOneToOne 1 0 0 4294967295 ECU_ADDRESS 0x700153F0 /end MEASUREMENT
/begin MEASUREMENT dataJ1939Dm1Failrs_as[7].dtc_as[20].fmi_u8 "" UBYTE CnvRule_NumberOneToOne 1 0 0 255 ECU_ADDRESS 0x700153F4 /end MEASUREMENT
/begin MEASUREMENT dataJ1939Dm1Failrs_as[7].dtc_as[20].occ_u8 "" UBYTE CnvRule_NumberOneToOne 1 0 0 255 ECU_ADDRESS 0x700153F5 /end MEASUREMENT
/begin MEASUREMENT dataJ1939Dm1Failrs_as[7].dtc_as "" UBYTE CnvRule_NumberOneToOne 1 0 0 255 ECU_ADDRESS 0x70015358 ARRAY_SIZE 160 /end MEASUREMENT
/begin MEASUREMENT dataJ1939Dm1Failrs_as[8].dtc_as[1].spn_u32 "" ULONG CnvRule_NumberOneToOne 1 0 0 4294967295 ECU_ADDRESS 0x700153FC /end MEASUREMENT
/begin MEASUREMENT dataJ1939Dm1Failrs_as[8].dtc_as[1].fmi_u8 "" UBYTE CnvRule_NumberOneToOne 1 0 0 255 ECU_ADDRESS 0x70015400 /end MEASUREMENT
/begin MEASUREMENT dataJ1939Dm1Failrs_as[8].dtc_as[1].occ_u8 "" UBYTE CnvRule_NumberOneToOne 1 0 0 255 ECU_ADDRESS 0x70015401 /end MEASUREMENT
/begin MEASUREMENT dataJ1939Dm1Failrs_as[8].dtc_as[2].spn_u32 "" ULONG CnvRule_NumberOneToOne 1 0 0 4294967295 ECU_ADDRESS 0x70015404 /end MEASUREMENT
/begin MEASUREMENT dataJ1939Dm1Failrs_as[8].dtc_as[2].fmi_u8 "" UBYTE CnvRule_NumberOneToOne 1 0 0 255 ECU_ADDRESS 0x70015408 /end MEASUREMENT
/begin MEASUREMENT dataJ1939Dm1Failrs_as[8].dtc_as[2].occ_u8 "" UBYTE CnvRule_NumberOneToOne 1 0 0 255 ECU_ADDRESS 0x70015409 /end MEASUREMENT
/begin MEASUREMENT dataJ1939Dm1Failrs_as[8].dtc_as[3].spn_u32 "" ULONG CnvRule_NumberOneToOne 1 0 0 4294967295 ECU_ADDRESS 0x7001540C /end MEASUREMENT
/begin MEASUREMENT dataJ1939Dm1Failrs_as[8].dtc_as[3].fmi_u8 "" UBYTE CnvRule_NumberOneToOne 1 0 0 255 ECU_ADDRESS 0x70015410 /end MEASUREMENT
/begin MEASUREMENT dataJ1939Dm1Failrs_as[8].dtc_as[3].occ_u8 "" UBYTE CnvRule_NumberOneToOne 1 0 0 255 ECU_ADDRESS 0x70015411 /end MEASUREMENT
/begin MEASUREMENT dataJ1939Dm1Failrs_as[8].dtc_as[4].spn_u32 "" ULONG CnvRule_NumberOneToOne 1 0 0 4294967295 ECU_ADDRESS 0x70015414 /end MEASUREMENT
/begin MEASUREMENT dataJ1939Dm1Failrs_as[8].dtc_as[4].fmi_u8 "" UBYTE CnvRule_NumberOneToOne 1 0 0 255 ECU_ADDRESS 0x70015418 /end MEASUREMENT
/begin MEASUREMENT dataJ1939Dm1Failrs_as[8].dtc_as[4].occ_u8 "" UBYTE CnvRule_NumberOneToOne 1 0 0 255 ECU_ADDRESS 0x70015419 /end MEASUREMENT
/begin MEASUREMENT dataJ1939Dm1Failrs_as[8].dtc_as[5].spn_u32 "" ULONG CnvRule_NumberOneToOne 1 0 0 4294967295 ECU_ADDRESS 0x7001541C /end MEASUREMENT
/begin MEASUREMENT dataJ1939Dm1Failrs_as[8].dtc_as[5].fmi_u8 "" UBYTE CnvRule_NumberOneToOne 1 0 0 255 ECU_ADDRESS 0x70015420 /end MEASUREMENT
/begin MEASUREMENT dataJ1939Dm1Failrs_as[8].dtc_as[5].occ_u8 "" UBYTE CnvRule_NumberOneToOne 1 0 0 255 ECU_ADDRESS 0x70015421 /end MEASUREMENT
/begin MEASUREMENT dataJ1939Dm1Failrs_as[8].dtc_as[6].spn_u32 "" ULONG CnvRule_NumberOneToOne 1 0 0 4294967295 ECU_ADDRESS 0x70015424 /end MEASUREMENT
/begin MEASUREMENT dataJ1939Dm1Failrs_as[8].dtc_as[6].fmi_u8 "" UBYTE CnvRule_NumberOneToOne 1 0 0 255 ECU_ADDRESS 0x70015428 /end MEASUREMENT
/begin MEASUREMENT dataJ1939Dm1Failrs_as[8].dtc_as[6].occ_u8 "" UBYTE CnvRule_NumberOneToOne 1 0 0 255 ECU_ADDRESS 0x70015429 /end MEASUREMENT
/begin MEASUREMENT dataJ1939Dm1Failrs_as[8].dtc_as[7].spn_u32 "" ULONG CnvRule_NumberOneToOne 1 0 0 4294967295 ECU_ADDRESS 0x7001542C /end MEASUREMENT
/begin MEASUREMENT dataJ1939Dm1Failrs_as[8].dtc_as[7].fmi_u8 "" UBYTE CnvRule_NumberOneToOne 1 0 0 255 ECU_ADDRESS 0x70015430 /end MEASUREMENT
/begin MEASUREMENT dataJ1939Dm1Failrs_as[8].dtc_as[7].occ_u8 "" UBYTE CnvRule_NumberOneToOne 1 0 0 255 ECU_ADDRESS 0x70015431 /end MEASUREMENT
/begin MEASUREMENT dataJ1939Dm1Failrs_as[8].dtc_as[8].spn_u32 "" ULONG CnvRule_NumberOneToOne 1 0 0 4294967295 ECU_ADDRESS 0x70015434 /end MEASUREMENT
/begin MEASUREMENT dataJ1939Dm1Failrs_as[8].dtc_as[8].fmi_u8 "" UBYTE CnvRule_NumberOneToOne 1 0 0 255 ECU_ADDRESS 0x70015438 /end MEASUREMENT
/begin MEASUREMENT dataJ1939Dm1Failrs_as[8].dtc_as[8].occ_u8 "" UBYTE CnvRule_NumberOneToOne 1 0 0 255 ECU_ADDRESS 0x70015439 /end MEASUREMENT
/begin MEASUREMENT dataJ1939Dm1Failrs_as[8].dtc_as[9].spn_u32 "" ULONG CnvRule_NumberOneToOne 1 0 0 4294967295 ECU_ADDRESS 0x7001543C /end MEASUREMENT
/begin MEASUREMENT dataJ1939Dm1Failrs_as[8].dtc_as[9].fmi_u8 "" UBYTE CnvRule_NumberOneToOne 1 0 0 255 ECU_ADDRESS 0x70015440 /end MEASUREMENT
/begin MEASUREMENT dataJ1939Dm1Failrs_as[8].dtc_as[9].occ_u8 "" UBYTE CnvRule_NumberOneToOne 1 0 0 255 ECU_ADDRESS 0x70015441 /end MEASUREMENT
/begin MEASUREMENT dataJ1939Dm1Failrs_as[8].dtc_as[10].spn_u32 "" ULONG CnvRule_NumberOneToOne 1 0 0 4294967295 ECU_ADDRESS 0x70015444 /end MEASUREMENT
/begin MEASUREMENT dataJ1939Dm1Failrs_as[8].dtc_as[10].fmi_u8 "" UBYTE CnvRule_NumberOneToOne 1 0 0 255 ECU_ADDRESS 0x70015448 /end MEASUREMENT
/begin MEASUREMENT dataJ1939Dm1Failrs_as[8].dtc_as[10].occ_u8 "" UBYTE CnvRule_NumberOneToOne 1 0 0 255 ECU_ADDRESS 0x70015449 /end MEASUREMENT
/begin MEASUREMENT dataJ1939Dm1Failrs_as[8].dtc_as[11].spn_u32 "" ULONG CnvRule_NumberOneToOne 1 0 0 4294967295 ECU_ADDRESS 0x7001544C /end MEASUREMENT
/begin MEASUREMENT dataJ1939Dm1Failrs_as[8].dtc_as[11].fmi_u8 "" UBYTE CnvRule_NumberOneToOne 1 0 0 255 ECU_ADDRESS 0x70015450 /end MEASUREMENT
/begin MEASUREMENT dataJ1939Dm1Failrs_as[8].dtc_as[11].occ_u8 "" UBYTE CnvRule_NumberOneToOne 1 0 0 255 ECU_ADDRESS 0x70015451 /end MEASUREMENT
/begin MEASUREMENT dataJ1939Dm1Failrs_as[8].dtc_as[12].spn_u32 "" ULONG CnvRule_NumberOneToOne 1 0 0 4294967295 ECU_ADDRESS 0x70015454 /end MEASUREMENT
/begin MEASUREMENT dataJ1939Dm1Failrs_as[8].dtc_as[12].fmi_u8 "" UBYTE CnvRule_NumberOneToOne 1 0 0 255 ECU_ADDRESS 0x70015458 /end MEASUREMENT
/begin MEASUREMENT dataJ1939Dm1Failrs_as[8].dtc_as[12].occ_u8 "" UBYTE CnvRule_NumberOneToOne 1 0 0 255 ECU_ADDRESS 0x70015459 /end MEASUREMENT
/begin MEASUREMENT dataJ1939Dm1Failrs_as[8].dtc_as[13].spn_u32 "" ULONG CnvRule_NumberOneToOne 1 0 0 4294967295 ECU_ADDRESS 0x7001545C /end MEASUREMENT
/begin MEASUREMENT dataJ1939Dm1Failrs_as[8].dtc_as[13].fmi_u8 "" UBYTE CnvRule_NumberOneToOne 1 0 0 255 ECU_ADDRESS 0x70015460 /end MEASUREMENT
/begin MEASUREMENT dataJ1939Dm1Failrs_as[8].dtc_as[13].occ_u8 "" UBYTE CnvRule_NumberOneToOne 1 0 0 255 ECU_ADDRESS 0x70015461 /end MEASUREMENT
/begin MEASUREMENT dataJ1939Dm1Failrs_as[8].dtc_as[14].spn_u32 "" ULONG CnvRule_NumberOneToOne 1 0 0 4294967295 ECU_ADDRESS 0x70015464 /end MEASUREMENT
/begin MEASUREMENT dataJ1939Dm1Failrs_as[8].dtc_as[14].fmi_u8 "" UBYTE CnvRule_NumberOneToOne 1 0 0 255 ECU_ADDRESS 0x70015468 /end MEASUREMENT
/begin MEASUREMENT dataJ1939Dm1Failrs_as[8].dtc_as[14].occ_u8 "" UBYTE CnvRule_NumberOneToOne 1 0 0 255 ECU_ADDRESS 0x70015469 /end MEASUREMENT
/begin MEASUREMENT dataJ1939Dm1Failrs_as[8].dtc_as[15].spn_u32 "" ULONG CnvRule_NumberOneToOne 1 0 0 4294967295 ECU_ADDRESS 0x7001546C /end MEASUREMENT
/begin MEASUREMENT dataJ1939Dm1Failrs_as[8].dtc_as[15].fmi_u8 "" UBYTE CnvRule_NumberOneToOne 1 0 0 255 ECU_ADDRESS 0x70015470 /end MEASUREMENT
/begin MEASUREMENT dataJ1939Dm1Failrs_as[8].dtc_as[15].occ_u8 "" UBYTE CnvRule_NumberOneToOne 1 0 0 255 ECU_ADDRESS 0x70015471 /end MEASUREMENT
/begin MEASUREMENT dataJ1939Dm1Failrs_as[8].dtc_as[16].spn_u32 "" ULONG CnvRule_NumberOneToOne 1 0 0 4294967295 ECU_ADDRESS 0x70015474 /end MEASUREMENT
/begin MEASUREMENT dataJ1939Dm1Failrs_as[8].dtc_as[16].fmi_u8 "" UBYTE CnvRule_NumberOneToOne 1 0 0 255 ECU_ADDRESS 0x70015478 /end MEASUREMENT
/begin MEASUREMENT dataJ1939Dm1Failrs_as[8].dtc_as[16].occ_u8 "" UBYTE CnvRule_NumberOneToOne 1 0 0 255 ECU_ADDRESS 0x70015479 /end MEASUREMENT
/begin MEASUREMENT dataJ1939Dm1Failrs_as[8].dtc_as[17].spn_u32 "" ULONG CnvRule_NumberOneToOne 1 0 0 4294967295 ECU_ADDRESS 0x7001547C /end MEASUREMENT
/begin MEASUREMENT dataJ1939Dm1Failrs_as[8].dtc_as[17].fmi_u8 "" UBYTE CnvRule_NumberOneToOne 1 0 0 255 ECU_ADDRESS 0x70015480 /end MEASUREMENT
/begin MEASUREMENT dataJ1939Dm1Failrs_as[8].dtc_as[17].occ_u8 "" UBYTE CnvRule_NumberOneToOne 1 0 0 255 ECU_ADDRESS 0x70015481 /end MEASUREMENT
/begin MEASUREMENT dataJ1939Dm1Failrs_as[8].dtc_as[18].spn_u32 "" ULONG CnvRule_NumberOneToOne 1 0 0 4294967295 ECU_ADDRESS 0x70015484 /end MEASUREMENT
/begin MEASUREMENT dataJ1939Dm1Failrs_as[8].dtc_as[18].fmi_u8 "" UBYTE CnvRule_NumberOneToOne 1 0 0 255 ECU_ADDRESS 0x70015488 /end MEASUREMENT
/begin MEASUREMENT dataJ1939Dm1Failrs_as[8].dtc_as[18].occ_u8 "" UBYTE CnvRule_NumberOneToOne 1 0 0 255 ECU_ADDRESS 0x70015489 /end MEASUREMENT
/begin MEASUREMENT dataJ1939Dm1Failrs_as[8].dtc_as[19].spn_u32 "" ULONG CnvRule_NumberOneToOne 1 0 0 4294967295 ECU_ADDRESS 0x7001548C /end MEASUREMENT
/begin MEASUREMENT dataJ1939Dm1Failrs_as[8].dtc_as[19].fmi_u8 "" UBYTE CnvRule_NumberOneToOne 1 0 0 255 ECU_ADDRESS 0x70015490 /end MEASUREMENT
/begin MEASUREMENT dataJ1939Dm1Failrs_as[8].dtc_as[19].occ_u8 "" UBYTE CnvRule_NumberOneToOne 1 0 0 255 ECU_ADDRESS 0x70015491 /end MEASUREMENT
/begin MEASUREMENT dataJ1939Dm1Failrs_as[8].dtc_as[20].spn_u32 "" ULONG CnvRule_NumberOneToOne 1 0 0 4294967295 ECU_ADDRESS 0x70015494 /end MEASUREMENT
/begin MEASUREMENT dataJ1939Dm1Failrs_as[8].dtc_as[20].fmi_u8 "" UBYTE CnvRule_NumberOneToOne 1 0 0 255 ECU_ADDRESS 0x70015498 /end MEASUREMENT
/begin COMPU_METHOD CnvRule_NumberOneToOne "This is a predefined standard conversion rule for signals representing a number with a 1:1 conversion (*nr*_*)." IDENTICAL "%.0" "-" /end COMPU_METHOD
