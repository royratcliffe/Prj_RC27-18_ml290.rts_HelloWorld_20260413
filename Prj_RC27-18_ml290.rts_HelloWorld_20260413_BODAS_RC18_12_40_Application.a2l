/begin MEASUREMENT dataJ1939Dm1Failrs_as[29].dtc_as[7].spn_u32 "" ULONG CnvRule_NumberOneToOne 1 0 0 4294967295 ECU_ADDRESS 0x700161A0 /end MEASUREMENT
/begin MEASUREMENT dataJ1939Dm1Failrs_as[29].dtc_as[7].fmi_u8 "" UBYTE CnvRule_NumberOneToOne 1 0 0 255 ECU_ADDRESS 0x700161A4 /end MEASUREMENT
/begin MEASUREMENT dataJ1939Dm1Failrs_as[29].dtc_as[7].occ_u8 "" UBYTE CnvRule_NumberOneToOne 1 0 0 255 ECU_ADDRESS 0x700161A5 /end MEASUREMENT
/begin MEASUREMENT dataJ1939Dm1Failrs_as[29].dtc_as[8].spn_u32 "" ULONG CnvRule_NumberOneToOne 1 0 0 4294967295 ECU_ADDRESS 0x700161A8 /end MEASUREMENT
/begin MEASUREMENT dataJ1939Dm1Failrs_as[29].dtc_as[8].fmi_u8 "" UBYTE CnvRule_NumberOneToOne 1 0 0 255 ECU_ADDRESS 0x700161AC /end MEASUREMENT
/begin MEASUREMENT dataJ1939Dm1Failrs_as[29].dtc_as[8].occ_u8 "" UBYTE CnvRule_NumberOneToOne 1 0 0 255 ECU_ADDRESS 0x700161AD /end MEASUREMENT
/begin MEASUREMENT dataJ1939Dm1Failrs_as[29].dtc_as[9].spn_u32 "" ULONG CnvRule_NumberOneToOne 1 0 0 4294967295 ECU_ADDRESS 0x700161B0 /end MEASUREMENT
/begin MEASUREMENT dataJ1939Dm1Failrs_as[29].dtc_as[9].fmi_u8 "" UBYTE CnvRule_NumberOneToOne 1 0 0 255 ECU_ADDRESS 0x700161B4 /end MEASUREMENT
/begin MEASUREMENT dataJ1939Dm1Failrs_as[29].dtc_as[9].occ_u8 "" UBYTE CnvRule_NumberOneToOne 1 0 0 255 ECU_ADDRESS 0x700161B5 /end MEASUREMENT
/begin MEASUREMENT dataJ1939Dm1Failrs_as[29].dtc_as[10].spn_u32 "" ULONG CnvRule_NumberOneToOne 1 0 0 4294967295 ECU_ADDRESS 0x700161B8 /end MEASUREMENT
/begin MEASUREMENT dataJ1939Dm1Failrs_as[29].dtc_as[10].fmi_u8 "" UBYTE CnvRule_NumberOneToOne 1 0 0 255 ECU_ADDRESS 0x700161BC /end MEASUREMENT
/begin MEASUREMENT dataJ1939Dm1Failrs_as[29].dtc_as[10].occ_u8 "" UBYTE CnvRule_NumberOneToOne 1 0 0 255 ECU_ADDRESS 0x700161BD /end MEASUREMENT
/begin MEASUREMENT dataJ1939Dm1Failrs_as[29].dtc_as[11].spn_u32 "" ULONG CnvRule_NumberOneToOne 1 0 0 4294967295 ECU_ADDRESS 0x700161C0 /end MEASUREMENT
/begin MEASUREMENT dataJ1939Dm1Failrs_as[29].dtc_as[11].fmi_u8 "" UBYTE CnvRule_NumberOneToOne 1 0 0 255 ECU_ADDRESS 0x700161C4 /end MEASUREMENT
/begin MEASUREMENT dataJ1939Dm1Failrs_as[29].dtc_as[11].occ_u8 "" UBYTE CnvRule_NumberOneToOne 1 0 0 255 ECU_ADDRESS 0x700161C5 /end MEASUREMENT
/begin MEASUREMENT dataJ1939Dm1Failrs_as[29].dtc_as[12].spn_u32 "" ULONG CnvRule_NumberOneToOne 1 0 0 4294967295 ECU_ADDRESS 0x700161C8 /end MEASUREMENT
/begin MEASUREMENT dataJ1939Dm1Failrs_as[29].dtc_as[12].fmi_u8 "" UBYTE CnvRule_NumberOneToOne 1 0 0 255 ECU_ADDRESS 0x700161CC /end MEASUREMENT
/begin MEASUREMENT dataJ1939Dm1Failrs_as[29].dtc_as[12].occ_u8 "" UBYTE CnvRule_NumberOneToOne 1 0 0 255 ECU_ADDRESS 0x700161CD /end MEASUREMENT
/begin MEASUREMENT dataJ1939Dm1Failrs_as[29].dtc_as[13].spn_u32 "" ULONG CnvRule_NumberOneToOne 1 0 0 4294967295 ECU_ADDRESS 0x700161D0 /end MEASUREMENT
/begin MEASUREMENT dataJ1939Dm1Failrs_as[29].dtc_as[13].fmi_u8 "" UBYTE CnvRule_NumberOneToOne 1 0 0 255 ECU_ADDRESS 0x700161D4 /end MEASUREMENT
/begin MEASUREMENT dataJ1939Dm1Failrs_as[29].dtc_as[13].occ_u8 "" UBYTE CnvRule_NumberOneToOne 1 0 0 255 ECU_ADDRESS 0x700161D5 /end MEASUREMENT
/begin MEASUREMENT dataJ1939Dm1Failrs_as[29].dtc_as[14].spn_u32 "" ULONG CnvRule_NumberOneToOne 1 0 0 4294967295 ECU_ADDRESS 0x700161D8 /end MEASUREMENT
/begin MEASUREMENT dataJ1939Dm1Failrs_as[29].dtc_as[14].fmi_u8 "" UBYTE CnvRule_NumberOneToOne 1 0 0 255 ECU_ADDRESS 0x700161DC /end MEASUREMENT
/begin MEASUREMENT dataJ1939Dm1Failrs_as[29].dtc_as[14].occ_u8 "" UBYTE CnvRule_NumberOneToOne 1 0 0 255 ECU_ADDRESS 0x700161DD /end MEASUREMENT
/begin MEASUREMENT dataJ1939Dm1Failrs_as[29].dtc_as[15].spn_u32 "" ULONG CnvRule_NumberOneToOne 1 0 0 4294967295 ECU_ADDRESS 0x700161E0 /end MEASUREMENT
/begin MEASUREMENT dataJ1939Dm1Failrs_as[29].dtc_as[15].fmi_u8 "" UBYTE CnvRule_NumberOneToOne 1 0 0 255 ECU_ADDRESS 0x700161E4 /end MEASUREMENT
/begin MEASUREMENT dataJ1939Dm1Failrs_as[29].dtc_as[15].occ_u8 "" UBYTE CnvRule_NumberOneToOne 1 0 0 255 ECU_ADDRESS 0x700161E5 /end MEASUREMENT
/begin MEASUREMENT dataJ1939Dm1Failrs_as[29].dtc_as[16].spn_u32 "" ULONG CnvRule_NumberOneToOne 1 0 0 4294967295 ECU_ADDRESS 0x700161E8 /end MEASUREMENT
/begin MEASUREMENT dataJ1939Dm1Failrs_as[29].dtc_as[16].fmi_u8 "" UBYTE CnvRule_NumberOneToOne 1 0 0 255 ECU_ADDRESS 0x700161EC /end MEASUREMENT
/begin MEASUREMENT dataJ1939Dm1Failrs_as[29].dtc_as[16].occ_u8 "" UBYTE CnvRule_NumberOneToOne 1 0 0 255 ECU_ADDRESS 0x700161ED /end MEASUREMENT
/begin MEASUREMENT dataJ1939Dm1Failrs_as[29].dtc_as[17].spn_u32 "" ULONG CnvRule_NumberOneToOne 1 0 0 4294967295 ECU_ADDRESS 0x700161F0 /end MEASUREMENT
/begin MEASUREMENT dataJ1939Dm1Failrs_as[29].dtc_as[17].fmi_u8 "" UBYTE CnvRule_NumberOneToOne 1 0 0 255 ECU_ADDRESS 0x700161F4 /end MEASUREMENT
/begin MEASUREMENT dataJ1939Dm1Failrs_as[29].dtc_as[17].occ_u8 "" UBYTE CnvRule_NumberOneToOne 1 0 0 255 ECU_ADDRESS 0x700161F5 /end MEASUREMENT
/begin MEASUREMENT dataJ1939Dm1Failrs_as[29].dtc_as[18].spn_u32 "" ULONG CnvRule_NumberOneToOne 1 0 0 4294967295 ECU_ADDRESS 0x700161F8 /end MEASUREMENT
/begin MEASUREMENT dataJ1939Dm1Failrs_as[29].dtc_as[18].fmi_u8 "" UBYTE CnvRule_NumberOneToOne 1 0 0 255 ECU_ADDRESS 0x700161FC /end MEASUREMENT
/begin MEASUREMENT dataJ1939Dm1Failrs_as[29].dtc_as[18].occ_u8 "" UBYTE CnvRule_NumberOneToOne 1 0 0 255 ECU_ADDRESS 0x700161FD /end MEASUREMENT
/begin MEASUREMENT dataJ1939Dm1Failrs_as[29].dtc_as[19].spn_u32 "" ULONG CnvRule_NumberOneToOne 1 0 0 4294967295 ECU_ADDRESS 0x70016200 /end MEASUREMENT
/begin MEASUREMENT dataJ1939Dm1Failrs_as[29].dtc_as[19].fmi_u8 "" UBYTE CnvRule_NumberOneToOne 1 0 0 255 ECU_ADDRESS 0x70016204 /end MEASUREMENT
/begin MEASUREMENT dataJ1939Dm1Failrs_as[29].dtc_as[19].occ_u8 "" UBYTE CnvRule_NumberOneToOne 1 0 0 255 ECU_ADDRESS 0x70016205 /end MEASUREMENT
/begin MEASUREMENT dataJ1939Dm1Failrs_as[29].dtc_as[20].spn_u32 "" ULONG CnvRule_NumberOneToOne 1 0 0 4294967295 ECU_ADDRESS 0x70016208 /end MEASUREMENT
/begin MEASUREMENT dataJ1939Dm1Failrs_as[29].dtc_as[20].fmi_u8 "" UBYTE CnvRule_NumberOneToOne 1 0 0 255 ECU_ADDRESS 0x7001620C /end MEASUREMENT
/begin MEASUREMENT dataJ1939Dm1Failrs_as[29].dtc_as[20].occ_u8 "" UBYTE CnvRule_NumberOneToOne 1 0 0 255 ECU_ADDRESS 0x7001620D /end MEASUREMENT
/begin MEASUREMENT dataJ1939Dm1Failrs_as[29].dtc_as "" UBYTE CnvRule_NumberOneToOne 1 0 0 255 ECU_ADDRESS 0x70016170 ARRAY_SIZE 160 /end MEASUREMENT
/begin MEASUREMENT dataJ1939Dm1Failrs_as[30].dtc_as[1].spn_u32 "" ULONG CnvRule_NumberOneToOne 1 0 0 4294967295 ECU_ADDRESS 0x70016214 /end MEASUREMENT
/begin MEASUREMENT dataJ1939Dm1Failrs_as[30].dtc_as[1].fmi_u8 "" UBYTE CnvRule_NumberOneToOne 1 0 0 255 ECU_ADDRESS 0x70016218 /end MEASUREMENT
/begin MEASUREMENT dataJ1939Dm1Failrs_as[30].dtc_as[1].occ_u8 "" UBYTE CnvRule_NumberOneToOne 1 0 0 255 ECU_ADDRESS 0x70016219 /end MEASUREMENT
/begin MEASUREMENT dataJ1939Dm1Failrs_as[30].dtc_as[2].spn_u32 "" ULONG CnvRule_NumberOneToOne 1 0 0 4294967295 ECU_ADDRESS 0x7001621C /end MEASUREMENT
/begin MEASUREMENT dataJ1939Dm1Failrs_as[30].dtc_as[2].fmi_u8 "" UBYTE CnvRule_NumberOneToOne 1 0 0 255 ECU_ADDRESS 0x70016220 /end MEASUREMENT
/begin MEASUREMENT dataJ1939Dm1Failrs_as[30].dtc_as[2].occ_u8 "" UBYTE CnvRule_NumberOneToOne 1 0 0 255 ECU_ADDRESS 0x70016221 /end MEASUREMENT
/begin MEASUREMENT dataJ1939Dm1Failrs_as[30].dtc_as[3].spn_u32 "" ULONG CnvRule_NumberOneToOne 1 0 0 4294967295 ECU_ADDRESS 0x70016224 /end MEASUREMENT
/begin MEASUREMENT dataJ1939Dm1Failrs_as[30].dtc_as[3].fmi_u8 "" UBYTE CnvRule_NumberOneToOne 1 0 0 255 ECU_ADDRESS 0x70016228 /end MEASUREMENT
/begin MEASUREMENT dataJ1939Dm1Failrs_as[30].dtc_as[3].occ_u8 "" UBYTE CnvRule_NumberOneToOne 1 0 0 255 ECU_ADDRESS 0x70016229 /end MEASUREMENT
/begin MEASUREMENT dataJ1939Dm1Failrs_as[30].dtc_as[4].spn_u32 "" ULONG CnvRule_NumberOneToOne 1 0 0 4294967295 ECU_ADDRESS 0x7001622C /end MEASUREMENT
/begin MEASUREMENT dataJ1939Dm1Failrs_as[30].dtc_as[4].fmi_u8 "" UBYTE CnvRule_NumberOneToOne 1 0 0 255 ECU_ADDRESS 0x70016230 /end MEASUREMENT
/begin MEASUREMENT dataJ1939Dm1Failrs_as[30].dtc_as[4].occ_u8 "" UBYTE CnvRule_NumberOneToOne 1 0 0 255 ECU_ADDRESS 0x70016231 /end MEASUREMENT
/begin MEASUREMENT dataJ1939Dm1Failrs_as[30].dtc_as[5].spn_u32 "" ULONG CnvRule_NumberOneToOne 1 0 0 4294967295 ECU_ADDRESS 0x70016234 /end MEASUREMENT
/begin MEASUREMENT dataJ1939Dm1Failrs_as[30].dtc_as[5].fmi_u8 "" UBYTE CnvRule_NumberOneToOne 1 0 0 255 ECU_ADDRESS 0x70016238 /end MEASUREMENT
/begin MEASUREMENT dataJ1939Dm1Failrs_as[30].dtc_as[5].occ_u8 "" UBYTE CnvRule_NumberOneToOne 1 0 0 255 ECU_ADDRESS 0x70016239 /end MEASUREMENT
/begin MEASUREMENT dataJ1939Dm1Failrs_as[30].dtc_as[6].spn_u32 "" ULONG CnvRule_NumberOneToOne 1 0 0 4294967295 ECU_ADDRESS 0x7001623C /end MEASUREMENT
/begin MEASUREMENT dataJ1939Dm1Failrs_as[30].dtc_as[6].fmi_u8 "" UBYTE CnvRule_NumberOneToOne 1 0 0 255 ECU_ADDRESS 0x70016240 /end MEASUREMENT
/begin MEASUREMENT dataJ1939Dm1Failrs_as[30].dtc_as[6].occ_u8 "" UBYTE CnvRule_NumberOneToOne 1 0 0 255 ECU_ADDRESS 0x70016241 /end MEASUREMENT
/begin MEASUREMENT dataJ1939Dm1Failrs_as[30].dtc_as[7].spn_u32 "" ULONG CnvRule_NumberOneToOne 1 0 0 4294967295 ECU_ADDRESS 0x70016244 /end MEASUREMENT
/begin MEASUREMENT dataJ1939Dm1Failrs_as[30].dtc_as[7].fmi_u8 "" UBYTE CnvRule_NumberOneToOne 1 0 0 255 ECU_ADDRESS 0x70016248 /end MEASUREMENT
/begin MEASUREMENT dataJ1939Dm1Failrs_as[30].dtc_as[7].occ_u8 "" UBYTE CnvRule_NumberOneToOne 1 0 0 255 ECU_ADDRESS 0x70016249 /end MEASUREMENT
/begin MEASUREMENT dataJ1939Dm1Failrs_as[30].dtc_as[8].spn_u32 "" ULONG CnvRule_NumberOneToOne 1 0 0 4294967295 ECU_ADDRESS 0x7001624C /end MEASUREMENT
/begin MEASUREMENT dataJ1939Dm1Failrs_as[30].dtc_as[8].fmi_u8 "" UBYTE CnvRule_NumberOneToOne 1 0 0 255 ECU_ADDRESS 0x70016250 /end MEASUREMENT
/begin MEASUREMENT dataJ1939Dm1Failrs_as[30].dtc_as[8].occ_u8 "" UBYTE CnvRule_NumberOneToOne 1 0 0 255 ECU_ADDRESS 0x70016251 /end MEASUREMENT
/begin MEASUREMENT dataJ1939Dm1Failrs_as[30].dtc_as[9].spn_u32 "" ULONG CnvRule_NumberOneToOne 1 0 0 4294967295 ECU_ADDRESS 0x70016254 /end MEASUREMENT
/begin MEASUREMENT dataJ1939Dm1Failrs_as[30].dtc_as[9].fmi_u8 "" UBYTE CnvRule_NumberOneToOne 1 0 0 255 ECU_ADDRESS 0x70016258 /end MEASUREMENT
/begin MEASUREMENT dataJ1939Dm1Failrs_as[30].dtc_as[9].occ_u8 "" UBYTE CnvRule_NumberOneToOne 1 0 0 255 ECU_ADDRESS 0x70016259 /end MEASUREMENT
/begin MEASUREMENT dataJ1939Dm1Failrs_as[30].dtc_as[10].spn_u32 "" ULONG CnvRule_NumberOneToOne 1 0 0 4294967295 ECU_ADDRESS 0x7001625C /end MEASUREMENT
/begin MEASUREMENT dataJ1939Dm1Failrs_as[30].dtc_as[10].fmi_u8 "" UBYTE CnvRule_NumberOneToOne 1 0 0 255 ECU_ADDRESS 0x70016260 /end MEASUREMENT
/begin MEASUREMENT dataJ1939Dm1Failrs_as[30].dtc_as[10].occ_u8 "" UBYTE CnvRule_NumberOneToOne 1 0 0 255 ECU_ADDRESS 0x70016261 /end MEASUREMENT
/begin MEASUREMENT dataJ1939Dm1Failrs_as[30].dtc_as[11].spn_u32 "" ULONG CnvRule_NumberOneToOne 1 0 0 4294967295 ECU_ADDRESS 0x70016264 /end MEASUREMENT
/begin MEASUREMENT dataJ1939Dm1Failrs_as[30].dtc_as[11].fmi_u8 "" UBYTE CnvRule_NumberOneToOne 1 0 0 255 ECU_ADDRESS 0x70016268 /end MEASUREMENT
/begin MEASUREMENT dataJ1939Dm1Failrs_as[30].dtc_as[11].occ_u8 "" UBYTE CnvRule_NumberOneToOne 1 0 0 255 ECU_ADDRESS 0x70016269 /end MEASUREMENT
/begin MEASUREMENT dataJ1939Dm1Failrs_as[30].dtc_as[12].spn_u32 "" ULONG CnvRule_NumberOneToOne 1 0 0 4294967295 ECU_ADDRESS 0x7001626C /end MEASUREMENT
/begin MEASUREMENT dataJ1939Dm1Failrs_as[30].dtc_as[12].fmi_u8 "" UBYTE CnvRule_NumberOneToOne 1 0 0 255 ECU_ADDRESS 0x70016270 /end MEASUREMENT
/begin MEASUREMENT dataJ1939Dm1Failrs_as[30].dtc_as[12].occ_u8 "" UBYTE CnvRule_NumberOneToOne 1 0 0 255 ECU_ADDRESS 0x70016271 /end MEASUREMENT
/begin MEASUREMENT dataJ1939Dm1Failrs_as[30].dtc_as[13].spn_u32 "" ULONG CnvRule_NumberOneToOne 1 0 0 4294967295 ECU_ADDRESS 0x70016274 /end MEASUREMENT
/begin MEASUREMENT dataJ1939Dm1Failrs_as[30].dtc_as[13].fmi_u8 "" UBYTE CnvRule_NumberOneToOne 1 0 0 255 ECU_ADDRESS 0x70016278 /end MEASUREMENT
/begin MEASUREMENT dataJ1939Dm1Failrs_as[30].dtc_as[13].occ_u8 "" UBYTE CnvRule_NumberOneToOne 1 0 0 255 ECU_ADDRESS 0x70016279 /end MEASUREMENT
/begin MEASUREMENT dataJ1939Dm1Failrs_as[30].dtc_as[14].spn_u32 "" ULONG CnvRule_NumberOneToOne 1 0 0 4294967295 ECU_ADDRESS 0x7001627C /end MEASUREMENT
/begin MEASUREMENT dataJ1939Dm1Failrs_as[30].dtc_as[14].fmi_u8 "" UBYTE CnvRule_NumberOneToOne 1 0 0 255 ECU_ADDRESS 0x70016280 /end MEASUREMENT
/begin MEASUREMENT dataJ1939Dm1Failrs_as[30].dtc_as[14].occ_u8 "" UBYTE CnvRule_NumberOneToOne 1 0 0 255 ECU_ADDRESS 0x70016281 /end MEASUREMENT
/begin MEASUREMENT dataJ1939Dm1Failrs_as[30].dtc_as[15].spn_u32 "" ULONG CnvRule_NumberOneToOne 1 0 0 4294967295 ECU_ADDRESS 0x70016284 /end MEASUREMENT
/begin MEASUREMENT dataJ1939Dm1Failrs_as[30].dtc_as[15].fmi_u8 "" UBYTE CnvRule_NumberOneToOne 1 0 0 255 ECU_ADDRESS 0x70016288 /end MEASUREMENT
/begin MEASUREMENT dataJ1939Dm1Failrs_as[30].dtc_as[15].occ_u8 "" UBYTE CnvRule_NumberOneToOne 1 0 0 255 ECU_ADDRESS 0x70016289 /end MEASUREMENT
/begin MEASUREMENT dataJ1939Dm1Failrs_as[30].dtc_as[16].spn_u32 "" ULONG CnvRule_NumberOneToOne 1 0 0 4294967295 ECU_ADDRESS 0x7001628C /end MEASUREMENT
/begin MEASUREMENT dataJ1939Dm1Failrs_as[30].dtc_as[16].fmi_u8 "" UBYTE CnvRule_NumberOneToOne 1 0 0 255 ECU_ADDRESS 0x70016290 /end MEASUREMENT
/begin MEASUREMENT dataJ1939Dm1Failrs_as[30].dtc_as[16].occ_u8 "" UBYTE CnvRule_NumberOneToOne 1 0 0 255 ECU_ADDRESS 0x70016291 /end MEASUREMENT
/begin MEASUREMENT dataJ1939Dm1Failrs_as[30].dtc_as[17].spn_u32 "" ULONG CnvRule_NumberOneToOne 1 0 0 4294967295 ECU_ADDRESS 0x70016294 /end MEASUREMENT
/begin MEASUREMENT dataJ1939Dm1Failrs_as[30].dtc_as[17].fmi_u8 "" UBYTE CnvRule_NumberOneToOne 1 0 0 255 ECU_ADDRESS 0x70016298 /end MEASUREMENT
/begin MEASUREMENT dataJ1939Dm1Failrs_as[30].dtc_as[17].occ_u8 "" UBYTE CnvRule_NumberOneToOne 1 0 0 255 ECU_ADDRESS 0x70016299 /end MEASUREMENT
/begin MEASUREMENT dataJ1939Dm1Failrs_as[30].dtc_as[18].spn_u32 "" ULONG CnvRule_NumberOneToOne 1 0 0 4294967295 ECU_ADDRESS 0x7001629C /end MEASUREMENT
/begin MEASUREMENT dataJ1939Dm1Failrs_as[30].dtc_as[18].fmi_u8 "" UBYTE CnvRule_NumberOneToOne 1 0 0 255 ECU_ADDRESS 0x700162A0 /end MEASUREMENT
/begin MEASUREMENT dataJ1939Dm1Failrs_as[30].dtc_as[18].occ_u8 "" UBYTE CnvRule_NumberOneToOne 1 0 0 255 ECU_ADDRESS 0x700162A1 /end MEASUREMENT
/begin MEASUREMENT dataJ1939Dm1Failrs_as[30].dtc_as[19].spn_u32 "" ULONG CnvRule_NumberOneToOne 1 0 0 4294967295 ECU_ADDRESS 0x700162A4 /end MEASUREMENT
/begin MEASUREMENT dataJ1939Dm1Failrs_as[30].dtc_as[19].fmi_u8 "" UBYTE CnvRule_NumberOneToOne 1 0 0 255 ECU_ADDRESS 0x700162A8 /end MEASUREMENT
/begin MEASUREMENT dataJ1939Dm1Failrs_as[30].dtc_as[19].occ_u8 "" UBYTE CnvRule_NumberOneToOne 1 0 0 255 ECU_ADDRESS 0x700162A9 /end MEASUREMENT
/begin MEASUREMENT dataJ1939Dm1Failrs_as[30].dtc_as[20].spn_u32 "" ULONG CnvRule_NumberOneToOne 1 0 0 4294967295 ECU_ADDRESS 0x700162AC /end MEASUREMENT
/begin MEASUREMENT dataJ1939Dm1Failrs_as[30].dtc_as[20].fmi_u8 "" UBYTE CnvRule_NumberOneToOne 1 0 0 255 ECU_ADDRESS 0x700162B0 /end MEASUREMENT
/begin MEASUREMENT dataJ1939Dm1Failrs_as[30].dtc_as[20].occ_u8 "" UBYTE CnvRule_NumberOneToOne 1 0 0 255 ECU_ADDRESS 0x700162B1 /end MEASUREMENT
/begin MEASUREMENT dataJ1939Dm1Failrs_as[30].dtc_as "" UBYTE CnvRule_NumberOneToOne 1 0 0 255 ECU_ADDRESS 0x70016214 ARRAY_SIZE 160 /end MEASUREMENT
/begin MEASUREMENT dataJ1939Dm1Failrs_as[31].dtc_as[1].spn_u32 "" ULONG CnvRule_NumberOneToOne 1 0 0 4294967295 ECU_ADDRESS 0x700162B8 /end MEASUREMENT
/begin MEASUREMENT dataJ1939Dm1Failrs_as[31].dtc_as[1].fmi_u8 "" UBYTE CnvRule_NumberOneToOne 1 0 0 255 ECU_ADDRESS 0x700162BC /end MEASUREMENT
/begin MEASUREMENT dataJ1939Dm1Failrs_as[31].dtc_as[1].occ_u8 "" UBYTE CnvRule_NumberOneToOne 1 0 0 255 ECU_ADDRESS 0x700162BD /end MEASUREMENT
/begin MEASUREMENT dataJ1939Dm1Failrs_as[31].dtc_as[2].spn_u32 "" ULONG CnvRule_NumberOneToOne 1 0 0 4294967295 ECU_ADDRESS 0x700162C0 /end MEASUREMENT
/begin MEASUREMENT dataJ1939Dm1Failrs_as[31].dtc_as[2].fmi_u8 "" UBYTE CnvRule_NumberOneToOne 1 0 0 255 ECU_ADDRESS 0x700162C4 /end MEASUREMENT
/begin MEASUREMENT dataJ1939Dm1Failrs_as[31].dtc_as[2].occ_u8 "" UBYTE CnvRule_NumberOneToOne 1 0 0 255 ECU_ADDRESS 0x700162C5 /end MEASUREMENT
/begin MEASUREMENT dataJ1939Dm1Failrs_as[31].dtc_as[3].spn_u32 "" ULONG CnvRule_NumberOneToOne 1 0 0 4294967295 ECU_ADDRESS 0x700162C8 /end MEASUREMENT
/begin MEASUREMENT dataJ1939Dm1Failrs_as[31].dtc_as[3].fmi_u8 "" UBYTE CnvRule_NumberOneToOne 1 0 0 255 ECU_ADDRESS 0x700162CC /end MEASUREMENT
/begin MEASUREMENT dataJ1939Dm1Failrs_as[31].dtc_as[3].occ_u8 "" UBYTE CnvRule_NumberOneToOne 1 0 0 255 ECU_ADDRESS 0x700162CD /end MEASUREMENT
/begin MEASUREMENT dataJ1939Dm1Failrs_as[31].dtc_as[4].spn_u32 "" ULONG CnvRule_NumberOneToOne 1 0 0 4294967295 ECU_ADDRESS 0x700162D0 /end MEASUREMENT
/begin MEASUREMENT dataJ1939Dm1Failrs_as[31].dtc_as[4].fmi_u8 "" UBYTE CnvRule_NumberOneToOne 1 0 0 255 ECU_ADDRESS 0x700162D4 /end MEASUREMENT
/begin MEASUREMENT dataJ1939Dm1Failrs_as[31].dtc_as[4].occ_u8 "" UBYTE CnvRule_NumberOneToOne 1 0 0 255 ECU_ADDRESS 0x700162D5 /end MEASUREMENT
/begin MEASUREMENT dataJ1939Dm1Failrs_as[31].dtc_as[5].spn_u32 "" ULONG CnvRule_NumberOneToOne 1 0 0 4294967295 ECU_ADDRESS 0x700162D8 /end MEASUREMENT
/begin MEASUREMENT dataJ1939Dm1Failrs_as[31].dtc_as[5].fmi_u8 "" UBYTE CnvRule_NumberOneToOne 1 0 0 255 ECU_ADDRESS 0x700162DC /end MEASUREMENT
/begin MEASUREMENT dataJ1939Dm1Failrs_as[31].dtc_as[5].occ_u8 "" UBYTE CnvRule_NumberOneToOne 1 0 0 255 ECU_ADDRESS 0x700162DD /end MEASUREMENT
/begin MEASUREMENT dataJ1939Dm1Failrs_as[31].dtc_as[6].spn_u32 "" ULONG CnvRule_NumberOneToOne 1 0 0 4294967295 ECU_ADDRESS 0x700162E0 /end MEASUREMENT
/begin MEASUREMENT dataJ1939Dm1Failrs_as[31].dtc_as[6].fmi_u8 "" UBYTE CnvRule_NumberOneToOne 1 0 0 255 ECU_ADDRESS 0x700162E4 /end MEASUREMENT
/begin MEASUREMENT dataJ1939Dm1Failrs_as[31].dtc_as[6].occ_u8 "" UBYTE CnvRule_NumberOneToOne 1 0 0 255 ECU_ADDRESS 0x700162E5 /end MEASUREMENT
/begin MEASUREMENT dataJ1939Dm1Failrs_as[31].dtc_as[7].spn_u32 "" ULONG CnvRule_NumberOneToOne 1 0 0 4294967295 ECU_ADDRESS 0x700162E8 /end MEASUREMENT
/begin MEASUREMENT dataJ1939Dm1Failrs_as[31].dtc_as[7].fmi_u8 "" UBYTE CnvRule_NumberOneToOne 1 0 0 255 ECU_ADDRESS 0x700162EC /end MEASUREMENT
/begin MEASUREMENT dataJ1939Dm1Failrs_as[31].dtc_as[7].occ_u8 "" UBYTE CnvRule_NumberOneToOne 1 0 0 255 ECU_ADDRESS 0x700162ED /end MEASUREMENT
/begin MEASUREMENT dataJ1939Dm1Failrs_as[31].dtc_as[8].spn_u32 "" ULONG CnvRule_NumberOneToOne 1 0 0 4294967295 ECU_ADDRESS 0x700162F0 /end MEASUREMENT
/begin MEASUREMENT dataJ1939Dm1Failrs_as[31].dtc_as[8].fmi_u8 "" UBYTE CnvRule_NumberOneToOne 1 0 0 255 ECU_ADDRESS 0x700162F4 /end MEASUREMENT
/begin MEASUREMENT dataJ1939Dm1Failrs_as[31].dtc_as[8].occ_u8 "" UBYTE CnvRule_NumberOneToOne 1 0 0 255 ECU_ADDRESS 0x700162F5 /end MEASUREMENT
/begin MEASUREMENT dataJ1939Dm1Failrs_as[31].dtc_as[9].spn_u32 "" ULONG CnvRule_NumberOneToOne 1 0 0 4294967295 ECU_ADDRESS 0x700162F8 /end MEASUREMENT
/begin MEASUREMENT dataJ1939Dm1Failrs_as[31].dtc_as[9].fmi_u8 "" UBYTE CnvRule_NumberOneToOne 1 0 0 255 ECU_ADDRESS 0x700162FC /end MEASUREMENT
/begin MEASUREMENT dataJ1939Dm1Failrs_as[31].dtc_as[9].occ_u8 "" UBYTE CnvRule_NumberOneToOne 1 0 0 255 ECU_ADDRESS 0x700162FD /end MEASUREMENT
/begin MEASUREMENT dataJ1939Dm1Failrs_as[31].dtc_as[10].spn_u32 "" ULONG CnvRule_NumberOneToOne 1 0 0 4294967295 ECU_ADDRESS 0x70016300 /end MEASUREMENT
/begin MEASUREMENT dataJ1939Dm1Failrs_as[31].dtc_as[10].fmi_u8 "" UBYTE CnvRule_NumberOneToOne 1 0 0 255 ECU_ADDRESS 0x70016304 /end MEASUREMENT
/begin MEASUREMENT dataJ1939Dm1Failrs_as[31].dtc_as[10].occ_u8 "" UBYTE CnvRule_NumberOneToOne 1 0 0 255 ECU_ADDRESS 0x70016305 /end MEASUREMENT
/begin MEASUREMENT dataJ1939Dm1Failrs_as[31].dtc_as[11].spn_u32 "" ULONG CnvRule_NumberOneToOne 1 0 0 4294967295 ECU_ADDRESS 0x70016308 /end MEASUREMENT
/begin MEASUREMENT dataJ1939Dm1Failrs_as[31].dtc_as[11].fmi_u8 "" UBYTE CnvRule_NumberOneToOne 1 0 0 255 ECU_ADDRESS 0x7001630C /end MEASUREMENT
/begin MEASUREMENT dataJ1939Dm1Failrs_as[31].dtc_as[11].occ_u8 "" UBYTE CnvRule_NumberOneToOne 1 0 0 255 ECU_ADDRESS 0x7001630D /end MEASUREMENT
/begin MEASUREMENT dataJ1939Dm1Failrs_as[31].dtc_as[12].spn_u32 "" ULONG CnvRule_NumberOneToOne 1 0 0 4294967295 ECU_ADDRESS 0x70016310 /end MEASUREMENT
/begin MEASUREMENT dataJ1939Dm1Failrs_as[31].dtc_as[12].fmi_u8 "" UBYTE CnvRule_NumberOneToOne 1 0 0 255 ECU_ADDRESS 0x70016314 /end MEASUREMENT
/begin MEASUREMENT dataJ1939Dm1Failrs_as[31].dtc_as[12].occ_u8 "" UBYTE CnvRule_NumberOneToOne 1 0 0 255 ECU_ADDRESS 0x70016315 /end MEASUREMENT
/begin MEASUREMENT dataJ1939Dm1Failrs_as[31].dtc_as[13].spn_u32 "" ULONG CnvRule_NumberOneToOne 1 0 0 4294967295 ECU_ADDRESS 0x70016318 /end MEASUREMENT
/begin MEASUREMENT dataJ1939Dm1Failrs_as[31].dtc_as[13].fmi_u8 "" UBYTE CnvRule_NumberOneToOne 1 0 0 255 ECU_ADDRESS 0x7001631C /end MEASUREMENT
/begin MEASUREMENT dataJ1939Dm1Failrs_as[31].dtc_as[13].occ_u8 "" UBYTE CnvRule_NumberOneToOne 1 0 0 255 ECU_ADDRESS 0x7001631D /end MEASUREMENT
/begin MEASUREMENT dataJ1939Dm1Failrs_as[31].dtc_as[14].spn_u32 "" ULONG CnvRule_NumberOneToOne 1 0 0 4294967295 ECU_ADDRESS 0x70016320 /end MEASUREMENT
/begin MEASUREMENT dataJ1939Dm1Failrs_as[31].dtc_as[14].fmi_u8 "" UBYTE CnvRule_NumberOneToOne 1 0 0 255 ECU_ADDRESS 0x70016324 /end MEASUREMENT
/begin MEASUREMENT dataJ1939Dm1Failrs_as[31].dtc_as[14].occ_u8 "" UBYTE CnvRule_NumberOneToOne 1 0 0 255 ECU_ADDRESS 0x70016325 /end MEASUREMENT
/begin MEASUREMENT dataJ1939Dm1Failrs_as[31].dtc_as[15].spn_u32 "" ULONG CnvRule_NumberOneToOne 1 0 0 4294967295 ECU_ADDRESS 0x70016328 /end MEASUREMENT
/begin MEASUREMENT dataJ1939Dm1Failrs_as[31].dtc_as[15].fmi_u8 "" UBYTE CnvRule_NumberOneToOne 1 0 0 255 ECU_ADDRESS 0x7001632C /end MEASUREMENT
/begin MEASUREMENT dataJ1939Dm1Failrs_as[31].dtc_as[15].occ_u8 "" UBYTE CnvRule_NumberOneToOne 1 0 0 255 ECU_ADDRESS 0x7001632D /end MEASUREMENT
/begin MEASUREMENT dataJ1939Dm1Failrs_as[31].dtc_as[16].spn_u32 "" ULONG CnvRule_NumberOneToOne 1 0 0 4294967295 ECU_ADDRESS 0x70016330 /end MEASUREMENT
/begin MEASUREMENT dataJ1939Dm1Failrs_as[31].dtc_as[16].fmi_u8 "" UBYTE CnvRule_NumberOneToOne 1 0 0 255 ECU_ADDRESS 0x70016334 /end MEASUREMENT
/begin MEASUREMENT dataJ1939Dm1Failrs_as[31].dtc_as[16].occ_u8 "" UBYTE CnvRule_NumberOneToOne 1 0 0 255 ECU_ADDRESS 0x70016335 /end MEASUREMENT
/begin MEASUREMENT dataJ1939Dm1Failrs_as[31].dtc_as[17].spn_u32 "" ULONG CnvRule_NumberOneToOne 1 0 0 4294967295 ECU_ADDRESS 0x70016338 /end MEASUREMENT
/begin MEASUREMENT dataJ1939Dm1Failrs_as[31].dtc_as[17].fmi_u8 "" UBYTE CnvRule_NumberOneToOne 1 0 0 255 ECU_ADDRESS 0x7001633C /end MEASUREMENT
/begin MEASUREMENT dataJ1939Dm1Failrs_as[31].dtc_as[17].occ_u8 "" UBYTE CnvRule_NumberOneToOne 1 0 0 255 ECU_ADDRESS 0x7001633D /end MEASUREMENT
/begin MEASUREMENT dataJ1939Dm1Failrs_as[31].dtc_as[18].spn_u32 "" ULONG CnvRule_NumberOneToOne 1 0 0 4294967295 ECU_ADDRESS 0x70016340 /end MEASUREMENT
/begin MEASUREMENT dataJ1939Dm1Failrs_as[31].dtc_as[18].fmi_u8 "" UBYTE CnvRule_NumberOneToOne 1 0 0 255 ECU_ADDRESS 0x70016344 /end MEASUREMENT
/begin MEASUREMENT dataJ1939Dm1Failrs_as[31].dtc_as[18].occ_u8 "" UBYTE CnvRule_NumberOneToOne 1 0 0 255 ECU_ADDRESS 0x70016345 /end MEASUREMENT
/begin MEASUREMENT dataJ1939Dm1Failrs_as[31].dtc_as[19].spn_u32 "" ULONG CnvRule_NumberOneToOne 1 0 0 4294967295 ECU_ADDRESS 0x70016348 /end MEASUREMENT
/begin MEASUREMENT dataJ1939Dm1Failrs_as[31].dtc_as[19].fmi_u8 "" UBYTE CnvRule_NumberOneToOne 1 0 0 255 ECU_ADDRESS 0x7001634C /end MEASUREMENT
/begin MEASUREMENT dataJ1939Dm1Failrs_as[31].dtc_as[19].occ_u8 "" UBYTE CnvRule_NumberOneToOne 1 0 0 255 ECU_ADDRESS 0x7001634D /end MEASUREMENT
/begin MEASUREMENT dataJ1939Dm1Failrs_as[31].dtc_as[20].spn_u32 "" ULONG CnvRule_NumberOneToOne 1 0 0 4294967295 ECU_ADDRESS 0x70016350 /end MEASUREMENT
/begin MEASUREMENT dataJ1939Dm1Failrs_as[31].dtc_as[20].fmi_u8 "" UBYTE CnvRule_NumberOneToOne 1 0 0 255 ECU_ADDRESS 0x70016354 /end MEASUREMENT
/begin MEASUREMENT dataJ1939Dm1Failrs_as[31].dtc_as[20].occ_u8 "" UBYTE CnvRule_NumberOneToOne 1 0 0 255 ECU_ADDRESS 0x70016355 /end MEASUREMENT
/begin MEASUREMENT dataJ1939Dm1Failrs_as[31].dtc_as "" UBYTE CnvRule_NumberOneToOne 1 0 0 255 ECU_ADDRESS 0x700162B8 ARRAY_SIZE 160 /end MEASUREMENT
/begin MEASUREMENT dataJ1939Dm1Failrs_as[32].dtc_as[1].spn_u32 "" ULONG CnvRule_NumberOneToOne 1 0 0 4294967295 ECU_ADDRESS 0x7001635C /end MEASUREMENT
/begin MEASUREMENT dataJ1939Dm1Failrs_as[32].dtc_as[1].fmi_u8 "" UBYTE CnvRule_NumberOneToOne 1 0 0 255 ECU_ADDRESS 0x70016360 /end MEASUREMENT
/begin MEASUREMENT dataJ1939Dm1Failrs_as[32].dtc_as[1].occ_u8 "" UBYTE CnvRule_NumberOneToOne 1 0 0 255 ECU_ADDRESS 0x70016361 /end MEASUREMENT
/begin MEASUREMENT dataJ1939Dm1Failrs_as[32].dtc_as[2].spn_u32 "" ULONG CnvRule_NumberOneToOne 1 0 0 4294967295 ECU_ADDRESS 0x70016364 /end MEASUREMENT
/begin MEASUREMENT dataJ1939Dm1Failrs_as[32].dtc_as[2].fmi_u8 "" UBYTE CnvRule_NumberOneToOne 1 0 0 255 ECU_ADDRESS 0x70016368 /end MEASUREMENT
/begin MEASUREMENT dataJ1939Dm1Failrs_as[32].dtc_as[2].occ_u8 "" UBYTE CnvRule_NumberOneToOne 1 0 0 255 ECU_ADDRESS 0x70016369 /end MEASUREMENT
/begin MEASUREMENT dataJ1939Dm1Failrs_as[32].dtc_as[3].spn_u32 "" ULONG CnvRule_NumberOneToOne 1 0 0 4294967295 ECU_ADDRESS 0x7001636C /end MEASUREMENT
/begin MEASUREMENT dataJ1939Dm1Failrs_as[32].dtc_as[3].fmi_u8 "" UBYTE CnvRule_NumberOneToOne 1 0 0 255 ECU_ADDRESS 0x70016370 /end MEASUREMENT
/begin MEASUREMENT dataJ1939Dm1Failrs_as[32].dtc_as[3].occ_u8 "" UBYTE CnvRule_NumberOneToOne 1 0 0 255 ECU_ADDRESS 0x70016371 /end MEASUREMENT
/begin MEASUREMENT dataJ1939Dm1Failrs_as[32].dtc_as[4].spn_u32 "" ULONG CnvRule_NumberOneToOne 1 0 0 4294967295 ECU_ADDRESS 0x70016374 /end MEASUREMENT
/begin MEASUREMENT dataJ1939Dm1Failrs_as[32].dtc_as[4].fmi_u8 "" UBYTE CnvRule_NumberOneToOne 1 0 0 255 ECU_ADDRESS 0x70016378 /end MEASUREMENT
/begin MEASUREMENT dataJ1939Dm1Failrs_as[32].dtc_as[4].occ_u8 "" UBYTE CnvRule_NumberOneToOne 1 0 0 255 ECU_ADDRESS 0x70016379 /end MEASUREMENT
/begin MEASUREMENT dataJ1939Dm1Failrs_as[32].dtc_as[5].spn_u32 "" ULONG CnvRule_NumberOneToOne 1 0 0 4294967295 ECU_ADDRESS 0x7001637C /end MEASUREMENT
/begin MEASUREMENT dataJ1939Dm1Failrs_as[32].dtc_as[5].fmi_u8 "" UBYTE CnvRule_NumberOneToOne 1 0 0 255 ECU_ADDRESS 0x70016380 /end MEASUREMENT
/begin MEASUREMENT dataJ1939Dm1Failrs_as[32].dtc_as[5].occ_u8 "" UBYTE CnvRule_NumberOneToOne 1 0 0 255 ECU_ADDRESS 0x70016381 /end MEASUREMENT
/begin MEASUREMENT dataJ1939Dm1Failrs_as[32].dtc_as[6].spn_u32 "" ULONG CnvRule_NumberOneToOne 1 0 0 4294967295 ECU_ADDRESS 0x70016384 /end MEASUREMENT
/begin MEASUREMENT dataJ1939Dm1Failrs_as[32].dtc_as[6].fmi_u8 "" UBYTE CnvRule_NumberOneToOne 1 0 0 255 ECU_ADDRESS 0x70016388 /end MEASUREMENT
/begin MEASUREMENT dataJ1939Dm1Failrs_as[32].dtc_as[6].occ_u8 "" UBYTE CnvRule_NumberOneToOne 1 0 0 255 ECU_ADDRESS 0x70016389 /end MEASUREMENT
/begin MEASUREMENT dataJ1939Dm1Failrs_as[32].dtc_as[7].spn_u32 "" ULONG CnvRule_NumberOneToOne 1 0 0 4294967295 ECU_ADDRESS 0x7001638C /end MEASUREMENT
/begin MEASUREMENT dataJ1939Dm1Failrs_as[32].dtc_as[7].fmi_u8 "" UBYTE CnvRule_NumberOneToOne 1 0 0 255 ECU_ADDRESS 0x70016390 /end MEASUREMENT
/begin MEASUREMENT dataJ1939Dm1Failrs_as[32].dtc_as[7].occ_u8 "" UBYTE CnvRule_NumberOneToOne 1 0 0 255 ECU_ADDRESS 0x70016391 /end MEASUREMENT
/begin MEASUREMENT dataJ1939Dm1Failrs_as[32].dtc_as[8].spn_u32 "" ULONG CnvRule_NumberOneToOne 1 0 0 4294967295 ECU_ADDRESS 0x70016394 /end MEASUREMENT
/begin MEASUREMENT dataJ1939Dm1Failrs_as[32].dtc_as[8].fmi_u8 "" UBYTE CnvRule_NumberOneToOne 1 0 0 255 ECU_ADDRESS 0x70016398 /end MEASUREMENT
/begin MEASUREMENT dataJ1939Dm1Failrs_as[32].dtc_as[8].occ_u8 "" UBYTE CnvRule_NumberOneToOne 1 0 0 255 ECU_ADDRESS 0x70016399 /end MEASUREMENT
/begin MEASUREMENT dataJ1939Dm1Failrs_as[32].dtc_as[9].spn_u32 "" ULONG CnvRule_NumberOneToOne 1 0 0 4294967295 ECU_ADDRESS 0x7001639C /end MEASUREMENT
/begin MEASUREMENT dataJ1939Dm1Failrs_as[32].dtc_as[9].fmi_u8 "" UBYTE CnvRule_NumberOneToOne 1 0 0 255 ECU_ADDRESS 0x700163A0 /end MEASUREMENT
/begin MEASUREMENT dataJ1939Dm1Failrs_as[32].dtc_as[9].occ_u8 "" UBYTE CnvRule_NumberOneToOne 1 0 0 255 ECU_ADDRESS 0x700163A1 /end MEASUREMENT
/begin MEASUREMENT dataJ1939Dm1Failrs_as[32].dtc_as[10].spn_u32 "" ULONG CnvRule_NumberOneToOne 1 0 0 4294967295 ECU_ADDRESS 0x700163A4 /end MEASUREMENT
/begin MEASUREMENT dataJ1939Dm1Failrs_as[32].dtc_as[10].fmi_u8 "" UBYTE CnvRule_NumberOneToOne 1 0 0 255 ECU_ADDRESS 0x700163A8 /end MEASUREMENT
/begin MEASUREMENT dataJ1939Dm1Failrs_as[32].dtc_as[10].occ_u8 "" UBYTE CnvRule_NumberOneToOne 1 0 0 255 ECU_ADDRESS 0x700163A9 /end MEASUREMENT
/begin MEASUREMENT dataJ1939Dm1Failrs_as[32].dtc_as[11].spn_u32 "" ULONG CnvRule_NumberOneToOne 1 0 0 4294967295 ECU_ADDRESS 0x700163AC /end MEASUREMENT
/begin MEASUREMENT dataJ1939Dm1Failrs_as[32].dtc_as[11].fmi_u8 "" UBYTE CnvRule_NumberOneToOne 1 0 0 255 ECU_ADDRESS 0x700163B0 /end MEASUREMENT
/begin MEASUREMENT dataJ1939Dm1Failrs_as[32].dtc_as[11].occ_u8 "" UBYTE CnvRule_NumberOneToOne 1 0 0 255 ECU_ADDRESS 0x700163B1 /end MEASUREMENT
/begin MEASUREMENT dataJ1939Dm1Failrs_as[32].dtc_as[12].spn_u32 "" ULONG CnvRule_NumberOneToOne 1 0 0 4294967295 ECU_ADDRESS 0x700163B4 /end MEASUREMENT
/begin MEASUREMENT dataJ1939Dm1Failrs_as[32].dtc_as[12].fmi_u8 "" UBYTE CnvRule_NumberOneToOne 1 0 0 255 ECU_ADDRESS 0x700163B8 /end MEASUREMENT
/begin MEASUREMENT dataJ1939Dm1Failrs_as[32].dtc_as[12].occ_u8 "" UBYTE CnvRule_NumberOneToOne 1 0 0 255 ECU_ADDRESS 0x700163B9 /end MEASUREMENT
/begin MEASUREMENT dataJ1939Dm1Failrs_as[32].dtc_as[13].spn_u32 "" ULONG CnvRule_NumberOneToOne 1 0 0 4294967295 ECU_ADDRESS 0x700163BC /end MEASUREMENT
/begin MEASUREMENT dataJ1939Dm1Failrs_as[32].dtc_as[13].fmi_u8 "" UBYTE CnvRule_NumberOneToOne 1 0 0 255 ECU_ADDRESS 0x700163C0 /end MEASUREMENT
/begin MEASUREMENT dataJ1939Dm1Failrs_as[32].dtc_as[13].occ_u8 "" UBYTE CnvRule_NumberOneToOne 1 0 0 255 ECU_ADDRESS 0x700163C1 /end MEASUREMENT
/begin MEASUREMENT dataJ1939Dm1Failrs_as[32].dtc_as[14].spn_u32 "" ULONG CnvRule_NumberOneToOne 1 0 0 4294967295 ECU_ADDRESS 0x700163C4 /end MEASUREMENT
/begin MEASUREMENT dataJ1939Dm1Failrs_as[32].dtc_as[14].fmi_u8 "" UBYTE CnvRule_NumberOneToOne 1 0 0 255 ECU_ADDRESS 0x700163C8 /end MEASUREMENT
/begin MEASUREMENT dataJ1939Dm1Failrs_as[32].dtc_as[14].occ_u8 "" UBYTE CnvRule_NumberOneToOne 1 0 0 255 ECU_ADDRESS 0x700163C9 /end MEASUREMENT
/begin MEASUREMENT dataJ1939Dm1Failrs_as[32].dtc_as[15].spn_u32 "" ULONG CnvRule_NumberOneToOne 1 0 0 4294967295 ECU_ADDRESS 0x700163CC /end MEASUREMENT
/begin MEASUREMENT dataJ1939Dm1Failrs_as[32].dtc_as[15].fmi_u8 "" UBYTE CnvRule_NumberOneToOne 1 0 0 255 ECU_ADDRESS 0x700163D0 /end MEASUREMENT
/begin MEASUREMENT dataJ1939Dm1Failrs_as[32].dtc_as[15].occ_u8 "" UBYTE CnvRule_NumberOneToOne 1 0 0 255 ECU_ADDRESS 0x700163D1 /end MEASUREMENT
/begin MEASUREMENT dataJ1939Dm1Failrs_as[32].dtc_as[16].spn_u32 "" ULONG CnvRule_NumberOneToOne 1 0 0 4294967295 ECU_ADDRESS 0x700163D4 /end MEASUREMENT
/begin MEASUREMENT dataJ1939Dm1Failrs_as[32].dtc_as[16].fmi_u8 "" UBYTE CnvRule_NumberOneToOne 1 0 0 255 ECU_ADDRESS 0x700163D8 /end MEASUREMENT
/begin MEASUREMENT dataJ1939Dm1Failrs_as[32].dtc_as[16].occ_u8 "" UBYTE CnvRule_NumberOneToOne 1 0 0 255 ECU_ADDRESS 0x700163D9 /end MEASUREMENT
/begin MEASUREMENT dataJ1939Dm1Failrs_as[32].dtc_as[17].spn_u32 "" ULONG CnvRule_NumberOneToOne 1 0 0 4294967295 ECU_ADDRESS 0x700163DC /end MEASUREMENT
/begin MEASUREMENT dataJ1939Dm1Failrs_as[32].dtc_as[17].fmi_u8 "" UBYTE CnvRule_NumberOneToOne 1 0 0 255 ECU_ADDRESS 0x700163E0 /end MEASUREMENT
/begin MEASUREMENT dataJ1939Dm1Failrs_as[32].dtc_as[17].occ_u8 "" UBYTE CnvRule_NumberOneToOne 1 0 0 255 ECU_ADDRESS 0x700163E1 /end MEASUREMENT
/begin MEASUREMENT dataJ1939Dm1Failrs_as[32].dtc_as[18].spn_u32 "" ULONG CnvRule_NumberOneToOne 1 0 0 4294967295 ECU_ADDRESS 0x700163E4 /end MEASUREMENT
/begin MEASUREMENT dataJ1939Dm1Failrs_as[32].dtc_as[18].fmi_u8 "" UBYTE CnvRule_NumberOneToOne 1 0 0 255 ECU_ADDRESS 0x700163E8 /end MEASUREMENT
/begin MEASUREMENT dataJ1939Dm1Failrs_as[32].dtc_as[18].occ_u8 "" UBYTE CnvRule_NumberOneToOne 1 0 0 255 ECU_ADDRESS 0x700163E9 /end MEASUREMENT
/begin MEASUREMENT dataJ1939Dm1Failrs_as[32].dtc_as[19].spn_u32 "" ULONG CnvRule_NumberOneToOne 1 0 0 4294967295 ECU_ADDRESS 0x700163EC /end MEASUREMENT
/begin MEASUREMENT dataJ1939Dm1Failrs_as[32].dtc_as[19].fmi_u8 "" UBYTE CnvRule_NumberOneToOne 1 0 0 255 ECU_ADDRESS 0x700163F0 /end MEASUREMENT
/begin MEASUREMENT dataJ1939Dm1Failrs_as[32].dtc_as[19].occ_u8 "" UBYTE CnvRule_NumberOneToOne 1 0 0 255 ECU_ADDRESS 0x700163F1 /end MEASUREMENT
/begin MEASUREMENT dataJ1939Dm1Failrs_as[32].dtc_as[20].spn_u32 "" ULONG CnvRule_NumberOneToOne 1 0 0 4294967295 ECU_ADDRESS 0x700163F4 /end MEASUREMENT
/begin MEASUREMENT dataJ1939Dm1Failrs_as[32].dtc_as[20].fmi_u8 "" UBYTE CnvRule_NumberOneToOne 1 0 0 255 ECU_ADDRESS 0x700163F8 /end MEASUREMENT
/begin MEASUREMENT dataJ1939Dm1Failrs_as[32].dtc_as[20].occ_u8 "" UBYTE CnvRule_NumberOneToOne 1 0 0 255 ECU_ADDRESS 0x700163F9 /end MEASUREMENT
/begin MEASUREMENT dataJ1939Dm1Failrs_as[32].dtc_as "" UBYTE CnvRule_NumberOneToOne 1 0 0 255 ECU_ADDRESS 0x7001635C ARRAY_SIZE 160 /end MEASUREMENT
/begin MEASUREMENT dataJ1939Dm1Failrs_as[33].dtc_as[1].spn_u32 "" ULONG CnvRule_NumberOneToOne 1 0 0 4294967295 ECU_ADDRESS 0x70016400 /end MEASUREMENT
/begin MEASUREMENT dataJ1939Dm1Failrs_as[33].dtc_as[1].fmi_u8 "" UBYTE CnvRule_NumberOneToOne 1 0 0 255 ECU_ADDRESS 0x70016404 /end MEASUREMENT
/begin MEASUREMENT dataJ1939Dm1Failrs_as[33].dtc_as[1].occ_u8 "" UBYTE CnvRule_NumberOneToOne 1 0 0 255 ECU_ADDRESS 0x70016405 /end MEASUREMENT
/begin MEASUREMENT dataJ1939Dm1Failrs_as[33].dtc_as[2].spn_u32 "" ULONG CnvRule_NumberOneToOne 1 0 0 4294967295 ECU_ADDRESS 0x70016408 /end MEASUREMENT
/begin MEASUREMENT dataJ1939Dm1Failrs_as[33].dtc_as[2].fmi_u8 "" UBYTE CnvRule_NumberOneToOne 1 0 0 255 ECU_ADDRESS 0x7001640C /end MEASUREMENT
/begin MEASUREMENT dataJ1939Dm1Failrs_as[33].dtc_as[2].occ_u8 "" UBYTE CnvRule_NumberOneToOne 1 0 0 255 ECU_ADDRESS 0x7001640D /end MEASUREMENT
/begin MEASUREMENT dataJ1939Dm1Failrs_as[33].dtc_as[3].spn_u32 "" ULONG CnvRule_NumberOneToOne 1 0 0 4294967295 ECU_ADDRESS 0x70016410 /end MEASUREMENT
/begin MEASUREMENT dataJ1939Dm1Failrs_as[33].dtc_as[3].fmi_u8 "" UBYTE CnvRule_NumberOneToOne 1 0 0 255 ECU_ADDRESS 0x70016414 /end MEASUREMENT
/begin MEASUREMENT dataJ1939Dm1Failrs_as[33].dtc_as[3].occ_u8 "" UBYTE CnvRule_NumberOneToOne 1 0 0 255 ECU_ADDRESS 0x70016415 /end MEASUREMENT
/begin MEASUREMENT dataJ1939Dm1Failrs_as[33].dtc_as[4].spn_u32 "" ULONG CnvRule_NumberOneToOne 1 0 0 4294967295 ECU_ADDRESS 0x70016418 /end MEASUREMENT
/begin MEASUREMENT dataJ1939Dm1Failrs_as[33].dtc_as[4].fmi_u8 "" UBYTE CnvRule_NumberOneToOne 1 0 0 255 ECU_ADDRESS 0x7001641C /end MEASUREMENT
/begin MEASUREMENT dataJ1939Dm1Failrs_as[33].dtc_as[4].occ_u8 "" UBYTE CnvRule_NumberOneToOne 1 0 0 255 ECU_ADDRESS 0x7001641D /end MEASUREMENT
/begin MEASUREMENT dataJ1939Dm1Failrs_as[33].dtc_as[5].spn_u32 "" ULONG CnvRule_NumberOneToOne 1 0 0 4294967295 ECU_ADDRESS 0x70016420 /end MEASUREMENT
/begin MEASUREMENT dataJ1939Dm1Failrs_as[33].dtc_as[5].fmi_u8 "" UBYTE CnvRule_NumberOneToOne 1 0 0 255 ECU_ADDRESS 0x70016424 /end MEASUREMENT
/begin MEASUREMENT dataJ1939Dm1Failrs_as[33].dtc_as[5].occ_u8 "" UBYTE CnvRule_NumberOneToOne 1 0 0 255 ECU_ADDRESS 0x70016425 /end MEASUREMENT
/begin MEASUREMENT dataJ1939Dm1Failrs_as[33].dtc_as[6].spn_u32 "" ULONG CnvRule_NumberOneToOne 1 0 0 4294967295 ECU_ADDRESS 0x70016428 /end MEASUREMENT
/begin MEASUREMENT dataJ1939Dm1Failrs_as[33].dtc_as[6].fmi_u8 "" UBYTE CnvRule_NumberOneToOne 1 0 0 255 ECU_ADDRESS 0x7001642C /end MEASUREMENT
/begin MEASUREMENT dataJ1939Dm1Failrs_as[33].dtc_as[6].occ_u8 "" UBYTE CnvRule_NumberOneToOne 1 0 0 255 ECU_ADDRESS 0x7001642D /end MEASUREMENT
/begin MEASUREMENT dataJ1939Dm1Failrs_as[33].dtc_as[7].spn_u32 "" ULONG CnvRule_NumberOneToOne 1 0 0 4294967295 ECU_ADDRESS 0x70016430 /end MEASUREMENT
/begin MEASUREMENT dataJ1939Dm1Failrs_as[33].dtc_as[7].fmi_u8 "" UBYTE CnvRule_NumberOneToOne 1 0 0 255 ECU_ADDRESS 0x70016434 /end MEASUREMENT
/begin MEASUREMENT dataJ1939Dm1Failrs_as[33].dtc_as[7].occ_u8 "" UBYTE CnvRule_NumberOneToOne 1 0 0 255 ECU_ADDRESS 0x70016435 /end MEASUREMENT
/begin MEASUREMENT dataJ1939Dm1Failrs_as[33].dtc_as[8].spn_u32 "" ULONG CnvRule_NumberOneToOne 1 0 0 4294967295 ECU_ADDRESS 0x70016438 /end MEASUREMENT
/begin MEASUREMENT dataJ1939Dm1Failrs_as[33].dtc_as[8].fmi_u8 "" UBYTE CnvRule_NumberOneToOne 1 0 0 255 ECU_ADDRESS 0x7001643C /end MEASUREMENT
/begin MEASUREMENT dataJ1939Dm1Failrs_as[33].dtc_as[8].occ_u8 "" UBYTE CnvRule_NumberOneToOne 1 0 0 255 ECU_ADDRESS 0x7001643D /end MEASUREMENT
/begin MEASUREMENT dataJ1939Dm1Failrs_as[33].dtc_as[9].spn_u32 "" ULONG CnvRule_NumberOneToOne 1 0 0 4294967295 ECU_ADDRESS 0x70016440 /end MEASUREMENT
/begin MEASUREMENT dataJ1939Dm1Failrs_as[33].dtc_as[9].fmi_u8 "" UBYTE CnvRule_NumberOneToOne 1 0 0 255 ECU_ADDRESS 0x70016444 /end MEASUREMENT
/begin MEASUREMENT dataJ1939Dm1Failrs_as[33].dtc_as[9].occ_u8 "" UBYTE CnvRule_NumberOneToOne 1 0 0 255 ECU_ADDRESS 0x70016445 /end MEASUREMENT
/begin MEASUREMENT dataJ1939Dm1Failrs_as[33].dtc_as[10].spn_u32 "" ULONG CnvRule_NumberOneToOne 1 0 0 4294967295 ECU_ADDRESS 0x70016448 /end MEASUREMENT
/begin MEASUREMENT dataJ1939Dm1Failrs_as[33].dtc_as[10].fmi_u8 "" UBYTE CnvRule_NumberOneToOne 1 0 0 255 ECU_ADDRESS 0x7001644C /end MEASUREMENT
/begin MEASUREMENT dataJ1939Dm1Failrs_as[33].dtc_as[10].occ_u8 "" UBYTE CnvRule_NumberOneToOne 1 0 0 255 ECU_ADDRESS 0x7001644D /end MEASUREMENT
/begin MEASUREMENT dataJ1939Dm1Failrs_as[33].dtc_as[11].spn_u32 "" ULONG CnvRule_NumberOneToOne 1 0 0 4294967295 ECU_ADDRESS 0x70016450 /end MEASUREMENT
/begin MEASUREMENT dataJ1939Dm1Failrs_as[33].dtc_as[11].fmi_u8 "" UBYTE CnvRule_NumberOneToOne 1 0 0 255 ECU_ADDRESS 0x70016454 /end MEASUREMENT
/begin MEASUREMENT dataJ1939Dm1Failrs_as[33].dtc_as[11].occ_u8 "" UBYTE CnvRule_NumberOneToOne 1 0 0 255 ECU_ADDRESS 0x70016455 /end MEASUREMENT
/begin MEASUREMENT dataJ1939Dm1Failrs_as[33].dtc_as[12].spn_u32 "" ULONG CnvRule_NumberOneToOne 1 0 0 4294967295 ECU_ADDRESS 0x70016458 /end MEASUREMENT
/begin MEASUREMENT dataJ1939Dm1Failrs_as[33].dtc_as[12].fmi_u8 "" UBYTE CnvRule_NumberOneToOne 1 0 0 255 ECU_ADDRESS 0x7001645C /end MEASUREMENT
/begin MEASUREMENT dataJ1939Dm1Failrs_as[33].dtc_as[12].occ_u8 "" UBYTE CnvRule_NumberOneToOne 1 0 0 255 ECU_ADDRESS 0x7001645D /end MEASUREMENT
/begin MEASUREMENT dataJ1939Dm1Failrs_as[33].dtc_as[13].spn_u32 "" ULONG CnvRule_NumberOneToOne 1 0 0 4294967295 ECU_ADDRESS 0x70016460 /end MEASUREMENT
/begin MEASUREMENT dataJ1939Dm1Failrs_as[33].dtc_as[13].fmi_u8 "" UBYTE CnvRule_NumberOneToOne 1 0 0 255 ECU_ADDRESS 0x70016464 /end MEASUREMENT
/begin MEASUREMENT dataJ1939Dm1Failrs_as[33].dtc_as[13].occ_u8 "" UBYTE CnvRule_NumberOneToOne 1 0 0 255 ECU_ADDRESS 0x70016465 /end MEASUREMENT
/begin MEASUREMENT dataJ1939Dm1Failrs_as[33].dtc_as[14].spn_u32 "" ULONG CnvRule_NumberOneToOne 1 0 0 4294967295 ECU_ADDRESS 0x70016468 /end MEASUREMENT
/begin MEASUREMENT dataJ1939Dm1Failrs_as[33].dtc_as[14].fmi_u8 "" UBYTE CnvRule_NumberOneToOne 1 0 0 255 ECU_ADDRESS 0x7001646C /end MEASUREMENT
/begin MEASUREMENT dataJ1939Dm1Failrs_as[33].dtc_as[14].occ_u8 "" UBYTE CnvRule_NumberOneToOne 1 0 0 255 ECU_ADDRESS 0x7001646D /end MEASUREMENT
/begin MEASUREMENT dataJ1939Dm1Failrs_as[33].dtc_as[15].spn_u32 "" ULONG CnvRule_NumberOneToOne 1 0 0 4294967295 ECU_ADDRESS 0x70016470 /end MEASUREMENT
/begin MEASUREMENT dataJ1939Dm1Failrs_as[33].dtc_as[15].fmi_u8 "" UBYTE CnvRule_NumberOneToOne 1 0 0 255 ECU_ADDRESS 0x70016474 /end MEASUREMENT
/begin MEASUREMENT dataJ1939Dm1Failrs_as[33].dtc_as[15].occ_u8 "" UBYTE CnvRule_NumberOneToOne 1 0 0 255 ECU_ADDRESS 0x70016475 /end MEASUREMENT
/begin MEASUREMENT dataJ1939Dm1Failrs_as[33].dtc_as[16].spn_u32 "" ULONG CnvRule_NumberOneToOne 1 0 0 4294967295 ECU_ADDRESS 0x70016478 /end MEASUREMENT
/begin MEASUREMENT dataJ1939Dm1Failrs_as[33].dtc_as[16].fmi_u8 "" UBYTE CnvRule_NumberOneToOne 1 0 0 255 ECU_ADDRESS 0x7001647C /end MEASUREMENT
/begin MEASUREMENT dataJ1939Dm1Failrs_as[33].dtc_as[16].occ_u8 "" UBYTE CnvRule_NumberOneToOne 1 0 0 255 ECU_ADDRESS 0x7001647D /end MEASUREMENT
/begin MEASUREMENT dataJ1939Dm1Failrs_as[33].dtc_as[17].spn_u32 "" ULONG CnvRule_NumberOneToOne 1 0 0 4294967295 ECU_ADDRESS 0x70016480 /end MEASUREMENT
/begin MEASUREMENT dataJ1939Dm1Failrs_as[33].dtc_as[17].fmi_u8 "" UBYTE CnvRule_NumberOneToOne 1 0 0 255 ECU_ADDRESS 0x70016484 /end MEASUREMENT
/begin MEASUREMENT dataJ1939Dm1Failrs_as[33].dtc_as[17].occ_u8 "" UBYTE CnvRule_NumberOneToOne 1 0 0 255 ECU_ADDRESS 0x70016485 /end MEASUREMENT
/begin MEASUREMENT dataJ1939Dm1Failrs_as[33].dtc_as[18].spn_u32 "" ULONG CnvRule_NumberOneToOne 1 0 0 4294967295 ECU_ADDRESS 0x70016488 /end MEASUREMENT
/begin MEASUREMENT dataJ1939Dm1Failrs_as[33].dtc_as[18].fmi_u8 "" UBYTE CnvRule_NumberOneToOne 1 0 0 255 ECU_ADDRESS 0x7001648C /end MEASUREMENT
/begin MEASUREMENT dataJ1939Dm1Failrs_as[33].dtc_as[18].occ_u8 "" UBYTE CnvRule_NumberOneToOne 1 0 0 255 ECU_ADDRESS 0x7001648D /end MEASUREMENT
/begin MEASUREMENT dataJ1939Dm1Failrs_as[33].dtc_as[19].spn_u32 "" ULONG CnvRule_NumberOneToOne 1 0 0 4294967295 ECU_ADDRESS 0x70016490 /end MEASUREMENT
/begin MEASUREMENT dataJ1939Dm1Failrs_as[33].dtc_as[19].fmi_u8 "" UBYTE CnvRule_NumberOneToOne 1 0 0 255 ECU_ADDRESS 0x70016494 /end MEASUREMENT
/begin MEASUREMENT dataJ1939Dm1Failrs_as[33].dtc_as[19].occ_u8 "" UBYTE CnvRule_NumberOneToOne 1 0 0 255 ECU_ADDRESS 0x70016495 /end MEASUREMENT
/begin MEASUREMENT dataJ1939Dm1Failrs_as[33].dtc_as[20].spn_u32 "" ULONG CnvRule_NumberOneToOne 1 0 0 4294967295 ECU_ADDRESS 0x70016498 /end MEASUREMENT
/begin MEASUREMENT dataJ1939Dm1Failrs_as[33].dtc_as[20].fmi_u8 "" UBYTE CnvRule_NumberOneToOne 1 0 0 255 ECU_ADDRESS 0x7001649C /end MEASUREMENT
/begin MEASUREMENT dataJ1939Dm1Failrs_as[33].dtc_as[20].occ_u8 "" UBYTE CnvRule_NumberOneToOne 1 0 0 255 ECU_ADDRESS 0x7001649D /end MEASUREMENT
/begin MEASUREMENT dataJ1939Dm1Failrs_as[33].dtc_as "" UBYTE CnvRule_NumberOneToOne 1 0 0 255 ECU_ADDRESS 0x70016400 ARRAY_SIZE 160 /end MEASUREMENT
/begin MEASUREMENT dataJ1939Dm1Failrs_as[34].dtc_as[1].spn_u32 "" ULONG CnvRule_NumberOneToOne 1 0 0 4294967295 ECU_ADDRESS 0x700164A4 /end MEASUREMENT
/begin MEASUREMENT dataJ1939Dm1Failrs_as[34].dtc_as[1].fmi_u8 "" UBYTE CnvRule_NumberOneToOne 1 0 0 255 ECU_ADDRESS 0x700164A8 /end MEASUREMENT
/begin MEASUREMENT dataJ1939Dm1Failrs_as[34].dtc_as[1].occ_u8 "" UBYTE CnvRule_NumberOneToOne 1 0 0 255 ECU_ADDRESS 0x700164A9 /end MEASUREMENT
/begin MEASUREMENT dataJ1939Dm1Failrs_as[34].dtc_as[2].spn_u32 "" ULONG CnvRule_NumberOneToOne 1 0 0 4294967295 ECU_ADDRESS 0x700164AC /end MEASUREMENT
/begin MEASUREMENT dataJ1939Dm1Failrs_as[34].dtc_as[2].fmi_u8 "" UBYTE CnvRule_NumberOneToOne 1 0 0 255 ECU_ADDRESS 0x700164B0 /end MEASUREMENT
/begin MEASUREMENT dataJ1939Dm1Failrs_as[34].dtc_as[2].occ_u8 "" UBYTE CnvRule_NumberOneToOne 1 0 0 255 ECU_ADDRESS 0x700164B1 /end MEASUREMENT
/begin MEASUREMENT dataJ1939Dm1Failrs_as[34].dtc_as[3].spn_u32 "" ULONG CnvRule_NumberOneToOne 1 0 0 4294967295 ECU_ADDRESS 0x700164B4 /end MEASUREMENT
/begin MEASUREMENT dataJ1939Dm1Failrs_as[34].dtc_as[3].fmi_u8 "" UBYTE CnvRule_NumberOneToOne 1 0 0 255 ECU_ADDRESS 0x700164B8 /end MEASUREMENT
/begin MEASUREMENT dataJ1939Dm1Failrs_as[34].dtc_as[3].occ_u8 "" UBYTE CnvRule_NumberOneToOne 1 0 0 255 ECU_ADDRESS 0x700164B9 /end MEASUREMENT
/begin MEASUREMENT dataJ1939Dm1Failrs_as[34].dtc_as[4].spn_u32 "" ULONG CnvRule_NumberOneToOne 1 0 0 4294967295 ECU_ADDRESS 0x700164BC /end MEASUREMENT
/begin MEASUREMENT dataJ1939Dm1Failrs_as[34].dtc_as[4].fmi_u8 "" UBYTE CnvRule_NumberOneToOne 1 0 0 255 ECU_ADDRESS 0x700164C0 /end MEASUREMENT
/begin MEASUREMENT dataJ1939Dm1Failrs_as[34].dtc_as[4].occ_u8 "" UBYTE CnvRule_NumberOneToOne 1 0 0 255 ECU_ADDRESS 0x700164C1 /end MEASUREMENT
/begin MEASUREMENT dataJ1939Dm1Failrs_as[34].dtc_as[5].spn_u32 "" ULONG CnvRule_NumberOneToOne 1 0 0 4294967295 ECU_ADDRESS 0x700164C4 /end MEASUREMENT
/begin MEASUREMENT dataJ1939Dm1Failrs_as[34].dtc_as[5].fmi_u8 "" UBYTE CnvRule_NumberOneToOne 1 0 0 255 ECU_ADDRESS 0x700164C8 /end MEASUREMENT
/begin MEASUREMENT dataJ1939Dm1Failrs_as[34].dtc_as[5].occ_u8 "" UBYTE CnvRule_NumberOneToOne 1 0 0 255 ECU_ADDRESS 0x700164C9 /end MEASUREMENT
/begin MEASUREMENT dataJ1939Dm1Failrs_as[34].dtc_as[6].spn_u32 "" ULONG CnvRule_NumberOneToOne 1 0 0 4294967295 ECU_ADDRESS 0x700164CC /end MEASUREMENT
/begin MEASUREMENT dataJ1939Dm1Failrs_as[34].dtc_as[6].fmi_u8 "" UBYTE CnvRule_NumberOneToOne 1 0 0 255 ECU_ADDRESS 0x700164D0 /end MEASUREMENT
/begin MEASUREMENT dataJ1939Dm1Failrs_as[34].dtc_as[6].occ_u8 "" UBYTE CnvRule_NumberOneToOne 1 0 0 255 ECU_ADDRESS 0x700164D1 /end MEASUREMENT
/begin MEASUREMENT dataJ1939Dm1Failrs_as[34].dtc_as[7].spn_u32 "" ULONG CnvRule_NumberOneToOne 1 0 0 4294967295 ECU_ADDRESS 0x700164D4 /end MEASUREMENT
/begin MEASUREMENT dataJ1939Dm1Failrs_as[34].dtc_as[7].fmi_u8 "" UBYTE CnvRule_NumberOneToOne 1 0 0 255 ECU_ADDRESS 0x700164D8 /end MEASUREMENT
/begin MEASUREMENT dataJ1939Dm1Failrs_as[34].dtc_as[7].occ_u8 "" UBYTE CnvRule_NumberOneToOne 1 0 0 255 ECU_ADDRESS 0x700164D9 /end MEASUREMENT
/begin MEASUREMENT dataJ1939Dm1Failrs_as[34].dtc_as[8].spn_u32 "" ULONG CnvRule_NumberOneToOne 1 0 0 4294967295 ECU_ADDRESS 0x700164DC /end MEASUREMENT
/begin MEASUREMENT dataJ1939Dm1Failrs_as[34].dtc_as[8].fmi_u8 "" UBYTE CnvRule_NumberOneToOne 1 0 0 255 ECU_ADDRESS 0x700164E0 /end MEASUREMENT
/begin MEASUREMENT dataJ1939Dm1Failrs_as[34].dtc_as[8].occ_u8 "" UBYTE CnvRule_NumberOneToOne 1 0 0 255 ECU_ADDRESS 0x700164E1 /end MEASUREMENT
/begin MEASUREMENT dataJ1939Dm1Failrs_as[34].dtc_as[9].spn_u32 "" ULONG CnvRule_NumberOneToOne 1 0 0 4294967295 ECU_ADDRESS 0x700164E4 /end MEASUREMENT
/begin MEASUREMENT dataJ1939Dm1Failrs_as[34].dtc_as[9].fmi_u8 "" UBYTE CnvRule_NumberOneToOne 1 0 0 255 ECU_ADDRESS 0x700164E8 /end MEASUREMENT
/begin MEASUREMENT dataJ1939Dm1Failrs_as[34].dtc_as[9].occ_u8 "" UBYTE CnvRule_NumberOneToOne 1 0 0 255 ECU_ADDRESS 0x700164E9 /end MEASUREMENT
/begin MEASUREMENT dataJ1939Dm1Failrs_as[34].dtc_as[10].spn_u32 "" ULONG CnvRule_NumberOneToOne 1 0 0 4294967295 ECU_ADDRESS 0x700164EC /end MEASUREMENT
/begin MEASUREMENT dataJ1939Dm1Failrs_as[34].dtc_as[10].fmi_u8 "" UBYTE CnvRule_NumberOneToOne 1 0 0 255 ECU_ADDRESS 0x700164F0 /end MEASUREMENT
/begin MEASUREMENT dataJ1939Dm1Failrs_as[34].dtc_as[10].occ_u8 "" UBYTE CnvRule_NumberOneToOne 1 0 0 255 ECU_ADDRESS 0x700164F1 /end MEASUREMENT
/begin MEASUREMENT dataJ1939Dm1Failrs_as[34].dtc_as[11].spn_u32 "" ULONG CnvRule_NumberOneToOne 1 0 0 4294967295 ECU_ADDRESS 0x700164F4 /end MEASUREMENT
/begin MEASUREMENT dataJ1939Dm1Failrs_as[34].dtc_as[11].fmi_u8 "" UBYTE CnvRule_NumberOneToOne 1 0 0 255 ECU_ADDRESS 0x700164F8 /end MEASUREMENT
/begin MEASUREMENT dataJ1939Dm1Failrs_as[34].dtc_as[11].occ_u8 "" UBYTE CnvRule_NumberOneToOne 1 0 0 255 ECU_ADDRESS 0x700164F9 /end MEASUREMENT
/begin MEASUREMENT dataJ1939Dm1Failrs_as[34].dtc_as[12].spn_u32 "" ULONG CnvRule_NumberOneToOne 1 0 0 4294967295 ECU_ADDRESS 0x700164FC /end MEASUREMENT
/begin MEASUREMENT dataJ1939Dm1Failrs_as[34].dtc_as[12].fmi_u8 "" UBYTE CnvRule_NumberOneToOne 1 0 0 255 ECU_ADDRESS 0x70016500 /end MEASUREMENT
/begin MEASUREMENT dataJ1939Dm1Failrs_as[34].dtc_as[12].occ_u8 "" UBYTE CnvRule_NumberOneToOne 1 0 0 255 ECU_ADDRESS 0x70016501 /end MEASUREMENT
/begin MEASUREMENT dataJ1939Dm1Failrs_as[34].dtc_as[13].spn_u32 "" ULONG CnvRule_NumberOneToOne 1 0 0 4294967295 ECU_ADDRESS 0x70016504 /end MEASUREMENT
/begin MEASUREMENT dataJ1939Dm1Failrs_as[34].dtc_as[13].fmi_u8 "" UBYTE CnvRule_NumberOneToOne 1 0 0 255 ECU_ADDRESS 0x70016508 /end MEASUREMENT
/begin MEASUREMENT dataJ1939Dm1Failrs_as[34].dtc_as[13].occ_u8 "" UBYTE CnvRule_NumberOneToOne 1 0 0 255 ECU_ADDRESS 0x70016509 /end MEASUREMENT
/begin MEASUREMENT dataJ1939Dm1Failrs_as[34].dtc_as[14].spn_u32 "" ULONG CnvRule_NumberOneToOne 1 0 0 4294967295 ECU_ADDRESS 0x7001650C /end MEASUREMENT
/begin MEASUREMENT dataJ1939Dm1Failrs_as[34].dtc_as[14].fmi_u8 "" UBYTE CnvRule_NumberOneToOne 1 0 0 255 ECU_ADDRESS 0x70016510 /end MEASUREMENT
/begin MEASUREMENT dataJ1939Dm1Failrs_as[34].dtc_as[14].occ_u8 "" UBYTE CnvRule_NumberOneToOne 1 0 0 255 ECU_ADDRESS 0x70016511 /end MEASUREMENT
/begin MEASUREMENT dataJ1939Dm1Failrs_as[34].dtc_as[15].spn_u32 "" ULONG CnvRule_NumberOneToOne 1 0 0 4294967295 ECU_ADDRESS 0x70016514 /end MEASUREMENT
/begin MEASUREMENT dataJ1939Dm1Failrs_as[34].dtc_as[15].fmi_u8 "" UBYTE CnvRule_NumberOneToOne 1 0 0 255 ECU_ADDRESS 0x70016518 /end MEASUREMENT
/begin MEASUREMENT dataJ1939Dm1Failrs_as[34].dtc_as[15].occ_u8 "" UBYTE CnvRule_NumberOneToOne 1 0 0 255 ECU_ADDRESS 0x70016519 /end MEASUREMENT
/begin MEASUREMENT dataJ1939Dm1Failrs_as[34].dtc_as[16].spn_u32 "" ULONG CnvRule_NumberOneToOne 1 0 0 4294967295 ECU_ADDRESS 0x7001651C /end MEASUREMENT
/begin MEASUREMENT dataJ1939Dm1Failrs_as[34].dtc_as[16].fmi_u8 "" UBYTE CnvRule_NumberOneToOne 1 0 0 255 ECU_ADDRESS 0x70016520 /end MEASUREMENT
/begin MEASUREMENT dataJ1939Dm1Failrs_as[34].dtc_as[16].occ_u8 "" UBYTE CnvRule_NumberOneToOne 1 0 0 255 ECU_ADDRESS 0x70016521 /end MEASUREMENT
/begin MEASUREMENT dataJ1939Dm1Failrs_as[34].dtc_as[17].spn_u32 "" ULONG CnvRule_NumberOneToOne 1 0 0 4294967295 ECU_ADDRESS 0x70016524 /end MEASUREMENT
/begin MEASUREMENT dataJ1939Dm1Failrs_as[34].dtc_as[17].fmi_u8 "" UBYTE CnvRule_NumberOneToOne 1 0 0 255 ECU_ADDRESS 0x70016528 /end MEASUREMENT
/begin MEASUREMENT dataJ1939Dm1Failrs_as[34].dtc_as[17].occ_u8 "" UBYTE CnvRule_NumberOneToOne 1 0 0 255 ECU_ADDRESS 0x70016529 /end MEASUREMENT
/begin MEASUREMENT dataJ1939Dm1Failrs_as[34].dtc_as[18].spn_u32 "" ULONG CnvRule_NumberOneToOne 1 0 0 4294967295 ECU_ADDRESS 0x7001652C /end MEASUREMENT
/begin MEASUREMENT dataJ1939Dm1Failrs_as[34].dtc_as[18].fmi_u8 "" UBYTE CnvRule_NumberOneToOne 1 0 0 255 ECU_ADDRESS 0x70016530 /end MEASUREMENT
/begin MEASUREMENT dataJ1939Dm1Failrs_as[34].dtc_as[18].occ_u8 "" UBYTE CnvRule_NumberOneToOne 1 0 0 255 ECU_ADDRESS 0x70016531 /end MEASUREMENT
/begin MEASUREMENT dataJ1939Dm1Failrs_as[34].dtc_as[19].spn_u32 "" ULONG CnvRule_NumberOneToOne 1 0 0 4294967295 ECU_ADDRESS 0x70016534 /end MEASUREMENT
/begin MEASUREMENT dataJ1939Dm1Failrs_as[34].dtc_as[19].fmi_u8 "" UBYTE CnvRule_NumberOneToOne 1 0 0 255 ECU_ADDRESS 0x70016538 /end MEASUREMENT
/begin MEASUREMENT dataJ1939Dm1Failrs_as[34].dtc_as[19].occ_u8 "" UBYTE CnvRule_NumberOneToOne 1 0 0 255 ECU_ADDRESS 0x70016539 /end MEASUREMENT
/begin MEASUREMENT dataJ1939Dm1Failrs_as[34].dtc_as[20].spn_u32 "" ULONG CnvRule_NumberOneToOne 1 0 0 4294967295 ECU_ADDRESS 0x7001653C /end MEASUREMENT
/begin MEASUREMENT dataJ1939Dm1Failrs_as[34].dtc_as[20].fmi_u8 "" UBYTE CnvRule_NumberOneToOne 1 0 0 255 ECU_ADDRESS 0x70016540 /end MEASUREMENT
/begin MEASUREMENT dataJ1939Dm1Failrs_as[34].dtc_as[20].occ_u8 "" UBYTE CnvRule_NumberOneToOne 1 0 0 255 ECU_ADDRESS 0x70016541 /end MEASUREMENT
/begin MEASUREMENT dataJ1939Dm1Failrs_as[34].dtc_as "" UBYTE CnvRule_NumberOneToOne 1 0 0 255 ECU_ADDRESS 0x700164A4 ARRAY_SIZE 160 /end MEASUREMENT
/begin MEASUREMENT dataJ1939Dm1Failrs_as[35].dtc_as[1].spn_u32 "" ULONG CnvRule_NumberOneToOne 1 0 0 4294967295 ECU_ADDRESS 0x70016548 /end MEASUREMENT
/begin MEASUREMENT dataJ1939Dm1Failrs_as[35].dtc_as[1].fmi_u8 "" UBYTE CnvRule_NumberOneToOne 1 0 0 255 ECU_ADDRESS 0x7001654C /end MEASUREMENT
/begin MEASUREMENT dataJ1939Dm1Failrs_as[35].dtc_as[1].occ_u8 "" UBYTE CnvRule_NumberOneToOne 1 0 0 255 ECU_ADDRESS 0x7001654D /end MEASUREMENT
/begin MEASUREMENT dataJ1939Dm1Failrs_as[35].dtc_as[2].spn_u32 "" ULONG CnvRule_NumberOneToOne 1 0 0 4294967295 ECU_ADDRESS 0x70016550 /end MEASUREMENT
/begin MEASUREMENT dataJ1939Dm1Failrs_as[35].dtc_as[2].fmi_u8 "" UBYTE CnvRule_NumberOneToOne 1 0 0 255 ECU_ADDRESS 0x70016554 /end MEASUREMENT
/begin MEASUREMENT dataJ1939Dm1Failrs_as[35].dtc_as[2].occ_u8 "" UBYTE CnvRule_NumberOneToOne 1 0 0 255 ECU_ADDRESS 0x70016555 /end MEASUREMENT
/begin MEASUREMENT dataJ1939Dm1Failrs_as[35].dtc_as[3].spn_u32 "" ULONG CnvRule_NumberOneToOne 1 0 0 4294967295 ECU_ADDRESS 0x70016558 /end MEASUREMENT
/begin MEASUREMENT dataJ1939Dm1Failrs_as[35].dtc_as[3].fmi_u8 "" UBYTE CnvRule_NumberOneToOne 1 0 0 255 ECU_ADDRESS 0x7001655C /end MEASUREMENT
/begin MEASUREMENT dataJ1939Dm1Failrs_as[35].dtc_as[3].occ_u8 "" UBYTE CnvRule_NumberOneToOne 1 0 0 255 ECU_ADDRESS 0x7001655D /end MEASUREMENT
/begin MEASUREMENT dataJ1939Dm1Failrs_as[35].dtc_as[4].spn_u32 "" ULONG CnvRule_NumberOneToOne 1 0 0 4294967295 ECU_ADDRESS 0x70016560 /end MEASUREMENT
/begin MEASUREMENT dataJ1939Dm1Failrs_as[35].dtc_as[4].fmi_u8 "" UBYTE CnvRule_NumberOneToOne 1 0 0 255 ECU_ADDRESS 0x70016564 /end MEASUREMENT
/begin MEASUREMENT dataJ1939Dm1Failrs_as[35].dtc_as[4].occ_u8 "" UBYTE CnvRule_NumberOneToOne 1 0 0 255 ECU_ADDRESS 0x70016565 /end MEASUREMENT
/begin MEASUREMENT dataJ1939Dm1Failrs_as[35].dtc_as[5].spn_u32 "" ULONG CnvRule_NumberOneToOne 1 0 0 4294967295 ECU_ADDRESS 0x70016568 /end MEASUREMENT
/begin MEASUREMENT dataJ1939Dm1Failrs_as[35].dtc_as[5].fmi_u8 "" UBYTE CnvRule_NumberOneToOne 1 0 0 255 ECU_ADDRESS 0x7001656C /end MEASUREMENT
/begin MEASUREMENT dataJ1939Dm1Failrs_as[35].dtc_as[5].occ_u8 "" UBYTE CnvRule_NumberOneToOne 1 0 0 255 ECU_ADDRESS 0x7001656D /end MEASUREMENT
/begin MEASUREMENT dataJ1939Dm1Failrs_as[35].dtc_as[6].spn_u32 "" ULONG CnvRule_NumberOneToOne 1 0 0 4294967295 ECU_ADDRESS 0x70016570 /end MEASUREMENT
/begin MEASUREMENT dataJ1939Dm1Failrs_as[35].dtc_as[6].fmi_u8 "" UBYTE CnvRule_NumberOneToOne 1 0 0 255 ECU_ADDRESS 0x70016574 /end MEASUREMENT
/begin MEASUREMENT dataJ1939Dm1Failrs_as[35].dtc_as[6].occ_u8 "" UBYTE CnvRule_NumberOneToOne 1 0 0 255 ECU_ADDRESS 0x70016575 /end MEASUREMENT
/begin MEASUREMENT dataJ1939Dm1Failrs_as[35].dtc_as[7].spn_u32 "" ULONG CnvRule_NumberOneToOne 1 0 0 4294967295 ECU_ADDRESS 0x70016578 /end MEASUREMENT
/begin MEASUREMENT dataJ1939Dm1Failrs_as[35].dtc_as[7].fmi_u8 "" UBYTE CnvRule_NumberOneToOne 1 0 0 255 ECU_ADDRESS 0x7001657C /end MEASUREMENT
/begin MEASUREMENT dataJ1939Dm1Failrs_as[35].dtc_as[7].occ_u8 "" UBYTE CnvRule_NumberOneToOne 1 0 0 255 ECU_ADDRESS 0x7001657D /end MEASUREMENT
/begin MEASUREMENT dataJ1939Dm1Failrs_as[35].dtc_as[8].spn_u32 "" ULONG CnvRule_NumberOneToOne 1 0 0 4294967295 ECU_ADDRESS 0x70016580 /end MEASUREMENT
/begin MEASUREMENT dataJ1939Dm1Failrs_as[35].dtc_as[8].fmi_u8 "" UBYTE CnvRule_NumberOneToOne 1 0 0 255 ECU_ADDRESS 0x70016584 /end MEASUREMENT
/begin MEASUREMENT dataJ1939Dm1Failrs_as[35].dtc_as[8].occ_u8 "" UBYTE CnvRule_NumberOneToOne 1 0 0 255 ECU_ADDRESS 0x70016585 /end MEASUREMENT
/begin MEASUREMENT dataJ1939Dm1Failrs_as[35].dtc_as[9].spn_u32 "" ULONG CnvRule_NumberOneToOne 1 0 0 4294967295 ECU_ADDRESS 0x70016588 /end MEASUREMENT
/begin MEASUREMENT dataJ1939Dm1Failrs_as[35].dtc_as[9].fmi_u8 "" UBYTE CnvRule_NumberOneToOne 1 0 0 255 ECU_ADDRESS 0x7001658C /end MEASUREMENT
/begin MEASUREMENT dataJ1939Dm1Failrs_as[35].dtc_as[9].occ_u8 "" UBYTE CnvRule_NumberOneToOne 1 0 0 255 ECU_ADDRESS 0x7001658D /end MEASUREMENT
/begin MEASUREMENT dataJ1939Dm1Failrs_as[35].dtc_as[10].spn_u32 "" ULONG CnvRule_NumberOneToOne 1 0 0 4294967295 ECU_ADDRESS 0x70016590 /end MEASUREMENT
/begin MEASUREMENT dataJ1939Dm1Failrs_as[35].dtc_as[10].fmi_u8 "" UBYTE CnvRule_NumberOneToOne 1 0 0 255 ECU_ADDRESS 0x70016594 /end MEASUREMENT
/begin MEASUREMENT dataJ1939Dm1Failrs_as[35].dtc_as[10].occ_u8 "" UBYTE CnvRule_NumberOneToOne 1 0 0 255 ECU_ADDRESS 0x70016595 /end MEASUREMENT
/begin MEASUREMENT dataJ1939Dm1Failrs_as[35].dtc_as[11].spn_u32 "" ULONG CnvRule_NumberOneToOne 1 0 0 4294967295 ECU_ADDRESS 0x70016598 /end MEASUREMENT
/begin MEASUREMENT dataJ1939Dm1Failrs_as[35].dtc_as[11].fmi_u8 "" UBYTE CnvRule_NumberOneToOne 1 0 0 255 ECU_ADDRESS 0x7001659C /end MEASUREMENT
/begin MEASUREMENT dataJ1939Dm1Failrs_as[35].dtc_as[11].occ_u8 "" UBYTE CnvRule_NumberOneToOne 1 0 0 255 ECU_ADDRESS 0x7001659D /end MEASUREMENT
/begin MEASUREMENT dataJ1939Dm1Failrs_as[35].dtc_as[12].spn_u32 "" ULONG CnvRule_NumberOneToOne 1 0 0 4294967295 ECU_ADDRESS 0x700165A0 /end MEASUREMENT
/begin MEASUREMENT dataJ1939Dm1Failrs_as[35].dtc_as[12].fmi_u8 "" UBYTE CnvRule_NumberOneToOne 1 0 0 255 ECU_ADDRESS 0x700165A4 /end MEASUREMENT
/begin MEASUREMENT dataJ1939Dm1Failrs_as[35].dtc_as[12].occ_u8 "" UBYTE CnvRule_NumberOneToOne 1 0 0 255 ECU_ADDRESS 0x700165A5 /end MEASUREMENT
/begin MEASUREMENT dataJ1939Dm1Failrs_as[35].dtc_as[13].spn_u32 "" ULONG CnvRule_NumberOneToOne 1 0 0 4294967295 ECU_ADDRESS 0x700165A8 /end MEASUREMENT
/begin MEASUREMENT dataJ1939Dm1Failrs_as[35].dtc_as[13].fmi_u8 "" UBYTE CnvRule_NumberOneToOne 1 0 0 255 ECU_ADDRESS 0x700165AC /end MEASUREMENT
/begin MEASUREMENT dataJ1939Dm1Failrs_as[35].dtc_as[13].occ_u8 "" UBYTE CnvRule_NumberOneToOne 1 0 0 255 ECU_ADDRESS 0x700165AD /end MEASUREMENT
/begin MEASUREMENT dataJ1939Dm1Failrs_as[35].dtc_as[14].spn_u32 "" ULONG CnvRule_NumberOneToOne 1 0 0 4294967295 ECU_ADDRESS 0x700165B0 /end MEASUREMENT
/begin MEASUREMENT dataJ1939Dm1Failrs_as[35].dtc_as[14].fmi_u8 "" UBYTE CnvRule_NumberOneToOne 1 0 0 255 ECU_ADDRESS 0x700165B4 /end MEASUREMENT
/begin MEASUREMENT dataJ1939Dm1Failrs_as[35].dtc_as[14].occ_u8 "" UBYTE CnvRule_NumberOneToOne 1 0 0 255 ECU_ADDRESS 0x700165B5 /end MEASUREMENT
/begin MEASUREMENT dataJ1939Dm1Failrs_as[35].dtc_as[15].spn_u32 "" ULONG CnvRule_NumberOneToOne 1 0 0 4294967295 ECU_ADDRESS 0x700165B8 /end MEASUREMENT
/begin MEASUREMENT dataJ1939Dm1Failrs_as[35].dtc_as[15].fmi_u8 "" UBYTE CnvRule_NumberOneToOne 1 0 0 255 ECU_ADDRESS 0x700165BC /end MEASUREMENT
/begin MEASUREMENT dataJ1939Dm1Failrs_as[35].dtc_as[15].occ_u8 "" UBYTE CnvRule_NumberOneToOne 1 0 0 255 ECU_ADDRESS 0x700165BD /end MEASUREMENT
/begin MEASUREMENT dataJ1939Dm1Failrs_as[35].dtc_as[16].spn_u32 "" ULONG CnvRule_NumberOneToOne 1 0 0 4294967295 ECU_ADDRESS 0x700165C0 /end MEASUREMENT
/begin MEASUREMENT dataJ1939Dm1Failrs_as[35].dtc_as[16].fmi_u8 "" UBYTE CnvRule_NumberOneToOne 1 0 0 255 ECU_ADDRESS 0x700165C4 /end MEASUREMENT
/begin MEASUREMENT dataJ1939Dm1Failrs_as[35].dtc_as[16].occ_u8 "" UBYTE CnvRule_NumberOneToOne 1 0 0 255 ECU_ADDRESS 0x700165C5 /end MEASUREMENT
/begin MEASUREMENT dataJ1939Dm1Failrs_as[35].dtc_as[17].spn_u32 "" ULONG CnvRule_NumberOneToOne 1 0 0 4294967295 ECU_ADDRESS 0x700165C8 /end MEASUREMENT
/begin MEASUREMENT dataJ1939Dm1Failrs_as[35].dtc_as[17].fmi_u8 "" UBYTE CnvRule_NumberOneToOne 1 0 0 255 ECU_ADDRESS 0x700165CC /end MEASUREMENT
/begin MEASUREMENT dataJ1939Dm1Failrs_as[35].dtc_as[17].occ_u8 "" UBYTE CnvRule_NumberOneToOne 1 0 0 255 ECU_ADDRESS 0x700165CD /end MEASUREMENT
/begin MEASUREMENT dataJ1939Dm1Failrs_as[35].dtc_as[18].spn_u32 "" ULONG CnvRule_NumberOneToOne 1 0 0 4294967295 ECU_ADDRESS 0x700165D0 /end MEASUREMENT
/begin MEASUREMENT dataJ1939Dm1Failrs_as[35].dtc_as[18].fmi_u8 "" UBYTE CnvRule_NumberOneToOne 1 0 0 255 ECU_ADDRESS 0x700165D4 /end MEASUREMENT
/begin MEASUREMENT dataJ1939Dm1Failrs_as[35].dtc_as[18].occ_u8 "" UBYTE CnvRule_NumberOneToOne 1 0 0 255 ECU_ADDRESS 0x700165D5 /end MEASUREMENT
/begin MEASUREMENT dataJ1939Dm1Failrs_as[35].dtc_as[19].spn_u32 "" ULONG CnvRule_NumberOneToOne 1 0 0 4294967295 ECU_ADDRESS 0x700165D8 /end MEASUREMENT
/begin MEASUREMENT dataJ1939Dm1Failrs_as[35].dtc_as[19].fmi_u8 "" UBYTE CnvRule_NumberOneToOne 1 0 0 255 ECU_ADDRESS 0x700165DC /end MEASUREMENT
/begin MEASUREMENT dataJ1939Dm1Failrs_as[35].dtc_as[19].occ_u8 "" UBYTE CnvRule_NumberOneToOne 1 0 0 255 ECU_ADDRESS 0x700165DD /end MEASUREMENT
/begin MEASUREMENT dataJ1939Dm1Failrs_as[35].dtc_as[20].spn_u32 "" ULONG CnvRule_NumberOneToOne 1 0 0 4294967295 ECU_ADDRESS 0x700165E0 /end MEASUREMENT
/begin MEASUREMENT dataJ1939Dm1Failrs_as[35].dtc_as[20].fmi_u8 "" UBYTE CnvRule_NumberOneToOne 1 0 0 255 ECU_ADDRESS 0x700165E4 /end MEASUREMENT
/begin MEASUREMENT dataJ1939Dm1Failrs_as[35].dtc_as[20].occ_u8 "" UBYTE CnvRule_NumberOneToOne 1 0 0 255 ECU_ADDRESS 0x700165E5 /end MEASUREMENT
/begin MEASUREMENT dataJ1939Dm1Failrs_as[35].dtc_as "" UBYTE CnvRule_NumberOneToOne 1 0 0 255 ECU_ADDRESS 0x70016548 ARRAY_SIZE 160 /end MEASUREMENT
/begin MEASUREMENT dataJ1939Dm1Failrs_as[36].dtc_as[1].spn_u32 "" ULONG CnvRule_NumberOneToOne 1 0 0 4294967295 ECU_ADDRESS 0x700165EC /end MEASUREMENT
/begin MEASUREMENT dataJ1939Dm1Failrs_as[36].dtc_as[1].fmi_u8 "" UBYTE CnvRule_NumberOneToOne 1 0 0 255 ECU_ADDRESS 0x700165F0 /end MEASUREMENT
/begin MEASUREMENT dataJ1939Dm1Failrs_as[36].dtc_as[1].occ_u8 "" UBYTE CnvRule_NumberOneToOne 1 0 0 255 ECU_ADDRESS 0x700165F1 /end MEASUREMENT
/begin MEASUREMENT dataJ1939Dm1Failrs_as[36].dtc_as[2].spn_u32 "" ULONG CnvRule_NumberOneToOne 1 0 0 4294967295 ECU_ADDRESS 0x700165F4 /end MEASUREMENT
/begin MEASUREMENT dataJ1939Dm1Failrs_as[36].dtc_as[2].fmi_u8 "" UBYTE CnvRule_NumberOneToOne 1 0 0 255 ECU_ADDRESS 0x700165F8 /end MEASUREMENT
/begin MEASUREMENT dataJ1939Dm1Failrs_as[36].dtc_as[2].occ_u8 "" UBYTE CnvRule_NumberOneToOne 1 0 0 255 ECU_ADDRESS 0x700165F9 /end MEASUREMENT
/begin MEASUREMENT dataJ1939Dm1Failrs_as[36].dtc_as[3].spn_u32 "" ULONG CnvRule_NumberOneToOne 1 0 0 4294967295 ECU_ADDRESS 0x700165FC /end MEASUREMENT
/begin MEASUREMENT dataJ1939Dm1Failrs_as[36].dtc_as[3].fmi_u8 "" UBYTE CnvRule_NumberOneToOne 1 0 0 255 ECU_ADDRESS 0x70016600 /end MEASUREMENT
/begin MEASUREMENT dataJ1939Dm1Failrs_as[36].dtc_as[3].occ_u8 "" UBYTE CnvRule_NumberOneToOne 1 0 0 255 ECU_ADDRESS 0x70016601 /end MEASUREMENT
/begin MEASUREMENT dataJ1939Dm1Failrs_as[36].dtc_as[4].spn_u32 "" ULONG CnvRule_NumberOneToOne 1 0 0 4294967295 ECU_ADDRESS 0x70016604 /end MEASUREMENT
/begin MEASUREMENT dataJ1939Dm1Failrs_as[36].dtc_as[4].fmi_u8 "" UBYTE CnvRule_NumberOneToOne 1 0 0 255 ECU_ADDRESS 0x70016608 /end MEASUREMENT
/begin MEASUREMENT dataJ1939Dm1Failrs_as[36].dtc_as[4].occ_u8 "" UBYTE CnvRule_NumberOneToOne 1 0 0 255 ECU_ADDRESS 0x70016609 /end MEASUREMENT
/begin MEASUREMENT dataJ1939Dm1Failrs_as[36].dtc_as[5].spn_u32 "" ULONG CnvRule_NumberOneToOne 1 0 0 4294967295 ECU_ADDRESS 0x7001660C /end MEASUREMENT
/begin MEASUREMENT dataJ1939Dm1Failrs_as[36].dtc_as[5].fmi_u8 "" UBYTE CnvRule_NumberOneToOne 1 0 0 255 ECU_ADDRESS 0x70016610 /end MEASUREMENT
/begin MEASUREMENT dataJ1939Dm1Failrs_as[36].dtc_as[5].occ_u8 "" UBYTE CnvRule_NumberOneToOne 1 0 0 255 ECU_ADDRESS 0x70016611 /end MEASUREMENT
/begin MEASUREMENT dataJ1939Dm1Failrs_as[36].dtc_as[6].spn_u32 "" ULONG CnvRule_NumberOneToOne 1 0 0 4294967295 ECU_ADDRESS 0x70016614 /end MEASUREMENT
/begin MEASUREMENT dataJ1939Dm1Failrs_as[36].dtc_as[6].fmi_u8 "" UBYTE CnvRule_NumberOneToOne 1 0 0 255 ECU_ADDRESS 0x70016618 /end MEASUREMENT
/begin MEASUREMENT dataJ1939Dm1Failrs_as[36].dtc_as[6].occ_u8 "" UBYTE CnvRule_NumberOneToOne 1 0 0 255 ECU_ADDRESS 0x70016619 /end MEASUREMENT
/begin MEASUREMENT dataJ1939Dm1Failrs_as[36].dtc_as[7].spn_u32 "" ULONG CnvRule_NumberOneToOne 1 0 0 4294967295 ECU_ADDRESS 0x7001661C /end MEASUREMENT
/begin MEASUREMENT dataJ1939Dm1Failrs_as[36].dtc_as[7].fmi_u8 "" UBYTE CnvRule_NumberOneToOne 1 0 0 255 ECU_ADDRESS 0x70016620 /end MEASUREMENT
/begin MEASUREMENT dataJ1939Dm1Failrs_as[36].dtc_as[7].occ_u8 "" UBYTE CnvRule_NumberOneToOne 1 0 0 255 ECU_ADDRESS 0x70016621 /end MEASUREMENT
/begin MEASUREMENT dataJ1939Dm1Failrs_as[36].dtc_as[8].spn_u32 "" ULONG CnvRule_NumberOneToOne 1 0 0 4294967295 ECU_ADDRESS 0x70016624 /end MEASUREMENT
/begin MEASUREMENT dataJ1939Dm1Failrs_as[36].dtc_as[8].fmi_u8 "" UBYTE CnvRule_NumberOneToOne 1 0 0 255 ECU_ADDRESS 0x70016628 /end MEASUREMENT
/begin MEASUREMENT dataJ1939Dm1Failrs_as[36].dtc_as[8].occ_u8 "" UBYTE CnvRule_NumberOneToOne 1 0 0 255 ECU_ADDRESS 0x70016629 /end MEASUREMENT
/begin MEASUREMENT dataJ1939Dm1Failrs_as[36].dtc_as[9].spn_u32 "" ULONG CnvRule_NumberOneToOne 1 0 0 4294967295 ECU_ADDRESS 0x7001662C /end MEASUREMENT
/begin MEASUREMENT dataJ1939Dm1Failrs_as[36].dtc_as[9].fmi_u8 "" UBYTE CnvRule_NumberOneToOne 1 0 0 255 ECU_ADDRESS 0x70016630 /end MEASUREMENT
/begin MEASUREMENT dataJ1939Dm1Failrs_as[36].dtc_as[9].occ_u8 "" UBYTE CnvRule_NumberOneToOne 1 0 0 255 ECU_ADDRESS 0x70016631 /end MEASUREMENT
/begin MEASUREMENT dataJ1939Dm1Failrs_as[36].dtc_as[10].spn_u32 "" ULONG CnvRule_NumberOneToOne 1 0 0 4294967295 ECU_ADDRESS 0x70016634 /end MEASUREMENT
/begin MEASUREMENT dataJ1939Dm1Failrs_as[36].dtc_as[10].fmi_u8 "" UBYTE CnvRule_NumberOneToOne 1 0 0 255 ECU_ADDRESS 0x70016638 /end MEASUREMENT
/begin MEASUREMENT dataJ1939Dm1Failrs_as[36].dtc_as[10].occ_u8 "" UBYTE CnvRule_NumberOneToOne 1 0 0 255 ECU_ADDRESS 0x70016639 /end MEASUREMENT
/begin MEASUREMENT dataJ1939Dm1Failrs_as[36].dtc_as[11].spn_u32 "" ULONG CnvRule_NumberOneToOne 1 0 0 4294967295 ECU_ADDRESS 0x7001663C /end MEASUREMENT
/begin MEASUREMENT dataJ1939Dm1Failrs_as[36].dtc_as[11].fmi_u8 "" UBYTE CnvRule_NumberOneToOne 1 0 0 255 ECU_ADDRESS 0x70016640 /end MEASUREMENT
/begin MEASUREMENT dataJ1939Dm1Failrs_as[36].dtc_as[11].occ_u8 "" UBYTE CnvRule_NumberOneToOne 1 0 0 255 ECU_ADDRESS 0x70016641 /end MEASUREMENT
/begin MEASUREMENT dataJ1939Dm1Failrs_as[36].dtc_as[12].spn_u32 "" ULONG CnvRule_NumberOneToOne 1 0 0 4294967295 ECU_ADDRESS 0x70016644 /end MEASUREMENT
/begin MEASUREMENT dataJ1939Dm1Failrs_as[36].dtc_as[12].fmi_u8 "" UBYTE CnvRule_NumberOneToOne 1 0 0 255 ECU_ADDRESS 0x70016648 /end MEASUREMENT
/begin MEASUREMENT dataJ1939Dm1Failrs_as[36].dtc_as[12].occ_u8 "" UBYTE CnvRule_NumberOneToOne 1 0 0 255 ECU_ADDRESS 0x70016649 /end MEASUREMENT
/begin MEASUREMENT dataJ1939Dm1Failrs_as[36].dtc_as[13].spn_u32 "" ULONG CnvRule_NumberOneToOne 1 0 0 4294967295 ECU_ADDRESS 0x7001664C /end MEASUREMENT
/begin MEASUREMENT dataJ1939Dm1Failrs_as[36].dtc_as[13].fmi_u8 "" UBYTE CnvRule_NumberOneToOne 1 0 0 255 ECU_ADDRESS 0x70016650 /end MEASUREMENT
/begin MEASUREMENT dataJ1939Dm1Failrs_as[36].dtc_as[13].occ_u8 "" UBYTE CnvRule_NumberOneToOne 1 0 0 255 ECU_ADDRESS 0x70016651 /end MEASUREMENT
/begin MEASUREMENT dataJ1939Dm1Failrs_as[36].dtc_as[14].spn_u32 "" ULONG CnvRule_NumberOneToOne 1 0 0 4294967295 ECU_ADDRESS 0x70016654 /end MEASUREMENT
/begin MEASUREMENT dataJ1939Dm1Failrs_as[36].dtc_as[14].fmi_u8 "" UBYTE CnvRule_NumberOneToOne 1 0 0 255 ECU_ADDRESS 0x70016658 /end MEASUREMENT
/begin MEASUREMENT dataJ1939Dm1Failrs_as[36].dtc_as[14].occ_u8 "" UBYTE CnvRule_NumberOneToOne 1 0 0 255 ECU_ADDRESS 0x70016659 /end MEASUREMENT
/begin MEASUREMENT dataJ1939Dm1Failrs_as[36].dtc_as[15].spn_u32 "" ULONG CnvRule_NumberOneToOne 1 0 0 4294967295 ECU_ADDRESS 0x7001665C /end MEASUREMENT
/begin MEASUREMENT dataJ1939Dm1Failrs_as[36].dtc_as[15].fmi_u8 "" UBYTE CnvRule_NumberOneToOne 1 0 0 255 ECU_ADDRESS 0x70016660 /end MEASUREMENT
/begin MEASUREMENT dataJ1939Dm1Failrs_as[36].dtc_as[15].occ_u8 "" UBYTE CnvRule_NumberOneToOne 1 0 0 255 ECU_ADDRESS 0x70016661 /end MEASUREMENT
/begin MEASUREMENT dataJ1939Dm1Failrs_as[36].dtc_as[16].spn_u32 "" ULONG CnvRule_NumberOneToOne 1 0 0 4294967295 ECU_ADDRESS 0x70016664 /end MEASUREMENT
/begin MEASUREMENT dataJ1939Dm1Failrs_as[36].dtc_as[16].fmi_u8 "" UBYTE CnvRule_NumberOneToOne 1 0 0 255 ECU_ADDRESS 0x70016668 /end MEASUREMENT
/begin MEASUREMENT dataJ1939Dm1Failrs_as[36].dtc_as[16].occ_u8 "" UBYTE CnvRule_NumberOneToOne 1 0 0 255 ECU_ADDRESS 0x70016669 /end MEASUREMENT
/begin MEASUREMENT dataJ1939Dm1Failrs_as[36].dtc_as[17].spn_u32 "" ULONG CnvRule_NumberOneToOne 1 0 0 4294967295 ECU_ADDRESS 0x7001666C /end MEASUREMENT
/begin MEASUREMENT dataJ1939Dm1Failrs_as[36].dtc_as[17].fmi_u8 "" UBYTE CnvRule_NumberOneToOne 1 0 0 255 ECU_ADDRESS 0x70016670 /end MEASUREMENT
/begin MEASUREMENT dataJ1939Dm1Failrs_as[36].dtc_as[17].occ_u8 "" UBYTE CnvRule_NumberOneToOne 1 0 0 255 ECU_ADDRESS 0x70016671 /end MEASUREMENT
/begin MEASUREMENT dataJ1939Dm1Failrs_as[36].dtc_as[18].spn_u32 "" ULONG CnvRule_NumberOneToOne 1 0 0 4294967295 ECU_ADDRESS 0x70016674 /end MEASUREMENT
/begin MEASUREMENT dataJ1939Dm1Failrs_as[36].dtc_as[18].fmi_u8 "" UBYTE CnvRule_NumberOneToOne 1 0 0 255 ECU_ADDRESS 0x70016678 /end MEASUREMENT
/begin MEASUREMENT dataJ1939Dm1Failrs_as[36].dtc_as[18].occ_u8 "" UBYTE CnvRule_NumberOneToOne 1 0 0 255 ECU_ADDRESS 0x70016679 /end MEASUREMENT
/begin MEASUREMENT dataJ1939Dm1Failrs_as[36].dtc_as[19].spn_u32 "" ULONG CnvRule_NumberOneToOne 1 0 0 4294967295 ECU_ADDRESS 0x7001667C /end MEASUREMENT
/begin MEASUREMENT dataJ1939Dm1Failrs_as[36].dtc_as[19].fmi_u8 "" UBYTE CnvRule_NumberOneToOne 1 0 0 255 ECU_ADDRESS 0x70016680 /end MEASUREMENT
/begin MEASUREMENT dataJ1939Dm1Failrs_as[36].dtc_as[19].occ_u8 "" UBYTE CnvRule_NumberOneToOne 1 0 0 255 ECU_ADDRESS 0x70016681 /end MEASUREMENT
/begin MEASUREMENT dataJ1939Dm1Failrs_as[36].dtc_as[20].spn_u32 "" ULONG CnvRule_NumberOneToOne 1 0 0 4294967295 ECU_ADDRESS 0x70016684 /end MEASUREMENT
/begin MEASUREMENT dataJ1939Dm1Failrs_as[36].dtc_as[20].fmi_u8 "" UBYTE CnvRule_NumberOneToOne 1 0 0 255 ECU_ADDRESS 0x70016688 /end MEASUREMENT
/begin MEASUREMENT dataJ1939Dm1Failrs_as[36].dtc_as[20].occ_u8 "" UBYTE CnvRule_NumberOneToOne 1 0 0 255 ECU_ADDRESS 0x70016689 /end MEASUREMENT
/begin MEASUREMENT dataJ1939Dm1Failrs_as[36].dtc_as "" UBYTE CnvRule_NumberOneToOne 1 0 0 255 ECU_ADDRESS 0x700165EC ARRAY_SIZE 160 /end MEASUREMENT
/begin MEASUREMENT dataJ1939Dm1Failrs_as[37].dtc_as[1].spn_u32 "" ULONG CnvRule_NumberOneToOne 1 0 0 4294967295 ECU_ADDRESS 0x70016690 /end MEASUREMENT
/begin MEASUREMENT dataJ1939Dm1Failrs_as[37].dtc_as[1].fmi_u8 "" UBYTE CnvRule_NumberOneToOne 1 0 0 255 ECU_ADDRESS 0x70016694 /end MEASUREMENT
/begin MEASUREMENT dataJ1939Dm1Failrs_as[37].dtc_as[1].occ_u8 "" UBYTE CnvRule_NumberOneToOne 1 0 0 255 ECU_ADDRESS 0x70016695 /end MEASUREMENT
/begin MEASUREMENT dataJ1939Dm1Failrs_as[37].dtc_as[2].spn_u32 "" ULONG CnvRule_NumberOneToOne 1 0 0 4294967295 ECU_ADDRESS 0x70016698 /end MEASUREMENT
/begin MEASUREMENT dataJ1939Dm1Failrs_as[37].dtc_as[2].fmi_u8 "" UBYTE CnvRule_NumberOneToOne 1 0 0 255 ECU_ADDRESS 0x7001669C /end MEASUREMENT
/begin MEASUREMENT dataJ1939Dm1Failrs_as[37].dtc_as[2].occ_u8 "" UBYTE CnvRule_NumberOneToOne 1 0 0 255 ECU_ADDRESS 0x7001669D /end MEASUREMENT
/begin MEASUREMENT dataJ1939Dm1Failrs_as[37].dtc_as[3].spn_u32 "" ULONG CnvRule_NumberOneToOne 1 0 0 4294967295 ECU_ADDRESS 0x700166A0 /end MEASUREMENT
/begin MEASUREMENT dataJ1939Dm1Failrs_as[37].dtc_as[3].fmi_u8 "" UBYTE CnvRule_NumberOneToOne 1 0 0 255 ECU_ADDRESS 0x700166A4 /end MEASUREMENT
/begin MEASUREMENT dataJ1939Dm1Failrs_as[37].dtc_as[3].occ_u8 "" UBYTE CnvRule_NumberOneToOne 1 0 0 255 ECU_ADDRESS 0x700166A5 /end MEASUREMENT
/begin MEASUREMENT dataJ1939Dm1Failrs_as[37].dtc_as[4].spn_u32 "" ULONG CnvRule_NumberOneToOne 1 0 0 4294967295 ECU_ADDRESS 0x700166A8 /end MEASUREMENT
/begin MEASUREMENT dataJ1939Dm1Failrs_as[37].dtc_as[4].fmi_u8 "" UBYTE CnvRule_NumberOneToOne 1 0 0 255 ECU_ADDRESS 0x700166AC /end MEASUREMENT
/begin MEASUREMENT dataJ1939Dm1Failrs_as[37].dtc_as[4].occ_u8 "" UBYTE CnvRule_NumberOneToOne 1 0 0 255 ECU_ADDRESS 0x700166AD /end MEASUREMENT
/begin MEASUREMENT dataJ1939Dm1Failrs_as[37].dtc_as[5].spn_u32 "" ULONG CnvRule_NumberOneToOne 1 0 0 4294967295 ECU_ADDRESS 0x700166B0 /end MEASUREMENT
/begin MEASUREMENT dataJ1939Dm1Failrs_as[37].dtc_as[5].fmi_u8 "" UBYTE CnvRule_NumberOneToOne 1 0 0 255 ECU_ADDRESS 0x700166B4 /end MEASUREMENT
/begin MEASUREMENT dataJ1939Dm1Failrs_as[37].dtc_as[5].occ_u8 "" UBYTE CnvRule_NumberOneToOne 1 0 0 255 ECU_ADDRESS 0x700166B5 /end MEASUREMENT
/begin MEASUREMENT dataJ1939Dm1Failrs_as[37].dtc_as[6].spn_u32 "" ULONG CnvRule_NumberOneToOne 1 0 0 4294967295 ECU_ADDRESS 0x700166B8 /end MEASUREMENT
/begin MEASUREMENT dataJ1939Dm1Failrs_as[37].dtc_as[6].fmi_u8 "" UBYTE CnvRule_NumberOneToOne 1 0 0 255 ECU_ADDRESS 0x700166BC /end MEASUREMENT
/begin MEASUREMENT dataJ1939Dm1Failrs_as[37].dtc_as[6].occ_u8 "" UBYTE CnvRule_NumberOneToOne 1 0 0 255 ECU_ADDRESS 0x700166BD /end MEASUREMENT
/begin MEASUREMENT dataJ1939Dm1Failrs_as[37].dtc_as[7].spn_u32 "" ULONG CnvRule_NumberOneToOne 1 0 0 4294967295 ECU_ADDRESS 0x700166C0 /end MEASUREMENT
/begin MEASUREMENT dataJ1939Dm1Failrs_as[37].dtc_as[7].fmi_u8 "" UBYTE CnvRule_NumberOneToOne 1 0 0 255 ECU_ADDRESS 0x700166C4 /end MEASUREMENT
/begin MEASUREMENT dataJ1939Dm1Failrs_as[37].dtc_as[7].occ_u8 "" UBYTE CnvRule_NumberOneToOne 1 0 0 255 ECU_ADDRESS 0x700166C5 /end MEASUREMENT
/begin MEASUREMENT dataJ1939Dm1Failrs_as[37].dtc_as[8].spn_u32 "" ULONG CnvRule_NumberOneToOne 1 0 0 4294967295 ECU_ADDRESS 0x700166C8 /end MEASUREMENT
/begin MEASUREMENT dataJ1939Dm1Failrs_as[37].dtc_as[8].fmi_u8 "" UBYTE CnvRule_NumberOneToOne 1 0 0 255 ECU_ADDRESS 0x700166CC /end MEASUREMENT
/begin MEASUREMENT dataJ1939Dm1Failrs_as[37].dtc_as[8].occ_u8 "" UBYTE CnvRule_NumberOneToOne 1 0 0 255 ECU_ADDRESS 0x700166CD /end MEASUREMENT
/begin MEASUREMENT dataJ1939Dm1Failrs_as[37].dtc_as[9].spn_u32 "" ULONG CnvRule_NumberOneToOne 1 0 0 4294967295 ECU_ADDRESS 0x700166D0 /end MEASUREMENT
/begin MEASUREMENT dataJ1939Dm1Failrs_as[37].dtc_as[9].fmi_u8 "" UBYTE CnvRule_NumberOneToOne 1 0 0 255 ECU_ADDRESS 0x700166D4 /end MEASUREMENT
/begin MEASUREMENT dataJ1939Dm1Failrs_as[37].dtc_as[9].occ_u8 "" UBYTE CnvRule_NumberOneToOne 1 0 0 255 ECU_ADDRESS 0x700166D5 /end MEASUREMENT
/begin MEASUREMENT dataJ1939Dm1Failrs_as[37].dtc_as[10].spn_u32 "" ULONG CnvRule_NumberOneToOne 1 0 0 4294967295 ECU_ADDRESS 0x700166D8 /end MEASUREMENT
/begin MEASUREMENT dataJ1939Dm1Failrs_as[37].dtc_as[10].fmi_u8 "" UBYTE CnvRule_NumberOneToOne 1 0 0 255 ECU_ADDRESS 0x700166DC /end MEASUREMENT
/begin MEASUREMENT dataJ1939Dm1Failrs_as[37].dtc_as[10].occ_u8 "" UBYTE CnvRule_NumberOneToOne 1 0 0 255 ECU_ADDRESS 0x700166DD /end MEASUREMENT
/begin MEASUREMENT dataJ1939Dm1Failrs_as[37].dtc_as[11].spn_u32 "" ULONG CnvRule_NumberOneToOne 1 0 0 4294967295 ECU_ADDRESS 0x700166E0 /end MEASUREMENT
/begin MEASUREMENT dataJ1939Dm1Failrs_as[37].dtc_as[11].fmi_u8 "" UBYTE CnvRule_NumberOneToOne 1 0 0 255 ECU_ADDRESS 0x700166E4 /end MEASUREMENT
/begin MEASUREMENT dataJ1939Dm1Failrs_as[37].dtc_as[11].occ_u8 "" UBYTE CnvRule_NumberOneToOne 1 0 0 255 ECU_ADDRESS 0x700166E5 /end MEASUREMENT
/begin MEASUREMENT dataJ1939Dm1Failrs_as[37].dtc_as[12].spn_u32 "" ULONG CnvRule_NumberOneToOne 1 0 0 4294967295 ECU_ADDRESS 0x700166E8 /end MEASUREMENT
/begin MEASUREMENT dataJ1939Dm1Failrs_as[37].dtc_as[12].fmi_u8 "" UBYTE CnvRule_NumberOneToOne 1 0 0 255 ECU_ADDRESS 0x700166EC /end MEASUREMENT
/begin MEASUREMENT dataJ1939Dm1Failrs_as[37].dtc_as[12].occ_u8 "" UBYTE CnvRule_NumberOneToOne 1 0 0 255 ECU_ADDRESS 0x700166ED /end MEASUREMENT
/begin MEASUREMENT dataJ1939Dm1Failrs_as[37].dtc_as[13].spn_u32 "" ULONG CnvRule_NumberOneToOne 1 0 0 4294967295 ECU_ADDRESS 0x700166F0 /end MEASUREMENT
/begin MEASUREMENT dataJ1939Dm1Failrs_as[37].dtc_as[13].fmi_u8 "" UBYTE CnvRule_NumberOneToOne 1 0 0 255 ECU_ADDRESS 0x700166F4 /end MEASUREMENT
/begin MEASUREMENT dataJ1939Dm1Failrs_as[37].dtc_as[13].occ_u8 "" UBYTE CnvRule_NumberOneToOne 1 0 0 255 ECU_ADDRESS 0x700166F5 /end MEASUREMENT
/begin MEASUREMENT dataJ1939Dm1Failrs_as[37].dtc_as[14].spn_u32 "" ULONG CnvRule_NumberOneToOne 1 0 0 4294967295 ECU_ADDRESS 0x700166F8 /end MEASUREMENT
/begin MEASUREMENT dataJ1939Dm1Failrs_as[37].dtc_as[14].fmi_u8 "" UBYTE CnvRule_NumberOneToOne 1 0 0 255 ECU_ADDRESS 0x700166FC /end MEASUREMENT
/begin MEASUREMENT dataJ1939Dm1Failrs_as[37].dtc_as[14].occ_u8 "" UBYTE CnvRule_NumberOneToOne 1 0 0 255 ECU_ADDRESS 0x700166FD /end MEASUREMENT
/begin MEASUREMENT dataJ1939Dm1Failrs_as[37].dtc_as[15].spn_u32 "" ULONG CnvRule_NumberOneToOne 1 0 0 4294967295 ECU_ADDRESS 0x70016700 /end MEASUREMENT
/begin MEASUREMENT dataJ1939Dm1Failrs_as[37].dtc_as[15].fmi_u8 "" UBYTE CnvRule_NumberOneToOne 1 0 0 255 ECU_ADDRESS 0x70016704 /end MEASUREMENT
/begin MEASUREMENT dataJ1939Dm1Failrs_as[37].dtc_as[15].occ_u8 "" UBYTE CnvRule_NumberOneToOne 1 0 0 255 ECU_ADDRESS 0x70016705 /end MEASUREMENT
/begin MEASUREMENT dataJ1939Dm1Failrs_as[37].dtc_as[16].spn_u32 "" ULONG CnvRule_NumberOneToOne 1 0 0 4294967295 ECU_ADDRESS 0x70016708 /end MEASUREMENT
/begin MEASUREMENT dataJ1939Dm1Failrs_as[37].dtc_as[16].fmi_u8 "" UBYTE CnvRule_NumberOneToOne 1 0 0 255 ECU_ADDRESS 0x7001670C /end MEASUREMENT
/begin MEASUREMENT dataJ1939Dm1Failrs_as[37].dtc_as[16].occ_u8 "" UBYTE CnvRule_NumberOneToOne 1 0 0 255 ECU_ADDRESS 0x7001670D /end MEASUREMENT
/begin MEASUREMENT dataJ1939Dm1Failrs_as[37].dtc_as[17].spn_u32 "" ULONG CnvRule_NumberOneToOne 1 0 0 4294967295 ECU_ADDRESS 0x70016710 /end MEASUREMENT
/begin MEASUREMENT dataJ1939Dm1Failrs_as[37].dtc_as[17].fmi_u8 "" UBYTE CnvRule_NumberOneToOne 1 0 0 255 ECU_ADDRESS 0x70016714 /end MEASUREMENT
/begin MEASUREMENT dataJ1939Dm1Failrs_as[37].dtc_as[17].occ_u8 "" UBYTE CnvRule_NumberOneToOne 1 0 0 255 ECU_ADDRESS 0x70016715 /end MEASUREMENT
/begin MEASUREMENT dataJ1939Dm1Failrs_as[37].dtc_as[18].spn_u32 "" ULONG CnvRule_NumberOneToOne 1 0 0 4294967295 ECU_ADDRESS 0x70016718 /end MEASUREMENT
/begin MEASUREMENT dataJ1939Dm1Failrs_as[37].dtc_as[18].fmi_u8 "" UBYTE CnvRule_NumberOneToOne 1 0 0 255 ECU_ADDRESS 0x7001671C /end MEASUREMENT
/begin MEASUREMENT dataJ1939Dm1Failrs_as[37].dtc_as[18].occ_u8 "" UBYTE CnvRule_NumberOneToOne 1 0 0 255 ECU_ADDRESS 0x7001671D /end MEASUREMENT
/begin MEASUREMENT dataJ1939Dm1Failrs_as[37].dtc_as[19].spn_u32 "" ULONG CnvRule_NumberOneToOne 1 0 0 4294967295 ECU_ADDRESS 0x70016720 /end MEASUREMENT
/begin MEASUREMENT dataJ1939Dm1Failrs_as[37].dtc_as[19].fmi_u8 "" UBYTE CnvRule_NumberOneToOne 1 0 0 255 ECU_ADDRESS 0x70016724 /end MEASUREMENT
/begin MEASUREMENT dataJ1939Dm1Failrs_as[37].dtc_as[19].occ_u8 "" UBYTE CnvRule_NumberOneToOne 1 0 0 255 ECU_ADDRESS 0x70016725 /end MEASUREMENT
/begin MEASUREMENT dataJ1939Dm1Failrs_as[37].dtc_as[20].spn_u32 "" ULONG CnvRule_NumberOneToOne 1 0 0 4294967295 ECU_ADDRESS 0x70016728 /end MEASUREMENT
/begin MEASUREMENT dataJ1939Dm1Failrs_as[37].dtc_as[20].fmi_u8 "" UBYTE CnvRule_NumberOneToOne 1 0 0 255 ECU_ADDRESS 0x7001672C /end MEASUREMENT
/begin MEASUREMENT dataJ1939Dm1Failrs_as[37].dtc_as[20].occ_u8 "" UBYTE CnvRule_NumberOneToOne 1 0 0 255 ECU_ADDRESS 0x7001672D /end MEASUREMENT
/begin MEASUREMENT dataJ1939Dm1Failrs_as[37].dtc_as "" UBYTE CnvRule_NumberOneToOne 1 0 0 255 ECU_ADDRESS 0x70016690 ARRAY_SIZE 160 /end MEASUREMENT
/begin MEASUREMENT dataJ1939Dm1Failrs_as[38].dtc_as[1].spn_u32 "" ULONG CnvRule_NumberOneToOne 1 0 0 4294967295 ECU_ADDRESS 0x70016734 /end MEASUREMENT
/begin MEASUREMENT dataJ1939Dm1Failrs_as[38].dtc_as[1].fmi_u8 "" UBYTE CnvRule_NumberOneToOne 1 0 0 255 ECU_ADDRESS 0x70016738 /end MEASUREMENT
/begin MEASUREMENT dataJ1939Dm1Failrs_as[38].dtc_as[1].occ_u8 "" UBYTE CnvRule_NumberOneToOne 1 0 0 255 ECU_ADDRESS 0x70016739 /end MEASUREMENT
/begin MEASUREMENT dataJ1939Dm1Failrs_as[38].dtc_as[2].spn_u32 "" ULONG CnvRule_NumberOneToOne 1 0 0 4294967295 ECU_ADDRESS 0x7001673C /end MEASUREMENT
/begin MEASUREMENT dataJ1939Dm1Failrs_as[38].dtc_as[2].fmi_u8 "" UBYTE CnvRule_NumberOneToOne 1 0 0 255 ECU_ADDRESS 0x70016740 /end MEASUREMENT
/begin MEASUREMENT dataJ1939Dm1Failrs_as[38].dtc_as[2].occ_u8 "" UBYTE CnvRule_NumberOneToOne 1 0 0 255 ECU_ADDRESS 0x70016741 /end MEASUREMENT
/begin MEASUREMENT dataJ1939Dm1Failrs_as[38].dtc_as[3].spn_u32 "" ULONG CnvRule_NumberOneToOne 1 0 0 4294967295 ECU_ADDRESS 0x70016744 /end MEASUREMENT
/begin MEASUREMENT dataJ1939Dm1Failrs_as[38].dtc_as[3].fmi_u8 "" UBYTE CnvRule_NumberOneToOne 1 0 0 255 ECU_ADDRESS 0x70016748 /end MEASUREMENT
/begin MEASUREMENT dataJ1939Dm1Failrs_as[38].dtc_as[3].occ_u8 "" UBYTE CnvRule_NumberOneToOne 1 0 0 255 ECU_ADDRESS 0x70016749 /end MEASUREMENT
/begin MEASUREMENT dataJ1939Dm1Failrs_as[38].dtc_as[4].spn_u32 "" ULONG CnvRule_NumberOneToOne 1 0 0 4294967295 ECU_ADDRESS 0x7001674C /end MEASUREMENT
/begin MEASUREMENT dataJ1939Dm1Failrs_as[38].dtc_as[4].fmi_u8 "" UBYTE CnvRule_NumberOneToOne 1 0 0 255 ECU_ADDRESS 0x70016750 /end MEASUREMENT
/begin MEASUREMENT dataJ1939Dm1Failrs_as[38].dtc_as[4].occ_u8 "" UBYTE CnvRule_NumberOneToOne 1 0 0 255 ECU_ADDRESS 0x70016751 /end MEASUREMENT
/begin MEASUREMENT dataJ1939Dm1Failrs_as[38].dtc_as[5].spn_u32 "" ULONG CnvRule_NumberOneToOne 1 0 0 4294967295 ECU_ADDRESS 0x70016754 /end MEASUREMENT
/begin MEASUREMENT dataJ1939Dm1Failrs_as[38].dtc_as[5].fmi_u8 "" UBYTE CnvRule_NumberOneToOne 1 0 0 255 ECU_ADDRESS 0x70016758 /end MEASUREMENT
/begin MEASUREMENT dataJ1939Dm1Failrs_as[38].dtc_as[5].occ_u8 "" UBYTE CnvRule_NumberOneToOne 1 0 0 255 ECU_ADDRESS 0x70016759 /end MEASUREMENT
/begin MEASUREMENT dataJ1939Dm1Failrs_as[38].dtc_as[6].spn_u32 "" ULONG CnvRule_NumberOneToOne 1 0 0 4294967295 ECU_ADDRESS 0x7001675C /end MEASUREMENT
/begin MEASUREMENT dataJ1939Dm1Failrs_as[38].dtc_as[6].fmi_u8 "" UBYTE CnvRule_NumberOneToOne 1 0 0 255 ECU_ADDRESS 0x70016760 /end MEASUREMENT
/begin MEASUREMENT dataJ1939Dm1Failrs_as[38].dtc_as[6].occ_u8 "" UBYTE CnvRule_NumberOneToOne 1 0 0 255 ECU_ADDRESS 0x70016761 /end MEASUREMENT
/begin MEASUREMENT dataJ1939Dm1Failrs_as[38].dtc_as[7].spn_u32 "" ULONG CnvRule_NumberOneToOne 1 0 0 4294967295 ECU_ADDRESS 0x70016764 /end MEASUREMENT
/begin MEASUREMENT dataJ1939Dm1Failrs_as[38].dtc_as[7].fmi_u8 "" UBYTE CnvRule_NumberOneToOne 1 0 0 255 ECU_ADDRESS 0x70016768 /end MEASUREMENT
/begin MEASUREMENT dataJ1939Dm1Failrs_as[38].dtc_as[7].occ_u8 "" UBYTE CnvRule_NumberOneToOne 1 0 0 255 ECU_ADDRESS 0x70016769 /end MEASUREMENT
/begin MEASUREMENT dataJ1939Dm1Failrs_as[38].dtc_as[8].spn_u32 "" ULONG CnvRule_NumberOneToOne 1 0 0 4294967295 ECU_ADDRESS 0x7001676C /end MEASUREMENT
/begin MEASUREMENT dataJ1939Dm1Failrs_as[38].dtc_as[8].fmi_u8 "" UBYTE CnvRule_NumberOneToOne 1 0 0 255 ECU_ADDRESS 0x70016770 /end MEASUREMENT
/begin MEASUREMENT dataJ1939Dm1Failrs_as[38].dtc_as[8].occ_u8 "" UBYTE CnvRule_NumberOneToOne 1 0 0 255 ECU_ADDRESS 0x70016771 /end MEASUREMENT
/begin MEASUREMENT dataJ1939Dm1Failrs_as[38].dtc_as[9].spn_u32 "" ULONG CnvRule_NumberOneToOne 1 0 0 4294967295 ECU_ADDRESS 0x70016774 /end MEASUREMENT
/begin MEASUREMENT dataJ1939Dm1Failrs_as[38].dtc_as[9].fmi_u8 "" UBYTE CnvRule_NumberOneToOne 1 0 0 255 ECU_ADDRESS 0x70016778 /end MEASUREMENT
/begin MEASUREMENT dataJ1939Dm1Failrs_as[38].dtc_as[9].occ_u8 "" UBYTE CnvRule_NumberOneToOne 1 0 0 255 ECU_ADDRESS 0x70016779 /end MEASUREMENT
/begin MEASUREMENT dataJ1939Dm1Failrs_as[38].dtc_as[10].spn_u32 "" ULONG CnvRule_NumberOneToOne 1 0 0 4294967295 ECU_ADDRESS 0x7001677C /end MEASUREMENT
/begin MEASUREMENT dataJ1939Dm1Failrs_as[38].dtc_as[10].fmi_u8 "" UBYTE CnvRule_NumberOneToOne 1 0 0 255 ECU_ADDRESS 0x70016780 /end MEASUREMENT
/begin MEASUREMENT dataJ1939Dm1Failrs_as[38].dtc_as[10].occ_u8 "" UBYTE CnvRule_NumberOneToOne 1 0 0 255 ECU_ADDRESS 0x70016781 /end MEASUREMENT
/begin MEASUREMENT dataJ1939Dm1Failrs_as[38].dtc_as[11].spn_u32 "" ULONG CnvRule_NumberOneToOne 1 0 0 4294967295 ECU_ADDRESS 0x70016784 /end MEASUREMENT
/begin MEASUREMENT dataJ1939Dm1Failrs_as[38].dtc_as[11].fmi_u8 "" UBYTE CnvRule_NumberOneToOne 1 0 0 255 ECU_ADDRESS 0x70016788 /end MEASUREMENT
/begin MEASUREMENT dataJ1939Dm1Failrs_as[38].dtc_as[11].occ_u8 "" UBYTE CnvRule_NumberOneToOne 1 0 0 255 ECU_ADDRESS 0x70016789 /end MEASUREMENT
/begin MEASUREMENT dataJ1939Dm1Failrs_as[38].dtc_as[12].spn_u32 "" ULONG CnvRule_NumberOneToOne 1 0 0 4294967295 ECU_ADDRESS 0x7001678C /end MEASUREMENT
/begin MEASUREMENT dataJ1939Dm1Failrs_as[38].dtc_as[12].fmi_u8 "" UBYTE CnvRule_NumberOneToOne 1 0 0 255 ECU_ADDRESS 0x70016790 /end MEASUREMENT
/begin MEASUREMENT dataJ1939Dm1Failrs_as[38].dtc_as[12].occ_u8 "" UBYTE CnvRule_NumberOneToOne 1 0 0 255 ECU_ADDRESS 0x70016791 /end MEASUREMENT
/begin MEASUREMENT dataJ1939Dm1Failrs_as[38].dtc_as[13].spn_u32 "" ULONG CnvRule_NumberOneToOne 1 0 0 4294967295 ECU_ADDRESS 0x70016794 /end MEASUREMENT
/begin MEASUREMENT dataJ1939Dm1Failrs_as[38].dtc_as[13].fmi_u8 "" UBYTE CnvRule_NumberOneToOne 1 0 0 255 ECU_ADDRESS 0x70016798 /end MEASUREMENT
/begin MEASUREMENT dataJ1939Dm1Failrs_as[38].dtc_as[13].occ_u8 "" UBYTE CnvRule_NumberOneToOne 1 0 0 255 ECU_ADDRESS 0x70016799 /end MEASUREMENT
/begin MEASUREMENT dataJ1939Dm1Failrs_as[38].dtc_as[14].spn_u32 "" ULONG CnvRule_NumberOneToOne 1 0 0 4294967295 ECU_ADDRESS 0x7001679C /end MEASUREMENT
/begin MEASUREMENT dataJ1939Dm1Failrs_as[38].dtc_as[14].fmi_u8 "" UBYTE CnvRule_NumberOneToOne 1 0 0 255 ECU_ADDRESS 0x700167A0 /end MEASUREMENT
/begin MEASUREMENT dataJ1939Dm1Failrs_as[38].dtc_as[14].occ_u8 "" UBYTE CnvRule_NumberOneToOne 1 0 0 255 ECU_ADDRESS 0x700167A1 /end MEASUREMENT
/begin MEASUREMENT dataJ1939Dm1Failrs_as[38].dtc_as[15].spn_u32 "" ULONG CnvRule_NumberOneToOne 1 0 0 4294967295 ECU_ADDRESS 0x700167A4 /end MEASUREMENT
/begin MEASUREMENT dataJ1939Dm1Failrs_as[38].dtc_as[15].fmi_u8 "" UBYTE CnvRule_NumberOneToOne 1 0 0 255 ECU_ADDRESS 0x700167A8 /end MEASUREMENT
/begin MEASUREMENT dataJ1939Dm1Failrs_as[38].dtc_as[15].occ_u8 "" UBYTE CnvRule_NumberOneToOne 1 0 0 255 ECU_ADDRESS 0x700167A9 /end MEASUREMENT
/begin MEASUREMENT dataJ1939Dm1Failrs_as[38].dtc_as[16].spn_u32 "" ULONG CnvRule_NumberOneToOne 1 0 0 4294967295 ECU_ADDRESS 0x700167AC /end MEASUREMENT
/begin MEASUREMENT dataJ1939Dm1Failrs_as[38].dtc_as[16].fmi_u8 "" UBYTE CnvRule_NumberOneToOne 1 0 0 255 ECU_ADDRESS 0x700167B0 /end MEASUREMENT
/begin MEASUREMENT dataJ1939Dm1Failrs_as[38].dtc_as[16].occ_u8 "" UBYTE CnvRule_NumberOneToOne 1 0 0 255 ECU_ADDRESS 0x700167B1 /end MEASUREMENT
/begin MEASUREMENT dataJ1939Dm1Failrs_as[38].dtc_as[17].spn_u32 "" ULONG CnvRule_NumberOneToOne 1 0 0 4294967295 ECU_ADDRESS 0x700167B4 /end MEASUREMENT
/begin MEASUREMENT dataJ1939Dm1Failrs_as[38].dtc_as[17].fmi_u8 "" UBYTE CnvRule_NumberOneToOne 1 0 0 255 ECU_ADDRESS 0x700167B8 /end MEASUREMENT
/begin MEASUREMENT dataJ1939Dm1Failrs_as[38].dtc_as[17].occ_u8 "" UBYTE CnvRule_NumberOneToOne 1 0 0 255 ECU_ADDRESS 0x700167B9 /end MEASUREMENT
/begin MEASUREMENT dataJ1939Dm1Failrs_as[38].dtc_as[18].spn_u32 "" ULONG CnvRule_NumberOneToOne 1 0 0 4294967295 ECU_ADDRESS 0x700167BC /end MEASUREMENT
/begin MEASUREMENT dataJ1939Dm1Failrs_as[38].dtc_as[18].fmi_u8 "" UBYTE CnvRule_NumberOneToOne 1 0 0 255 ECU_ADDRESS 0x700167C0 /end MEASUREMENT
/begin MEASUREMENT dataJ1939Dm1Failrs_as[38].dtc_as[18].occ_u8 "" UBYTE CnvRule_NumberOneToOne 1 0 0 255 ECU_ADDRESS 0x700167C1 /end MEASUREMENT
/begin MEASUREMENT dataJ1939Dm1Failrs_as[38].dtc_as[19].spn_u32 "" ULONG CnvRule_NumberOneToOne 1 0 0 4294967295 ECU_ADDRESS 0x700167C4 /end MEASUREMENT
/begin MEASUREMENT dataJ1939Dm1Failrs_as[38].dtc_as[19].fmi_u8 "" UBYTE CnvRule_NumberOneToOne 1 0 0 255 ECU_ADDRESS 0x700167C8 /end MEASUREMENT
/begin MEASUREMENT dataJ1939Dm1Failrs_as[38].dtc_as[19].occ_u8 "" UBYTE CnvRule_NumberOneToOne 1 0 0 255 ECU_ADDRESS 0x700167C9 /end MEASUREMENT
/begin MEASUREMENT dataJ1939Dm1Failrs_as[38].dtc_as[20].spn_u32 "" ULONG CnvRule_NumberOneToOne 1 0 0 4294967295 ECU_ADDRESS 0x700167CC /end MEASUREMENT
/begin MEASUREMENT dataJ1939Dm1Failrs_as[38].dtc_as[20].fmi_u8 "" UBYTE CnvRule_NumberOneToOne 1 0 0 255 ECU_ADDRESS 0x700167D0 /end MEASUREMENT
/begin MEASUREMENT dataJ1939Dm1Failrs_as[38].dtc_as[20].occ_u8 "" UBYTE CnvRule_NumberOneToOne 1 0 0 255 ECU_ADDRESS 0x700167D1 /end MEASUREMENT
/begin MEASUREMENT dataJ1939Dm1Failrs_as[38].dtc_as "" UBYTE CnvRule_NumberOneToOne 1 0 0 255 ECU_ADDRESS 0x70016734 ARRAY_SIZE 160 /end MEASUREMENT
/begin MEASUREMENT dataJ1939Dm1Failrs_as[39].dtc_as[1].spn_u32 "" ULONG CnvRule_NumberOneToOne 1 0 0 4294967295 ECU_ADDRESS 0x700167D8 /end MEASUREMENT
/begin MEASUREMENT dataJ1939Dm1Failrs_as[39].dtc_as[1].fmi_u8 "" UBYTE CnvRule_NumberOneToOne 1 0 0 255 ECU_ADDRESS 0x700167DC /end MEASUREMENT
/begin MEASUREMENT dataJ1939Dm1Failrs_as[39].dtc_as[1].occ_u8 "" UBYTE CnvRule_NumberOneToOne 1 0 0 255 ECU_ADDRESS 0x700167DD /end MEASUREMENT
/begin MEASUREMENT dataJ1939Dm1Failrs_as[39].dtc_as[2].spn_u32 "" ULONG CnvRule_NumberOneToOne 1 0 0 4294967295 ECU_ADDRESS 0x700167E0 /end MEASUREMENT
/begin MEASUREMENT dataJ1939Dm1Failrs_as[39].dtc_as[2].fmi_u8 "" UBYTE CnvRule_NumberOneToOne 1 0 0 255 ECU_ADDRESS 0x700167E4 /end MEASUREMENT
/begin MEASUREMENT dataJ1939Dm1Failrs_as[39].dtc_as[2].occ_u8 "" UBYTE CnvRule_NumberOneToOne 1 0 0 255 ECU_ADDRESS 0x700167E5 /end MEASUREMENT
/begin MEASUREMENT dataJ1939Dm1Failrs_as[39].dtc_as[3].spn_u32 "" ULONG CnvRule_NumberOneToOne 1 0 0 4294967295 ECU_ADDRESS 0x700167E8 /end MEASUREMENT
/begin MEASUREMENT dataJ1939Dm1Failrs_as[39].dtc_as[3].fmi_u8 "" UBYTE CnvRule_NumberOneToOne 1 0 0 255 ECU_ADDRESS 0x700167EC /end MEASUREMENT
/begin MEASUREMENT dataJ1939Dm1Failrs_as[39].dtc_as[3].occ_u8 "" UBYTE CnvRule_NumberOneToOne 1 0 0 255 ECU_ADDRESS 0x700167ED /end MEASUREMENT
/begin MEASUREMENT dataJ1939Dm1Failrs_as[39].dtc_as[4].spn_u32 "" ULONG CnvRule_NumberOneToOne 1 0 0 4294967295 ECU_ADDRESS 0x700167F0 /end MEASUREMENT
/begin MEASUREMENT dataJ1939Dm1Failrs_as[39].dtc_as[4].fmi_u8 "" UBYTE CnvRule_NumberOneToOne 1 0 0 255 ECU_ADDRESS 0x700167F4 /end MEASUREMENT
/begin MEASUREMENT dataJ1939Dm1Failrs_as[39].dtc_as[4].occ_u8 "" UBYTE CnvRule_NumberOneToOne 1 0 0 255 ECU_ADDRESS 0x700167F5 /end MEASUREMENT
/begin MEASUREMENT dataJ1939Dm1Failrs_as[39].dtc_as[5].spn_u32 "" ULONG CnvRule_NumberOneToOne 1 0 0 4294967295 ECU_ADDRESS 0x700167F8 /end MEASUREMENT
/begin MEASUREMENT dataJ1939Dm1Failrs_as[39].dtc_as[5].fmi_u8 "" UBYTE CnvRule_NumberOneToOne 1 0 0 255 ECU_ADDRESS 0x700167FC /end MEASUREMENT
/begin MEASUREMENT dataJ1939Dm1Failrs_as[39].dtc_as[5].occ_u8 "" UBYTE CnvRule_NumberOneToOne 1 0 0 255 ECU_ADDRESS 0x700167FD /end MEASUREMENT
/begin MEASUREMENT dataJ1939Dm1Failrs_as[39].dtc_as[6].spn_u32 "" ULONG CnvRule_NumberOneToOne 1 0 0 4294967295 ECU_ADDRESS 0x70016800 /end MEASUREMENT
/begin MEASUREMENT dataJ1939Dm1Failrs_as[39].dtc_as[6].fmi_u8 "" UBYTE CnvRule_NumberOneToOne 1 0 0 255 ECU_ADDRESS 0x70016804 /end MEASUREMENT
/begin MEASUREMENT dataJ1939Dm1Failrs_as[39].dtc_as[6].occ_u8 "" UBYTE CnvRule_NumberOneToOne 1 0 0 255 ECU_ADDRESS 0x70016805 /end MEASUREMENT
/begin MEASUREMENT dataJ1939Dm1Failrs_as[39].dtc_as[7].spn_u32 "" ULONG CnvRule_NumberOneToOne 1 0 0 4294967295 ECU_ADDRESS 0x70016808 /end MEASUREMENT
/begin MEASUREMENT dataJ1939Dm1Failrs_as[39].dtc_as[7].fmi_u8 "" UBYTE CnvRule_NumberOneToOne 1 0 0 255 ECU_ADDRESS 0x7001680C /end MEASUREMENT
/begin MEASUREMENT dataJ1939Dm1Failrs_as[39].dtc_as[7].occ_u8 "" UBYTE CnvRule_NumberOneToOne 1 0 0 255 ECU_ADDRESS 0x7001680D /end MEASUREMENT
/begin MEASUREMENT dataJ1939Dm1Failrs_as[39].dtc_as[8].spn_u32 "" ULONG CnvRule_NumberOneToOne 1 0 0 4294967295 ECU_ADDRESS 0x70016810 /end MEASUREMENT
/begin MEASUREMENT dataJ1939Dm1Failrs_as[39].dtc_as[8].fmi_u8 "" UBYTE CnvRule_NumberOneToOne 1 0 0 255 ECU_ADDRESS 0x70016814 /end MEASUREMENT
/begin MEASUREMENT dataJ1939Dm1Failrs_as[39].dtc_as[8].occ_u8 "" UBYTE CnvRule_NumberOneToOne 1 0 0 255 ECU_ADDRESS 0x70016815 /end MEASUREMENT
/begin MEASUREMENT dataJ1939Dm1Failrs_as[39].dtc_as[9].spn_u32 "" ULONG CnvRule_NumberOneToOne 1 0 0 4294967295 ECU_ADDRESS 0x70016818 /end MEASUREMENT
/begin MEASUREMENT dataJ1939Dm1Failrs_as[39].dtc_as[9].fmi_u8 "" UBYTE CnvRule_NumberOneToOne 1 0 0 255 ECU_ADDRESS 0x7001681C /end MEASUREMENT
/begin MEASUREMENT dataJ1939Dm1Failrs_as[39].dtc_as[9].occ_u8 "" UBYTE CnvRule_NumberOneToOne 1 0 0 255 ECU_ADDRESS 0x7001681D /end MEASUREMENT
/begin MEASUREMENT dataJ1939Dm1Failrs_as[39].dtc_as[10].spn_u32 "" ULONG CnvRule_NumberOneToOne 1 0 0 4294967295 ECU_ADDRESS 0x70016820 /end MEASUREMENT
/begin MEASUREMENT dataJ1939Dm1Failrs_as[39].dtc_as[10].fmi_u8 "" UBYTE CnvRule_NumberOneToOne 1 0 0 255 ECU_ADDRESS 0x70016824 /end MEASUREMENT
/begin MEASUREMENT dataJ1939Dm1Failrs_as[39].dtc_as[10].occ_u8 "" UBYTE CnvRule_NumberOneToOne 1 0 0 255 ECU_ADDRESS 0x70016825 /end MEASUREMENT
/begin MEASUREMENT dataJ1939Dm1Failrs_as[39].dtc_as[11].spn_u32 "" ULONG CnvRule_NumberOneToOne 1 0 0 4294967295 ECU_ADDRESS 0x70016828 /end MEASUREMENT
/begin MEASUREMENT dataJ1939Dm1Failrs_as[39].dtc_as[11].fmi_u8 "" UBYTE CnvRule_NumberOneToOne 1 0 0 255 ECU_ADDRESS 0x7001682C /end MEASUREMENT
/begin MEASUREMENT dataJ1939Dm1Failrs_as[39].dtc_as[11].occ_u8 "" UBYTE CnvRule_NumberOneToOne 1 0 0 255 ECU_ADDRESS 0x7001682D /end MEASUREMENT
/begin MEASUREMENT dataJ1939Dm1Failrs_as[39].dtc_as[12].spn_u32 "" ULONG CnvRule_NumberOneToOne 1 0 0 4294967295 ECU_ADDRESS 0x70016830 /end MEASUREMENT
/begin MEASUREMENT dataJ1939Dm1Failrs_as[39].dtc_as[12].fmi_u8 "" UBYTE CnvRule_NumberOneToOne 1 0 0 255 ECU_ADDRESS 0x70016834 /end MEASUREMENT
/begin MEASUREMENT dataJ1939Dm1Failrs_as[39].dtc_as[12].occ_u8 "" UBYTE CnvRule_NumberOneToOne 1 0 0 255 ECU_ADDRESS 0x70016835 /end MEASUREMENT
/begin MEASUREMENT dataJ1939Dm1Failrs_as[39].dtc_as[13].spn_u32 "" ULONG CnvRule_NumberOneToOne 1 0 0 4294967295 ECU_ADDRESS 0x70016838 /end MEASUREMENT
/begin MEASUREMENT dataJ1939Dm1Failrs_as[39].dtc_as[13].fmi_u8 "" UBYTE CnvRule_NumberOneToOne 1 0 0 255 ECU_ADDRESS 0x7001683C /end MEASUREMENT
/begin MEASUREMENT dataJ1939Dm1Failrs_as[39].dtc_as[13].occ_u8 "" UBYTE CnvRule_NumberOneToOne 1 0 0 255 ECU_ADDRESS 0x7001683D /end MEASUREMENT
/begin MEASUREMENT dataJ1939Dm1Failrs_as[39].dtc_as[14].spn_u32 "" ULONG CnvRule_NumberOneToOne 1 0 0 4294967295 ECU_ADDRESS 0x70016840 /end MEASUREMENT
/begin MEASUREMENT dataJ1939Dm1Failrs_as[39].dtc_as[14].fmi_u8 "" UBYTE CnvRule_NumberOneToOne 1 0 0 255 ECU_ADDRESS 0x70016844 /end MEASUREMENT
/begin MEASUREMENT dataJ1939Dm1Failrs_as[39].dtc_as[14].occ_u8 "" UBYTE CnvRule_NumberOneToOne 1 0 0 255 ECU_ADDRESS 0x70016845 /end MEASUREMENT
/begin MEASUREMENT dataJ1939Dm1Failrs_as[39].dtc_as[15].spn_u32 "" ULONG CnvRule_NumberOneToOne 1 0 0 4294967295 ECU_ADDRESS 0x70016848 /end MEASUREMENT
/begin MEASUREMENT dataJ1939Dm1Failrs_as[39].dtc_as[15].fmi_u8 "" UBYTE CnvRule_NumberOneToOne 1 0 0 255 ECU_ADDRESS 0x7001684C /end MEASUREMENT
/begin MEASUREMENT dataJ1939Dm1Failrs_as[39].dtc_as[15].occ_u8 "" UBYTE CnvRule_NumberOneToOne 1 0 0 255 ECU_ADDRESS 0x7001684D /end MEASUREMENT
/begin MEASUREMENT dataJ1939Dm1Failrs_as[39].dtc_as[16].spn_u32 "" ULONG CnvRule_NumberOneToOne 1 0 0 4294967295 ECU_ADDRESS 0x70016850 /end MEASUREMENT
/begin MEASUREMENT dataJ1939Dm1Failrs_as[39].dtc_as[16].fmi_u8 "" UBYTE CnvRule_NumberOneToOne 1 0 0 255 ECU_ADDRESS 0x70016854 /end MEASUREMENT
/begin MEASUREMENT dataJ1939Dm1Failrs_as[39].dtc_as[16].occ_u8 "" UBYTE CnvRule_NumberOneToOne 1 0 0 255 ECU_ADDRESS 0x70016855 /end MEASUREMENT
/begin MEASUREMENT dataJ1939Dm1Failrs_as[39].dtc_as[17].spn_u32 "" ULONG CnvRule_NumberOneToOne 1 0 0 4294967295 ECU_ADDRESS 0x70016858 /end MEASUREMENT
/begin MEASUREMENT dataJ1939Dm1Failrs_as[39].dtc_as[17].fmi_u8 "" UBYTE CnvRule_NumberOneToOne 1 0 0 255 ECU_ADDRESS 0x7001685C /end MEASUREMENT
/begin MEASUREMENT dataJ1939Dm1Failrs_as[39].dtc_as[17].occ_u8 "" UBYTE CnvRule_NumberOneToOne 1 0 0 255 ECU_ADDRESS 0x7001685D /end MEASUREMENT
/begin MEASUREMENT dataJ1939Dm1Failrs_as[39].dtc_as[18].spn_u32 "" ULONG CnvRule_NumberOneToOne 1 0 0 4294967295 ECU_ADDRESS 0x70016860 /end MEASUREMENT
/begin MEASUREMENT dataJ1939Dm1Failrs_as[39].dtc_as[18].fmi_u8 "" UBYTE CnvRule_NumberOneToOne 1 0 0 255 ECU_ADDRESS 0x70016864 /end MEASUREMENT
/begin MEASUREMENT dataJ1939Dm1Failrs_as[39].dtc_as[18].occ_u8 "" UBYTE CnvRule_NumberOneToOne 1 0 0 255 ECU_ADDRESS 0x70016865 /end MEASUREMENT
/begin MEASUREMENT dataJ1939Dm1Failrs_as[39].dtc_as[19].spn_u32 "" ULONG CnvRule_NumberOneToOne 1 0 0 4294967295 ECU_ADDRESS 0x70016868 /end MEASUREMENT
/begin MEASUREMENT dataJ1939Dm1Failrs_as[39].dtc_as[19].fmi_u8 "" UBYTE CnvRule_NumberOneToOne 1 0 0 255 ECU_ADDRESS 0x7001686C /end MEASUREMENT
/begin MEASUREMENT dataJ1939Dm1Failrs_as[39].dtc_as[19].occ_u8 "" UBYTE CnvRule_NumberOneToOne 1 0 0 255 ECU_ADDRESS 0x7001686D /end MEASUREMENT
/begin MEASUREMENT dataJ1939Dm1Failrs_as[39].dtc_as[20].spn_u32 "" ULONG CnvRule_NumberOneToOne 1 0 0 4294967295 ECU_ADDRESS 0x70016870 /end MEASUREMENT
/begin MEASUREMENT dataJ1939Dm1Failrs_as[39].dtc_as[20].fmi_u8 "" UBYTE CnvRule_NumberOneToOne 1 0 0 255 ECU_ADDRESS 0x70016874 /end MEASUREMENT
/begin MEASUREMENT dataJ1939Dm1Failrs_as[39].dtc_as[20].occ_u8 "" UBYTE CnvRule_NumberOneToOne 1 0 0 255 ECU_ADDRESS 0x70016875 /end MEASUREMENT
/begin MEASUREMENT dataJ1939Dm1Failrs_as[39].dtc_as "" UBYTE CnvRule_NumberOneToOne 1 0 0 255 ECU_ADDRESS 0x700167D8 ARRAY_SIZE 160 /end MEASUREMENT
/begin MEASUREMENT dataJ1939Dm1Failrs_as[40].dtc_as[1].spn_u32 "" ULONG CnvRule_NumberOneToOne 1 0 0 4294967295 ECU_ADDRESS 0x7001687C /end MEASUREMENT
/begin MEASUREMENT dataJ1939Dm1Failrs_as[40].dtc_as[1].fmi_u8 "" UBYTE CnvRule_NumberOneToOne 1 0 0 255 ECU_ADDRESS 0x70016880 /end MEASUREMENT
/begin MEASUREMENT dataJ1939Dm1Failrs_as[40].dtc_as[1].occ_u8 "" UBYTE CnvRule_NumberOneToOne 1 0 0 255 ECU_ADDRESS 0x70016881 /end MEASUREMENT
/begin MEASUREMENT dataJ1939Dm1Failrs_as[40].dtc_as[2].spn_u32 "" ULONG CnvRule_NumberOneToOne 1 0 0 4294967295 ECU_ADDRESS 0x70016884 /end MEASUREMENT
/begin MEASUREMENT dataJ1939Dm1Failrs_as[40].dtc_as[2].fmi_u8 "" UBYTE CnvRule_NumberOneToOne 1 0 0 255 ECU_ADDRESS 0x70016888 /end MEASUREMENT
/begin MEASUREMENT dataJ1939Dm1Failrs_as[40].dtc_as[2].occ_u8 "" UBYTE CnvRule_NumberOneToOne 1 0 0 255 ECU_ADDRESS 0x70016889 /end MEASUREMENT
/begin MEASUREMENT dataJ1939Dm1Failrs_as[40].dtc_as[3].spn_u32 "" ULONG CnvRule_NumberOneToOne 1 0 0 4294967295 ECU_ADDRESS 0x7001688C /end MEASUREMENT
/begin MEASUREMENT dataJ1939Dm1Failrs_as[40].dtc_as[3].fmi_u8 "" UBYTE CnvRule_NumberOneToOne 1 0 0 255 ECU_ADDRESS 0x70016890 /end MEASUREMENT
/begin MEASUREMENT dataJ1939Dm1Failrs_as[40].dtc_as[3].occ_u8 "" UBYTE CnvRule_NumberOneToOne 1 0 0 255 ECU_ADDRESS 0x70016891 /end MEASUREMENT
/begin MEASUREMENT dataJ1939Dm1Failrs_as[40].dtc_as[4].spn_u32 "" ULONG CnvRule_NumberOneToOne 1 0 0 4294967295 ECU_ADDRESS 0x70016894 /end MEASUREMENT
/begin MEASUREMENT dataJ1939Dm1Failrs_as[40].dtc_as[4].fmi_u8 "" UBYTE CnvRule_NumberOneToOne 1 0 0 255 ECU_ADDRESS 0x70016898 /end MEASUREMENT
/begin MEASUREMENT dataJ1939Dm1Failrs_as[40].dtc_as[4].occ_u8 "" UBYTE CnvRule_NumberOneToOne 1 0 0 255 ECU_ADDRESS 0x70016899 /end MEASUREMENT
/begin MEASUREMENT dataJ1939Dm1Failrs_as[40].dtc_as[5].spn_u32 "" ULONG CnvRule_NumberOneToOne 1 0 0 4294967295 ECU_ADDRESS 0x7001689C /end MEASUREMENT
/begin MEASUREMENT dataJ1939Dm1Failrs_as[40].dtc_as[5].fmi_u8 "" UBYTE CnvRule_NumberOneToOne 1 0 0 255 ECU_ADDRESS 0x700168A0 /end MEASUREMENT
/begin MEASUREMENT dataJ1939Dm1Failrs_as[40].dtc_as[5].occ_u8 "" UBYTE CnvRule_NumberOneToOne 1 0 0 255 ECU_ADDRESS 0x700168A1 /end MEASUREMENT
/begin MEASUREMENT dataJ1939Dm1Failrs_as[40].dtc_as[6].spn_u32 "" ULONG CnvRule_NumberOneToOne 1 0 0 4294967295 ECU_ADDRESS 0x700168A4 /end MEASUREMENT
/begin MEASUREMENT dataJ1939Dm1Failrs_as[40].dtc_as[6].fmi_u8 "" UBYTE CnvRule_NumberOneToOne 1 0 0 255 ECU_ADDRESS 0x700168A8 /end MEASUREMENT
/begin MEASUREMENT dataJ1939Dm1Failrs_as[40].dtc_as[6].occ_u8 "" UBYTE CnvRule_NumberOneToOne 1 0 0 255 ECU_ADDRESS 0x700168A9 /end MEASUREMENT
/begin MEASUREMENT dataJ1939Dm1Failrs_as[40].dtc_as[7].spn_u32 "" ULONG CnvRule_NumberOneToOne 1 0 0 4294967295 ECU_ADDRESS 0x700168AC /end MEASUREMENT
/begin MEASUREMENT dataJ1939Dm1Failrs_as[40].dtc_as[7].fmi_u8 "" UBYTE CnvRule_NumberOneToOne 1 0 0 255 ECU_ADDRESS 0x700168B0 /end MEASUREMENT
/begin MEASUREMENT dataJ1939Dm1Failrs_as[40].dtc_as[7].occ_u8 "" UBYTE CnvRule_NumberOneToOne 1 0 0 255 ECU_ADDRESS 0x700168B1 /end MEASUREMENT
/begin MEASUREMENT dataJ1939Dm1Failrs_as[40].dtc_as[8].spn_u32 "" ULONG CnvRule_NumberOneToOne 1 0 0 4294967295 ECU_ADDRESS 0x700168B4 /end MEASUREMENT
/begin MEASUREMENT dataJ1939Dm1Failrs_as[40].dtc_as[8].fmi_u8 "" UBYTE CnvRule_NumberOneToOne 1 0 0 255 ECU_ADDRESS 0x700168B8 /end MEASUREMENT
/begin MEASUREMENT dataJ1939Dm1Failrs_as[40].dtc_as[8].occ_u8 "" UBYTE CnvRule_NumberOneToOne 1 0 0 255 ECU_ADDRESS 0x700168B9 /end MEASUREMENT
/begin MEASUREMENT dataJ1939Dm1Failrs_as[40].dtc_as[9].spn_u32 "" ULONG CnvRule_NumberOneToOne 1 0 0 4294967295 ECU_ADDRESS 0x700168BC /end MEASUREMENT
/begin MEASUREMENT dataJ1939Dm1Failrs_as[40].dtc_as[9].fmi_u8 "" UBYTE CnvRule_NumberOneToOne 1 0 0 255 ECU_ADDRESS 0x700168C0 /end MEASUREMENT
/begin MEASUREMENT dataJ1939Dm1Failrs_as[40].dtc_as[9].occ_u8 "" UBYTE CnvRule_NumberOneToOne 1 0 0 255 ECU_ADDRESS 0x700168C1 /end MEASUREMENT
/begin MEASUREMENT dataJ1939Dm1Failrs_as[40].dtc_as[10].spn_u32 "" ULONG CnvRule_NumberOneToOne 1 0 0 4294967295 ECU_ADDRESS 0x700168C4 /end MEASUREMENT
/begin MEASUREMENT dataJ1939Dm1Failrs_as[40].dtc_as[10].fmi_u8 "" UBYTE CnvRule_NumberOneToOne 1 0 0 255 ECU_ADDRESS 0x700168C8 /end MEASUREMENT
/begin MEASUREMENT dataJ1939Dm1Failrs_as[40].dtc_as[10].occ_u8 "" UBYTE CnvRule_NumberOneToOne 1 0 0 255 ECU_ADDRESS 0x700168C9 /end MEASUREMENT
/begin MEASUREMENT dataJ1939Dm1Failrs_as[40].dtc_as[11].spn_u32 "" ULONG CnvRule_NumberOneToOne 1 0 0 4294967295 ECU_ADDRESS 0x700168CC /end MEASUREMENT
/begin MEASUREMENT dataJ1939Dm1Failrs_as[40].dtc_as[11].fmi_u8 "" UBYTE CnvRule_NumberOneToOne 1 0 0 255 ECU_ADDRESS 0x700168D0 /end MEASUREMENT
/begin MEASUREMENT dataJ1939Dm1Failrs_as[40].dtc_as[11].occ_u8 "" UBYTE CnvRule_NumberOneToOne 1 0 0 255 ECU_ADDRESS 0x700168D1 /end MEASUREMENT
/begin MEASUREMENT dataJ1939Dm1Failrs_as[40].dtc_as[12].spn_u32 "" ULONG CnvRule_NumberOneToOne 1 0 0 4294967295 ECU_ADDRESS 0x700168D4 /end MEASUREMENT
/begin MEASUREMENT dataJ1939Dm1Failrs_as[40].dtc_as[12].fmi_u8 "" UBYTE CnvRule_NumberOneToOne 1 0 0 255 ECU_ADDRESS 0x700168D8 /end MEASUREMENT
/begin MEASUREMENT dataJ1939Dm1Failrs_as[40].dtc_as[12].occ_u8 "" UBYTE CnvRule_NumberOneToOne 1 0 0 255 ECU_ADDRESS 0x700168D9 /end MEASUREMENT
/begin MEASUREMENT dataJ1939Dm1Failrs_as[40].dtc_as[13].spn_u32 "" ULONG CnvRule_NumberOneToOne 1 0 0 4294967295 ECU_ADDRESS 0x700168DC /end MEASUREMENT
/begin MEASUREMENT dataJ1939Dm1Failrs_as[40].dtc_as[13].fmi_u8 "" UBYTE CnvRule_NumberOneToOne 1 0 0 255 ECU_ADDRESS 0x700168E0 /end MEASUREMENT
/begin MEASUREMENT dataJ1939Dm1Failrs_as[40].dtc_as[13].occ_u8 "" UBYTE CnvRule_NumberOneToOne 1 0 0 255 ECU_ADDRESS 0x700168E1 /end MEASUREMENT
/begin MEASUREMENT dataJ1939Dm1Failrs_as[40].dtc_as[14].spn_u32 "" ULONG CnvRule_NumberOneToOne 1 0 0 4294967295 ECU_ADDRESS 0x700168E4 /end MEASUREMENT
/begin MEASUREMENT dataJ1939Dm1Failrs_as[40].dtc_as[14].fmi_u8 "" UBYTE CnvRule_NumberOneToOne 1 0 0 255 ECU_ADDRESS 0x700168E8 /end MEASUREMENT
/begin MEASUREMENT dataJ1939Dm1Failrs_as[40].dtc_as[14].occ_u8 "" UBYTE CnvRule_NumberOneToOne 1 0 0 255 ECU_ADDRESS 0x700168E9 /end MEASUREMENT
/begin MEASUREMENT dataJ1939Dm1Failrs_as[40].dtc_as[15].spn_u32 "" ULONG CnvRule_NumberOneToOne 1 0 0 4294967295 ECU_ADDRESS 0x700168EC /end MEASUREMENT
/begin MEASUREMENT dataJ1939Dm1Failrs_as[40].dtc_as[15].fmi_u8 "" UBYTE CnvRule_NumberOneToOne 1 0 0 255 ECU_ADDRESS 0x700168F0 /end MEASUREMENT
/begin MEASUREMENT dataJ1939Dm1Failrs_as[40].dtc_as[15].occ_u8 "" UBYTE CnvRule_NumberOneToOne 1 0 0 255 ECU_ADDRESS 0x700168F1 /end MEASUREMENT
/begin MEASUREMENT dataJ1939Dm1Failrs_as[40].dtc_as[16].spn_u32 "" ULONG CnvRule_NumberOneToOne 1 0 0 4294967295 ECU_ADDRESS 0x700168F4 /end MEASUREMENT
/begin MEASUREMENT dataJ1939Dm1Failrs_as[40].dtc_as[16].fmi_u8 "" UBYTE CnvRule_NumberOneToOne 1 0 0 255 ECU_ADDRESS 0x700168F8 /end MEASUREMENT
/begin MEASUREMENT dataJ1939Dm1Failrs_as[40].dtc_as[16].occ_u8 "" UBYTE CnvRule_NumberOneToOne 1 0 0 255 ECU_ADDRESS 0x700168F9 /end MEASUREMENT
/begin MEASUREMENT dataJ1939Dm1Failrs_as[40].dtc_as[17].spn_u32 "" ULONG CnvRule_NumberOneToOne 1 0 0 4294967295 ECU_ADDRESS 0x700168FC /end MEASUREMENT
/begin MEASUREMENT dataJ1939Dm1Failrs_as[40].dtc_as[17].fmi_u8 "" UBYTE CnvRule_NumberOneToOne 1 0 0 255 ECU_ADDRESS 0x70016900 /end MEASUREMENT
/begin MEASUREMENT dataJ1939Dm1Failrs_as[40].dtc_as[17].occ_u8 "" UBYTE CnvRule_NumberOneToOne 1 0 0 255 ECU_ADDRESS 0x70016901 /end MEASUREMENT
/begin MEASUREMENT dataJ1939Dm1Failrs_as[40].dtc_as[18].spn_u32 "" ULONG CnvRule_NumberOneToOne 1 0 0 4294967295 ECU_ADDRESS 0x70016904 /end MEASUREMENT
/begin MEASUREMENT dataJ1939Dm1Failrs_as[40].dtc_as[18].fmi_u8 "" UBYTE CnvRule_NumberOneToOne 1 0 0 255 ECU_ADDRESS 0x70016908 /end MEASUREMENT
/begin MEASUREMENT dataJ1939Dm1Failrs_as[40].dtc_as[18].occ_u8 "" UBYTE CnvRule_NumberOneToOne 1 0 0 255 ECU_ADDRESS 0x70016909 /end MEASUREMENT
/begin MEASUREMENT dataJ1939Dm1Failrs_as[40].dtc_as[19].spn_u32 "" ULONG CnvRule_NumberOneToOne 1 0 0 4294967295 ECU_ADDRESS 0x7001690C /end MEASUREMENT
/begin MEASUREMENT dataJ1939Dm1Failrs_as[40].dtc_as[19].fmi_u8 "" UBYTE CnvRule_NumberOneToOne 1 0 0 255 ECU_ADDRESS 0x70016910 /end MEASUREMENT
/begin MEASUREMENT dataJ1939Dm1Failrs_as[40].dtc_as[19].occ_u8 "" UBYTE CnvRule_NumberOneToOne 1 0 0 255 ECU_ADDRESS 0x70016911 /end MEASUREMENT
/begin MEASUREMENT dataJ1939Dm1Failrs_as[40].dtc_as[20].spn_u32 "" ULONG CnvRule_NumberOneToOne 1 0 0 4294967295 ECU_ADDRESS 0x70016914 /end MEASUREMENT
/begin MEASUREMENT dataJ1939Dm1Failrs_as[40].dtc_as[20].fmi_u8 "" UBYTE CnvRule_NumberOneToOne 1 0 0 255 ECU_ADDRESS 0x70016918 /end MEASUREMENT
/begin MEASUREMENT dataJ1939Dm1Failrs_as[40].dtc_as[20].occ_u8 "" UBYTE CnvRule_NumberOneToOne 1 0 0 255 ECU_ADDRESS 0x70016919 /end MEASUREMENT
/begin MEASUREMENT dataJ1939Dm1Failrs_as[40].dtc_as "" UBYTE CnvRule_NumberOneToOne 1 0 0 255 ECU_ADDRESS 0x7001687C ARRAY_SIZE 160 /end MEASUREMENT
/begin MEASUREMENT dataJ1939Dm1Failrs_as[41].dtc_as[1].spn_u32 "" ULONG CnvRule_NumberOneToOne 1 0 0 4294967295 ECU_ADDRESS 0x70016920 /end MEASUREMENT
/begin MEASUREMENT dataJ1939Dm1Failrs_as[41].dtc_as[1].fmi_u8 "" UBYTE CnvRule_NumberOneToOne 1 0 0 255 ECU_ADDRESS 0x70016924 /end MEASUREMENT
/begin MEASUREMENT dataJ1939Dm1Failrs_as[41].dtc_as[1].occ_u8 "" UBYTE CnvRule_NumberOneToOne 1 0 0 255 ECU_ADDRESS 0x70016925 /end MEASUREMENT
/begin MEASUREMENT dataJ1939Dm1Failrs_as[41].dtc_as[2].spn_u32 "" ULONG CnvRule_NumberOneToOne 1 0 0 4294967295 ECU_ADDRESS 0x70016928 /end MEASUREMENT
/begin MEASUREMENT dataJ1939Dm1Failrs_as[41].dtc_as[2].fmi_u8 "" UBYTE CnvRule_NumberOneToOne 1 0 0 255 ECU_ADDRESS 0x7001692C /end MEASUREMENT
/begin MEASUREMENT dataJ1939Dm1Failrs_as[41].dtc_as[2].occ_u8 "" UBYTE CnvRule_NumberOneToOne 1 0 0 255 ECU_ADDRESS 0x7001692D /end MEASUREMENT
/begin MEASUREMENT dataJ1939Dm1Failrs_as[41].dtc_as[3].spn_u32 "" ULONG CnvRule_NumberOneToOne 1 0 0 4294967295 ECU_ADDRESS 0x70016930 /end MEASUREMENT
/begin MEASUREMENT dataJ1939Dm1Failrs_as[41].dtc_as[3].fmi_u8 "" UBYTE CnvRule_NumberOneToOne 1 0 0 255 ECU_ADDRESS 0x70016934 /end MEASUREMENT
/begin MEASUREMENT dataJ1939Dm1Failrs_as[41].dtc_as[3].occ_u8 "" UBYTE CnvRule_NumberOneToOne 1 0 0 255 ECU_ADDRESS 0x70016935 /end MEASUREMENT
/begin MEASUREMENT dataJ1939Dm1Failrs_as[41].dtc_as[4].spn_u32 "" ULONG CnvRule_NumberOneToOne 1 0 0 4294967295 ECU_ADDRESS 0x70016938 /end MEASUREMENT
/begin MEASUREMENT dataJ1939Dm1Failrs_as[41].dtc_as[4].fmi_u8 "" UBYTE CnvRule_NumberOneToOne 1 0 0 255 ECU_ADDRESS 0x7001693C /end MEASUREMENT
/begin MEASUREMENT dataJ1939Dm1Failrs_as[41].dtc_as[4].occ_u8 "" UBYTE CnvRule_NumberOneToOne 1 0 0 255 ECU_ADDRESS 0x7001693D /end MEASUREMENT
/begin MEASUREMENT dataJ1939Dm1Failrs_as[41].dtc_as[5].spn_u32 "" ULONG CnvRule_NumberOneToOne 1 0 0 4294967295 ECU_ADDRESS 0x70016940 /end MEASUREMENT
/begin MEASUREMENT dataJ1939Dm1Failrs_as[41].dtc_as[5].fmi_u8 "" UBYTE CnvRule_NumberOneToOne 1 0 0 255 ECU_ADDRESS 0x70016944 /end MEASUREMENT
/begin MEASUREMENT dataJ1939Dm1Failrs_as[41].dtc_as[5].occ_u8 "" UBYTE CnvRule_NumberOneToOne 1 0 0 255 ECU_ADDRESS 0x70016945 /end MEASUREMENT
/begin MEASUREMENT dataJ1939Dm1Failrs_as[41].dtc_as[6].spn_u32 "" ULONG CnvRule_NumberOneToOne 1 0 0 4294967295 ECU_ADDRESS 0x70016948 /end MEASUREMENT
/begin MEASUREMENT dataJ1939Dm1Failrs_as[41].dtc_as[6].fmi_u8 "" UBYTE CnvRule_NumberOneToOne 1 0 0 255 ECU_ADDRESS 0x7001694C /end MEASUREMENT
/begin MEASUREMENT dataJ1939Dm1Failrs_as[41].dtc_as[6].occ_u8 "" UBYTE CnvRule_NumberOneToOne 1 0 0 255 ECU_ADDRESS 0x7001694D /end MEASUREMENT
/begin MEASUREMENT dataJ1939Dm1Failrs_as[41].dtc_as[7].spn_u32 "" ULONG CnvRule_NumberOneToOne 1 0 0 4294967295 ECU_ADDRESS 0x70016950 /end MEASUREMENT
/begin MEASUREMENT dataJ1939Dm1Failrs_as[41].dtc_as[7].fmi_u8 "" UBYTE CnvRule_NumberOneToOne 1 0 0 255 ECU_ADDRESS 0x70016954 /end MEASUREMENT
/begin MEASUREMENT dataJ1939Dm1Failrs_as[41].dtc_as[7].occ_u8 "" UBYTE CnvRule_NumberOneToOne 1 0 0 255 ECU_ADDRESS 0x70016955 /end MEASUREMENT
/begin MEASUREMENT dataJ1939Dm1Failrs_as[41].dtc_as[8].spn_u32 "" ULONG CnvRule_NumberOneToOne 1 0 0 4294967295 ECU_ADDRESS 0x70016958 /end MEASUREMENT
/begin MEASUREMENT dataJ1939Dm1Failrs_as[41].dtc_as[8].fmi_u8 "" UBYTE CnvRule_NumberOneToOne 1 0 0 255 ECU_ADDRESS 0x7001695C /end MEASUREMENT
/begin MEASUREMENT dataJ1939Dm1Failrs_as[41].dtc_as[8].occ_u8 "" UBYTE CnvRule_NumberOneToOne 1 0 0 255 ECU_ADDRESS 0x7001695D /end MEASUREMENT
/begin MEASUREMENT dataJ1939Dm1Failrs_as[41].dtc_as[9].spn_u32 "" ULONG CnvRule_NumberOneToOne 1 0 0 4294967295 ECU_ADDRESS 0x70016960 /end MEASUREMENT
/begin MEASUREMENT dataJ1939Dm1Failrs_as[41].dtc_as[9].fmi_u8 "" UBYTE CnvRule_NumberOneToOne 1 0 0 255 ECU_ADDRESS 0x70016964 /end MEASUREMENT
/begin MEASUREMENT dataJ1939Dm1Failrs_as[41].dtc_as[9].occ_u8 "" UBYTE CnvRule_NumberOneToOne 1 0 0 255 ECU_ADDRESS 0x70016965 /end MEASUREMENT
/begin MEASUREMENT dataJ1939Dm1Failrs_as[41].dtc_as[10].spn_u32 "" ULONG CnvRule_NumberOneToOne 1 0 0 4294967295 ECU_ADDRESS 0x70016968 /end MEASUREMENT
/begin MEASUREMENT dataJ1939Dm1Failrs_as[41].dtc_as[10].fmi_u8 "" UBYTE CnvRule_NumberOneToOne 1 0 0 255 ECU_ADDRESS 0x7001696C /end MEASUREMENT
/begin MEASUREMENT dataJ1939Dm1Failrs_as[41].dtc_as[10].occ_u8 "" UBYTE CnvRule_NumberOneToOne 1 0 0 255 ECU_ADDRESS 0x7001696D /end MEASUREMENT
/begin MEASUREMENT dataJ1939Dm1Failrs_as[41].dtc_as[11].spn_u32 "" ULONG CnvRule_NumberOneToOne 1 0 0 4294967295 ECU_ADDRESS 0x70016970 /end MEASUREMENT
/begin MEASUREMENT dataJ1939Dm1Failrs_as[41].dtc_as[11].fmi_u8 "" UBYTE CnvRule_NumberOneToOne 1 0 0 255 ECU_ADDRESS 0x70016974 /end MEASUREMENT
/begin MEASUREMENT dataJ1939Dm1Failrs_as[41].dtc_as[11].occ_u8 "" UBYTE CnvRule_NumberOneToOne 1 0 0 255 ECU_ADDRESS 0x70016975 /end MEASUREMENT
/begin MEASUREMENT dataJ1939Dm1Failrs_as[41].dtc_as[12].spn_u32 "" ULONG CnvRule_NumberOneToOne 1 0 0 4294967295 ECU_ADDRESS 0x70016978 /end MEASUREMENT
/begin MEASUREMENT dataJ1939Dm1Failrs_as[41].dtc_as[12].fmi_u8 "" UBYTE CnvRule_NumberOneToOne 1 0 0 255 ECU_ADDRESS 0x7001697C /end MEASUREMENT
/begin MEASUREMENT dataJ1939Dm1Failrs_as[41].dtc_as[12].occ_u8 "" UBYTE CnvRule_NumberOneToOne 1 0 0 255 ECU_ADDRESS 0x7001697D /end MEASUREMENT
/begin MEASUREMENT dataJ1939Dm1Failrs_as[41].dtc_as[13].spn_u32 "" ULONG CnvRule_NumberOneToOne 1 0 0 4294967295 ECU_ADDRESS 0x70016980 /end MEASUREMENT
/begin MEASUREMENT dataJ1939Dm1Failrs_as[41].dtc_as[13].fmi_u8 "" UBYTE CnvRule_NumberOneToOne 1 0 0 255 ECU_ADDRESS 0x70016984 /end MEASUREMENT
/begin MEASUREMENT dataJ1939Dm1Failrs_as[41].dtc_as[13].occ_u8 "" UBYTE CnvRule_NumberOneToOne 1 0 0 255 ECU_ADDRESS 0x70016985 /end MEASUREMENT
/begin MEASUREMENT dataJ1939Dm1Failrs_as[41].dtc_as[14].spn_u32 "" ULONG CnvRule_NumberOneToOne 1 0 0 4294967295 ECU_ADDRESS 0x70016988 /end MEASUREMENT
/begin MEASUREMENT dataJ1939Dm1Failrs_as[41].dtc_as[14].fmi_u8 "" UBYTE CnvRule_NumberOneToOne 1 0 0 255 ECU_ADDRESS 0x7001698C /end MEASUREMENT
/begin MEASUREMENT dataJ1939Dm1Failrs_as[41].dtc_as[14].occ_u8 "" UBYTE CnvRule_NumberOneToOne 1 0 0 255 ECU_ADDRESS 0x7001698D /end MEASUREMENT
/begin MEASUREMENT dataJ1939Dm1Failrs_as[41].dtc_as[15].spn_u32 "" ULONG CnvRule_NumberOneToOne 1 0 0 4294967295 ECU_ADDRESS 0x70016990 /end MEASUREMENT
/begin MEASUREMENT dataJ1939Dm1Failrs_as[41].dtc_as[15].fmi_u8 "" UBYTE CnvRule_NumberOneToOne 1 0 0 255 ECU_ADDRESS 0x70016994 /end MEASUREMENT
/begin MEASUREMENT dataJ1939Dm1Failrs_as[41].dtc_as[15].occ_u8 "" UBYTE CnvRule_NumberOneToOne 1 0 0 255 ECU_ADDRESS 0x70016995 /end MEASUREMENT
/begin MEASUREMENT dataJ1939Dm1Failrs_as[41].dtc_as[16].spn_u32 "" ULONG CnvRule_NumberOneToOne 1 0 0 4294967295 ECU_ADDRESS 0x70016998 /end MEASUREMENT
/begin MEASUREMENT dataJ1939Dm1Failrs_as[41].dtc_as[16].fmi_u8 "" UBYTE CnvRule_NumberOneToOne 1 0 0 255 ECU_ADDRESS 0x7001699C /end MEASUREMENT
/begin MEASUREMENT dataJ1939Dm1Failrs_as[41].dtc_as[16].occ_u8 "" UBYTE CnvRule_NumberOneToOne 1 0 0 255 ECU_ADDRESS 0x7001699D /end MEASUREMENT
/begin MEASUREMENT dataJ1939Dm1Failrs_as[41].dtc_as[17].spn_u32 "" ULONG CnvRule_NumberOneToOne 1 0 0 4294967295 ECU_ADDRESS 0x700169A0 /end MEASUREMENT
/begin MEASUREMENT dataJ1939Dm1Failrs_as[41].dtc_as[17].fmi_u8 "" UBYTE CnvRule_NumberOneToOne 1 0 0 255 ECU_ADDRESS 0x700169A4 /end MEASUREMENT
/begin MEASUREMENT dataJ1939Dm1Failrs_as[41].dtc_as[17].occ_u8 "" UBYTE CnvRule_NumberOneToOne 1 0 0 255 ECU_ADDRESS 0x700169A5 /end MEASUREMENT
/begin MEASUREMENT dataJ1939Dm1Failrs_as[41].dtc_as[18].spn_u32 "" ULONG CnvRule_NumberOneToOne 1 0 0 4294967295 ECU_ADDRESS 0x700169A8 /end MEASUREMENT
/begin MEASUREMENT dataJ1939Dm1Failrs_as[41].dtc_as[18].fmi_u8 "" UBYTE CnvRule_NumberOneToOne 1 0 0 255 ECU_ADDRESS 0x700169AC /end MEASUREMENT
/begin MEASUREMENT dataJ1939Dm1Failrs_as[41].dtc_as[18].occ_u8 "" UBYTE CnvRule_NumberOneToOne 1 0 0 255 ECU_ADDRESS 0x700169AD /end MEASUREMENT
/begin MEASUREMENT dataJ1939Dm1Failrs_as[41].dtc_as[19].spn_u32 "" ULONG CnvRule_NumberOneToOne 1 0 0 4294967295 ECU_ADDRESS 0x700169B0 /end MEASUREMENT
/begin MEASUREMENT dataJ1939Dm1Failrs_as[41].dtc_as[19].fmi_u8 "" UBYTE CnvRule_NumberOneToOne 1 0 0 255 ECU_ADDRESS 0x700169B4 /end MEASUREMENT
/begin MEASUREMENT dataJ1939Dm1Failrs_as[41].dtc_as[19].occ_u8 "" UBYTE CnvRule_NumberOneToOne 1 0 0 255 ECU_ADDRESS 0x700169B5 /end MEASUREMENT
/begin MEASUREMENT dataJ1939Dm1Failrs_as[41].dtc_as[20].spn_u32 "" ULONG CnvRule_NumberOneToOne 1 0 0 4294967295 ECU_ADDRESS 0x700169B8 /end MEASUREMENT
/begin MEASUREMENT dataJ1939Dm1Failrs_as[41].dtc_as[20].fmi_u8 "" UBYTE CnvRule_NumberOneToOne 1 0 0 255 ECU_ADDRESS 0x700169BC /end MEASUREMENT
/begin MEASUREMENT dataJ1939Dm1Failrs_as[41].dtc_as[20].occ_u8 "" UBYTE CnvRule_NumberOneToOne 1 0 0 255 ECU_ADDRESS 0x700169BD /end MEASUREMENT
/begin MEASUREMENT dataJ1939Dm1Failrs_as[41].dtc_as "" UBYTE CnvRule_NumberOneToOne 1 0 0 255 ECU_ADDRESS 0x70016920 ARRAY_SIZE 160 /end MEASUREMENT
/begin MEASUREMENT dataJ1939Dm1Failrs_as[42].dtc_as[1].spn_u32 "" ULONG CnvRule_NumberOneToOne 1 0 0 4294967295 ECU_ADDRESS 0x700169C4 /end MEASUREMENT
/begin MEASUREMENT dataJ1939Dm1Failrs_as[42].dtc_as[1].fmi_u8 "" UBYTE CnvRule_NumberOneToOne 1 0 0 255 ECU_ADDRESS 0x700169C8 /end MEASUREMENT
/begin MEASUREMENT dataJ1939Dm1Failrs_as[42].dtc_as[1].occ_u8 "" UBYTE CnvRule_NumberOneToOne 1 0 0 255 ECU_ADDRESS 0x700169C9 /end MEASUREMENT
/begin MEASUREMENT dataJ1939Dm1Failrs_as[42].dtc_as[2].spn_u32 "" ULONG CnvRule_NumberOneToOne 1 0 0 4294967295 ECU_ADDRESS 0x700169CC /end MEASUREMENT
/begin MEASUREMENT dataJ1939Dm1Failrs_as[42].dtc_as[2].fmi_u8 "" UBYTE CnvRule_NumberOneToOne 1 0 0 255 ECU_ADDRESS 0x700169D0 /end MEASUREMENT
/begin MEASUREMENT dataJ1939Dm1Failrs_as[42].dtc_as[2].occ_u8 "" UBYTE CnvRule_NumberOneToOne 1 0 0 255 ECU_ADDRESS 0x700169D1 /end MEASUREMENT
/begin MEASUREMENT dataJ1939Dm1Failrs_as[42].dtc_as[3].spn_u32 "" ULONG CnvRule_NumberOneToOne 1 0 0 4294967295 ECU_ADDRESS 0x700169D4 /end MEASUREMENT
/begin MEASUREMENT dataJ1939Dm1Failrs_as[42].dtc_as[3].fmi_u8 "" UBYTE CnvRule_NumberOneToOne 1 0 0 255 ECU_ADDRESS 0x700169D8 /end MEASUREMENT
/begin MEASUREMENT dataJ1939Dm1Failrs_as[42].dtc_as[3].occ_u8 "" UBYTE CnvRule_NumberOneToOne 1 0 0 255 ECU_ADDRESS 0x700169D9 /end MEASUREMENT
/begin MEASUREMENT dataJ1939Dm1Failrs_as[42].dtc_as[4].spn_u32 "" ULONG CnvRule_NumberOneToOne 1 0 0 4294967295 ECU_ADDRESS 0x700169DC /end MEASUREMENT
/begin MEASUREMENT dataJ1939Dm1Failrs_as[42].dtc_as[4].fmi_u8 "" UBYTE CnvRule_NumberOneToOne 1 0 0 255 ECU_ADDRESS 0x700169E0 /end MEASUREMENT
/begin MEASUREMENT dataJ1939Dm1Failrs_as[42].dtc_as[4].occ_u8 "" UBYTE CnvRule_NumberOneToOne 1 0 0 255 ECU_ADDRESS 0x700169E1 /end MEASUREMENT
/begin MEASUREMENT dataJ1939Dm1Failrs_as[42].dtc_as[5].spn_u32 "" ULONG CnvRule_NumberOneToOne 1 0 0 4294967295 ECU_ADDRESS 0x700169E4 /end MEASUREMENT
/begin MEASUREMENT dataJ1939Dm1Failrs_as[42].dtc_as[5].fmi_u8 "" UBYTE CnvRule_NumberOneToOne 1 0 0 255 ECU_ADDRESS 0x700169E8 /end MEASUREMENT
/begin MEASUREMENT dataJ1939Dm1Failrs_as[42].dtc_as[5].occ_u8 "" UBYTE CnvRule_NumberOneToOne 1 0 0 255 ECU_ADDRESS 0x700169E9 /end MEASUREMENT
/begin MEASUREMENT dataJ1939Dm1Failrs_as[42].dtc_as[6].spn_u32 "" ULONG CnvRule_NumberOneToOne 1 0 0 4294967295 ECU_ADDRESS 0x700169EC /end MEASUREMENT
/begin MEASUREMENT dataJ1939Dm1Failrs_as[42].dtc_as[6].fmi_u8 "" UBYTE CnvRule_NumberOneToOne 1 0 0 255 ECU_ADDRESS 0x700169F0 /end MEASUREMENT
/begin MEASUREMENT dataJ1939Dm1Failrs_as[42].dtc_as[6].occ_u8 "" UBYTE CnvRule_NumberOneToOne 1 0 0 255 ECU_ADDRESS 0x700169F1 /end MEASUREMENT
/begin MEASUREMENT dataJ1939Dm1Failrs_as[42].dtc_as[7].spn_u32 "" ULONG CnvRule_NumberOneToOne 1 0 0 4294967295 ECU_ADDRESS 0x700169F4 /end MEASUREMENT
/begin MEASUREMENT dataJ1939Dm1Failrs_as[42].dtc_as[7].fmi_u8 "" UBYTE CnvRule_NumberOneToOne 1 0 0 255 ECU_ADDRESS 0x700169F8 /end MEASUREMENT
/begin MEASUREMENT dataJ1939Dm1Failrs_as[42].dtc_as[7].occ_u8 "" UBYTE CnvRule_NumberOneToOne 1 0 0 255 ECU_ADDRESS 0x700169F9 /end MEASUREMENT
/begin MEASUREMENT dataJ1939Dm1Failrs_as[42].dtc_as[8].spn_u32 "" ULONG CnvRule_NumberOneToOne 1 0 0 4294967295 ECU_ADDRESS 0x700169FC /end MEASUREMENT
/begin MEASUREMENT dataJ1939Dm1Failrs_as[42].dtc_as[8].fmi_u8 "" UBYTE CnvRule_NumberOneToOne 1 0 0 255 ECU_ADDRESS 0x70016A00 /end MEASUREMENT
/begin MEASUREMENT dataJ1939Dm1Failrs_as[42].dtc_as[8].occ_u8 "" UBYTE CnvRule_NumberOneToOne 1 0 0 255 ECU_ADDRESS 0x70016A01 /end MEASUREMENT
/begin MEASUREMENT dataJ1939Dm1Failrs_as[42].dtc_as[9].spn_u32 "" ULONG CnvRule_NumberOneToOne 1 0 0 4294967295 ECU_ADDRESS 0x70016A04 /end MEASUREMENT
/begin MEASUREMENT dataJ1939Dm1Failrs_as[42].dtc_as[9].fmi_u8 "" UBYTE CnvRule_NumberOneToOne 1 0 0 255 ECU_ADDRESS 0x70016A08 /end MEASUREMENT
/begin MEASUREMENT dataJ1939Dm1Failrs_as[42].dtc_as[9].occ_u8 "" UBYTE CnvRule_NumberOneToOne 1 0 0 255 ECU_ADDRESS 0x70016A09 /end MEASUREMENT
/begin MEASUREMENT dataJ1939Dm1Failrs_as[42].dtc_as[10].spn_u32 "" ULONG CnvRule_NumberOneToOne 1 0 0 4294967295 ECU_ADDRESS 0x70016A0C /end MEASUREMENT
/begin MEASUREMENT dataJ1939Dm1Failrs_as[42].dtc_as[10].fmi_u8 "" UBYTE CnvRule_NumberOneToOne 1 0 0 255 ECU_ADDRESS 0x70016A10 /end MEASUREMENT
/begin MEASUREMENT dataJ1939Dm1Failrs_as[42].dtc_as[10].occ_u8 "" UBYTE CnvRule_NumberOneToOne 1 0 0 255 ECU_ADDRESS 0x70016A11 /end MEASUREMENT
/begin MEASUREMENT dataJ1939Dm1Failrs_as[42].dtc_as[11].spn_u32 "" ULONG CnvRule_NumberOneToOne 1 0 0 4294967295 ECU_ADDRESS 0x70016A14 /end MEASUREMENT
/begin MEASUREMENT dataJ1939Dm1Failrs_as[42].dtc_as[11].fmi_u8 "" UBYTE CnvRule_NumberOneToOne 1 0 0 255 ECU_ADDRESS 0x70016A18 /end MEASUREMENT
/begin MEASUREMENT dataJ1939Dm1Failrs_as[42].dtc_as[11].occ_u8 "" UBYTE CnvRule_NumberOneToOne 1 0 0 255 ECU_ADDRESS 0x70016A19 /end MEASUREMENT
/begin MEASUREMENT dataJ1939Dm1Failrs_as[42].dtc_as[12].spn_u32 "" ULONG CnvRule_NumberOneToOne 1 0 0 4294967295 ECU_ADDRESS 0x70016A1C /end MEASUREMENT
/begin MEASUREMENT dataJ1939Dm1Failrs_as[42].dtc_as[12].fmi_u8 "" UBYTE CnvRule_NumberOneToOne 1 0 0 255 ECU_ADDRESS 0x70016A20 /end MEASUREMENT
/begin MEASUREMENT dataJ1939Dm1Failrs_as[42].dtc_as[12].occ_u8 "" UBYTE CnvRule_NumberOneToOne 1 0 0 255 ECU_ADDRESS 0x70016A21 /end MEASUREMENT
/begin MEASUREMENT dataJ1939Dm1Failrs_as[42].dtc_as[13].spn_u32 "" ULONG CnvRule_NumberOneToOne 1 0 0 4294967295 ECU_ADDRESS 0x70016A24 /end MEASUREMENT
/begin MEASUREMENT dataJ1939Dm1Failrs_as[42].dtc_as[13].fmi_u8 "" UBYTE CnvRule_NumberOneToOne 1 0 0 255 ECU_ADDRESS 0x70016A28 /end MEASUREMENT
/begin MEASUREMENT dataJ1939Dm1Failrs_as[42].dtc_as[13].occ_u8 "" UBYTE CnvRule_NumberOneToOne 1 0 0 255 ECU_ADDRESS 0x70016A29 /end MEASUREMENT
/begin MEASUREMENT dataJ1939Dm1Failrs_as[42].dtc_as[14].spn_u32 "" ULONG CnvRule_NumberOneToOne 1 0 0 4294967295 ECU_ADDRESS 0x70016A2C /end MEASUREMENT
/begin MEASUREMENT dataJ1939Dm1Failrs_as[42].dtc_as[14].fmi_u8 "" UBYTE CnvRule_NumberOneToOne 1 0 0 255 ECU_ADDRESS 0x70016A30 /end MEASUREMENT
/begin MEASUREMENT dataJ1939Dm1Failrs_as[42].dtc_as[14].occ_u8 "" UBYTE CnvRule_NumberOneToOne 1 0 0 255 ECU_ADDRESS 0x70016A31 /end MEASUREMENT
/begin MEASUREMENT dataJ1939Dm1Failrs_as[42].dtc_as[15].spn_u32 "" ULONG CnvRule_NumberOneToOne 1 0 0 4294967295 ECU_ADDRESS 0x70016A34 /end MEASUREMENT
/begin MEASUREMENT dataJ1939Dm1Failrs_as[42].dtc_as[15].fmi_u8 "" UBYTE CnvRule_NumberOneToOne 1 0 0 255 ECU_ADDRESS 0x70016A38 /end MEASUREMENT
/begin MEASUREMENT dataJ1939Dm1Failrs_as[42].dtc_as[15].occ_u8 "" UBYTE CnvRule_NumberOneToOne 1 0 0 255 ECU_ADDRESS 0x70016A39 /end MEASUREMENT
/begin MEASUREMENT dataJ1939Dm1Failrs_as[42].dtc_as[16].spn_u32 "" ULONG CnvRule_NumberOneToOne 1 0 0 4294967295 ECU_ADDRESS 0x70016A3C /end MEASUREMENT
/begin MEASUREMENT dataJ1939Dm1Failrs_as[42].dtc_as[16].fmi_u8 "" UBYTE CnvRule_NumberOneToOne 1 0 0 255 ECU_ADDRESS 0x70016A40 /end MEASUREMENT
/begin MEASUREMENT dataJ1939Dm1Failrs_as[42].dtc_as[16].occ_u8 "" UBYTE CnvRule_NumberOneToOne 1 0 0 255 ECU_ADDRESS 0x70016A41 /end MEASUREMENT
/begin MEASUREMENT dataJ1939Dm1Failrs_as[42].dtc_as[17].spn_u32 "" ULONG CnvRule_NumberOneToOne 1 0 0 4294967295 ECU_ADDRESS 0x70016A44 /end MEASUREMENT
/begin MEASUREMENT dataJ1939Dm1Failrs_as[42].dtc_as[17].fmi_u8 "" UBYTE CnvRule_NumberOneToOne 1 0 0 255 ECU_ADDRESS 0x70016A48 /end MEASUREMENT
/begin MEASUREMENT dataJ1939Dm1Failrs_as[42].dtc_as[17].occ_u8 "" UBYTE CnvRule_NumberOneToOne 1 0 0 255 ECU_ADDRESS 0x70016A49 /end MEASUREMENT
/begin MEASUREMENT dataJ1939Dm1Failrs_as[42].dtc_as[18].spn_u32 "" ULONG CnvRule_NumberOneToOne 1 0 0 4294967295 ECU_ADDRESS 0x70016A4C /end MEASUREMENT
/begin MEASUREMENT dataJ1939Dm1Failrs_as[42].dtc_as[18].fmi_u8 "" UBYTE CnvRule_NumberOneToOne 1 0 0 255 ECU_ADDRESS 0x70016A50 /end MEASUREMENT
/begin MEASUREMENT dataJ1939Dm1Failrs_as[42].dtc_as[18].occ_u8 "" UBYTE CnvRule_NumberOneToOne 1 0 0 255 ECU_ADDRESS 0x70016A51 /end MEASUREMENT
/begin MEASUREMENT dataJ1939Dm1Failrs_as[42].dtc_as[19].spn_u32 "" ULONG CnvRule_NumberOneToOne 1 0 0 4294967295 ECU_ADDRESS 0x70016A54 /end MEASUREMENT
/begin MEASUREMENT dataJ1939Dm1Failrs_as[42].dtc_as[19].fmi_u8 "" UBYTE CnvRule_NumberOneToOne 1 0 0 255 ECU_ADDRESS 0x70016A58 /end MEASUREMENT
/begin MEASUREMENT dataJ1939Dm1Failrs_as[42].dtc_as[19].occ_u8 "" UBYTE CnvRule_NumberOneToOne 1 0 0 255 ECU_ADDRESS 0x70016A59 /end MEASUREMENT
/begin MEASUREMENT dataJ1939Dm1Failrs_as[42].dtc_as[20].spn_u32 "" ULONG CnvRule_NumberOneToOne 1 0 0 4294967295 ECU_ADDRESS 0x70016A5C /end MEASUREMENT
/begin MEASUREMENT dataJ1939Dm1Failrs_as[42].dtc_as[20].fmi_u8 "" UBYTE CnvRule_NumberOneToOne 1 0 0 255 ECU_ADDRESS 0x70016A60 /end MEASUREMENT
/begin MEASUREMENT dataJ1939Dm1Failrs_as[42].dtc_as[20].occ_u8 "" UBYTE CnvRule_NumberOneToOne 1 0 0 255 ECU_ADDRESS 0x70016A61 /end MEASUREMENT
/begin MEASUREMENT dataJ1939Dm1Failrs_as[42].dtc_as "" UBYTE CnvRule_NumberOneToOne 1 0 0 255 ECU_ADDRESS 0x700169C4 ARRAY_SIZE 160 /end MEASUREMENT
/begin MEASUREMENT dataJ1939Dm1Failrs_as[43].dtc_as[1].spn_u32 "" ULONG CnvRule_NumberOneToOne 1 0 0 4294967295 ECU_ADDRESS 0x70016A68 /end MEASUREMENT
/begin MEASUREMENT dataJ1939Dm1Failrs_as[43].dtc_as[1].fmi_u8 "" UBYTE CnvRule_NumberOneToOne 1 0 0 255 ECU_ADDRESS 0x70016A6C /end MEASUREMENT
/begin MEASUREMENT dataJ1939Dm1Failrs_as[43].dtc_as[1].occ_u8 "" UBYTE CnvRule_NumberOneToOne 1 0 0 255 ECU_ADDRESS 0x70016A6D /end MEASUREMENT
/begin MEASUREMENT dataJ1939Dm1Failrs_as[43].dtc_as[2].spn_u32 "" ULONG CnvRule_NumberOneToOne 1 0 0 4294967295 ECU_ADDRESS 0x70016A70 /end MEASUREMENT
/begin MEASUREMENT dataJ1939Dm1Failrs_as[43].dtc_as[2].fmi_u8 "" UBYTE CnvRule_NumberOneToOne 1 0 0 255 ECU_ADDRESS 0x70016A74 /end MEASUREMENT
/begin MEASUREMENT dataJ1939Dm1Failrs_as[43].dtc_as[2].occ_u8 "" UBYTE CnvRule_NumberOneToOne 1 0 0 255 ECU_ADDRESS 0x70016A75 /end MEASUREMENT
/begin MEASUREMENT dataJ1939Dm1Failrs_as[43].dtc_as[3].spn_u32 "" ULONG CnvRule_NumberOneToOne 1 0 0 4294967295 ECU_ADDRESS 0x70016A78 /end MEASUREMENT
/begin MEASUREMENT dataJ1939Dm1Failrs_as[43].dtc_as[3].fmi_u8 "" UBYTE CnvRule_NumberOneToOne 1 0 0 255 ECU_ADDRESS 0x70016A7C /end MEASUREMENT
/begin MEASUREMENT dataJ1939Dm1Failrs_as[43].dtc_as[3].occ_u8 "" UBYTE CnvRule_NumberOneToOne 1 0 0 255 ECU_ADDRESS 0x70016A7D /end MEASUREMENT
/begin MEASUREMENT dataJ1939Dm1Failrs_as[43].dtc_as[4].spn_u32 "" ULONG CnvRule_NumberOneToOne 1 0 0 4294967295 ECU_ADDRESS 0x70016A80 /end MEASUREMENT
/begin MEASUREMENT dataJ1939Dm1Failrs_as[43].dtc_as[4].fmi_u8 "" UBYTE CnvRule_NumberOneToOne 1 0 0 255 ECU_ADDRESS 0x70016A84 /end MEASUREMENT
/begin MEASUREMENT dataJ1939Dm1Failrs_as[43].dtc_as[4].occ_u8 "" UBYTE CnvRule_NumberOneToOne 1 0 0 255 ECU_ADDRESS 0x70016A85 /end MEASUREMENT
/begin MEASUREMENT dataJ1939Dm1Failrs_as[43].dtc_as[5].spn_u32 "" ULONG CnvRule_NumberOneToOne 1 0 0 4294967295 ECU_ADDRESS 0x70016A88 /end MEASUREMENT
/begin MEASUREMENT dataJ1939Dm1Failrs_as[43].dtc_as[5].fmi_u8 "" UBYTE CnvRule_NumberOneToOne 1 0 0 255 ECU_ADDRESS 0x70016A8C /end MEASUREMENT
/begin MEASUREMENT dataJ1939Dm1Failrs_as[43].dtc_as[5].occ_u8 "" UBYTE CnvRule_NumberOneToOne 1 0 0 255 ECU_ADDRESS 0x70016A8D /end MEASUREMENT
/begin MEASUREMENT dataJ1939Dm1Failrs_as[43].dtc_as[6].spn_u32 "" ULONG CnvRule_NumberOneToOne 1 0 0 4294967295 ECU_ADDRESS 0x70016A90 /end MEASUREMENT
/begin MEASUREMENT dataJ1939Dm1Failrs_as[43].dtc_as[6].fmi_u8 "" UBYTE CnvRule_NumberOneToOne 1 0 0 255 ECU_ADDRESS 0x70016A94 /end MEASUREMENT
/begin MEASUREMENT dataJ1939Dm1Failrs_as[43].dtc_as[6].occ_u8 "" UBYTE CnvRule_NumberOneToOne 1 0 0 255 ECU_ADDRESS 0x70016A95 /end MEASUREMENT
/begin MEASUREMENT dataJ1939Dm1Failrs_as[43].dtc_as[7].spn_u32 "" ULONG CnvRule_NumberOneToOne 1 0 0 4294967295 ECU_ADDRESS 0x70016A98 /end MEASUREMENT
/begin MEASUREMENT dataJ1939Dm1Failrs_as[43].dtc_as[7].fmi_u8 "" UBYTE CnvRule_NumberOneToOne 1 0 0 255 ECU_ADDRESS 0x70016A9C /end MEASUREMENT
/begin MEASUREMENT dataJ1939Dm1Failrs_as[43].dtc_as[7].occ_u8 "" UBYTE CnvRule_NumberOneToOne 1 0 0 255 ECU_ADDRESS 0x70016A9D /end MEASUREMENT
/begin MEASUREMENT dataJ1939Dm1Failrs_as[43].dtc_as[8].spn_u32 "" ULONG CnvRule_NumberOneToOne 1 0 0 4294967295 ECU_ADDRESS 0x70016AA0 /end MEASUREMENT
/begin MEASUREMENT dataJ1939Dm1Failrs_as[43].dtc_as[8].fmi_u8 "" UBYTE CnvRule_NumberOneToOne 1 0 0 255 ECU_ADDRESS 0x70016AA4 /end MEASUREMENT
/begin MEASUREMENT dataJ1939Dm1Failrs_as[43].dtc_as[8].occ_u8 "" UBYTE CnvRule_NumberOneToOne 1 0 0 255 ECU_ADDRESS 0x70016AA5 /end MEASUREMENT
/begin MEASUREMENT dataJ1939Dm1Failrs_as[43].dtc_as[9].spn_u32 "" ULONG CnvRule_NumberOneToOne 1 0 0 4294967295 ECU_ADDRESS 0x70016AA8 /end MEASUREMENT
/begin MEASUREMENT dataJ1939Dm1Failrs_as[43].dtc_as[9].fmi_u8 "" UBYTE CnvRule_NumberOneToOne 1 0 0 255 ECU_ADDRESS 0x70016AAC /end MEASUREMENT
/begin MEASUREMENT dataJ1939Dm1Failrs_as[43].dtc_as[9].occ_u8 "" UBYTE CnvRule_NumberOneToOne 1 0 0 255 ECU_ADDRESS 0x70016AAD /end MEASUREMENT
/begin MEASUREMENT dataJ1939Dm1Failrs_as[43].dtc_as[10].spn_u32 "" ULONG CnvRule_NumberOneToOne 1 0 0 4294967295 ECU_ADDRESS 0x70016AB0 /end MEASUREMENT
/begin MEASUREMENT dataJ1939Dm1Failrs_as[43].dtc_as[10].fmi_u8 "" UBYTE CnvRule_NumberOneToOne 1 0 0 255 ECU_ADDRESS 0x70016AB4 /end MEASUREMENT
/begin MEASUREMENT dataJ1939Dm1Failrs_as[43].dtc_as[10].occ_u8 "" UBYTE CnvRule_NumberOneToOne 1 0 0 255 ECU_ADDRESS 0x70016AB5 /end MEASUREMENT
/begin MEASUREMENT dataJ1939Dm1Failrs_as[43].dtc_as[11].spn_u32 "" ULONG CnvRule_NumberOneToOne 1 0 0 4294967295 ECU_ADDRESS 0x70016AB8 /end MEASUREMENT
/begin MEASUREMENT dataJ1939Dm1Failrs_as[43].dtc_as[11].fmi_u8 "" UBYTE CnvRule_NumberOneToOne 1 0 0 255 ECU_ADDRESS 0x70016ABC /end MEASUREMENT
/begin MEASUREMENT dataJ1939Dm1Failrs_as[43].dtc_as[11].occ_u8 "" UBYTE CnvRule_NumberOneToOne 1 0 0 255 ECU_ADDRESS 0x70016ABD /end MEASUREMENT
/begin MEASUREMENT dataJ1939Dm1Failrs_as[43].dtc_as[12].spn_u32 "" ULONG CnvRule_NumberOneToOne 1 0 0 4294967295 ECU_ADDRESS 0x70016AC0 /end MEASUREMENT
/begin MEASUREMENT dataJ1939Dm1Failrs_as[43].dtc_as[12].fmi_u8 "" UBYTE CnvRule_NumberOneToOne 1 0 0 255 ECU_ADDRESS 0x70016AC4 /end MEASUREMENT
/begin MEASUREMENT dataJ1939Dm1Failrs_as[43].dtc_as[12].occ_u8 "" UBYTE CnvRule_NumberOneToOne 1 0 0 255 ECU_ADDRESS 0x70016AC5 /end MEASUREMENT
/begin MEASUREMENT dataJ1939Dm1Failrs_as[43].dtc_as[13].spn_u32 "" ULONG CnvRule_NumberOneToOne 1 0 0 4294967295 ECU_ADDRESS 0x70016AC8 /end MEASUREMENT
/begin MEASUREMENT dataJ1939Dm1Failrs_as[43].dtc_as[13].fmi_u8 "" UBYTE CnvRule_NumberOneToOne 1 0 0 255 ECU_ADDRESS 0x70016ACC /end MEASUREMENT
/begin MEASUREMENT dataJ1939Dm1Failrs_as[43].dtc_as[13].occ_u8 "" UBYTE CnvRule_NumberOneToOne 1 0 0 255 ECU_ADDRESS 0x70016ACD /end MEASUREMENT
/begin MEASUREMENT dataJ1939Dm1Failrs_as[43].dtc_as[14].spn_u32 "" ULONG CnvRule_NumberOneToOne 1 0 0 4294967295 ECU_ADDRESS 0x70016AD0 /end MEASUREMENT
/begin MEASUREMENT dataJ1939Dm1Failrs_as[43].dtc_as[14].fmi_u8 "" UBYTE CnvRule_NumberOneToOne 1 0 0 255 ECU_ADDRESS 0x70016AD4 /end MEASUREMENT
/begin MEASUREMENT dataJ1939Dm1Failrs_as[43].dtc_as[14].occ_u8 "" UBYTE CnvRule_NumberOneToOne 1 0 0 255 ECU_ADDRESS 0x70016AD5 /end MEASUREMENT
/begin MEASUREMENT dataJ1939Dm1Failrs_as[43].dtc_as[15].spn_u32 "" ULONG CnvRule_NumberOneToOne 1 0 0 4294967295 ECU_ADDRESS 0x70016AD8 /end MEASUREMENT
/begin MEASUREMENT dataJ1939Dm1Failrs_as[43].dtc_as[15].fmi_u8 "" UBYTE CnvRule_NumberOneToOne 1 0 0 255 ECU_ADDRESS 0x70016ADC /end MEASUREMENT
/begin MEASUREMENT dataJ1939Dm1Failrs_as[43].dtc_as[15].occ_u8 "" UBYTE CnvRule_NumberOneToOne 1 0 0 255 ECU_ADDRESS 0x70016ADD /end MEASUREMENT
/begin MEASUREMENT dataJ1939Dm1Failrs_as[43].dtc_as[16].spn_u32 "" ULONG CnvRule_NumberOneToOne 1 0 0 4294967295 ECU_ADDRESS 0x70016AE0 /end MEASUREMENT
/begin MEASUREMENT dataJ1939Dm1Failrs_as[43].dtc_as[16].fmi_u8 "" UBYTE CnvRule_NumberOneToOne 1 0 0 255 ECU_ADDRESS 0x70016AE4 /end MEASUREMENT
/begin MEASUREMENT dataJ1939Dm1Failrs_as[43].dtc_as[16].occ_u8 "" UBYTE CnvRule_NumberOneToOne 1 0 0 255 ECU_ADDRESS 0x70016AE5 /end MEASUREMENT
/begin MEASUREMENT dataJ1939Dm1Failrs_as[43].dtc_as[17].spn_u32 "" ULONG CnvRule_NumberOneToOne 1 0 0 4294967295 ECU_ADDRESS 0x70016AE8 /end MEASUREMENT
/begin MEASUREMENT dataJ1939Dm1Failrs_as[43].dtc_as[17].fmi_u8 "" UBYTE CnvRule_NumberOneToOne 1 0 0 255 ECU_ADDRESS 0x70016AEC /end MEASUREMENT
/begin MEASUREMENT dataJ1939Dm1Failrs_as[43].dtc_as[17].occ_u8 "" UBYTE CnvRule_NumberOneToOne 1 0 0 255 ECU_ADDRESS 0x70016AED /end MEASUREMENT
/begin MEASUREMENT dataJ1939Dm1Failrs_as[43].dtc_as[18].spn_u32 "" ULONG CnvRule_NumberOneToOne 1 0 0 4294967295 ECU_ADDRESS 0x70016AF0 /end MEASUREMENT
/begin MEASUREMENT dataJ1939Dm1Failrs_as[43].dtc_as[18].fmi_u8 "" UBYTE CnvRule_NumberOneToOne 1 0 0 255 ECU_ADDRESS 0x70016AF4 /end MEASUREMENT
/begin MEASUREMENT dataJ1939Dm1Failrs_as[43].dtc_as[18].occ_u8 "" UBYTE CnvRule_NumberOneToOne 1 0 0 255 ECU_ADDRESS 0x70016AF5 /end MEASUREMENT
/begin MEASUREMENT dataJ1939Dm1Failrs_as[43].dtc_as[19].spn_u32 "" ULONG CnvRule_NumberOneToOne 1 0 0 4294967295 ECU_ADDRESS 0x70016AF8 /end MEASUREMENT
/begin MEASUREMENT dataJ1939Dm1Failrs_as[43].dtc_as[19].fmi_u8 "" UBYTE CnvRule_NumberOneToOne 1 0 0 255 ECU_ADDRESS 0x70016AFC /end MEASUREMENT
/begin MEASUREMENT dataJ1939Dm1Failrs_as[43].dtc_as[19].occ_u8 "" UBYTE CnvRule_NumberOneToOne 1 0 0 255 ECU_ADDRESS 0x70016AFD /end MEASUREMENT
/begin MEASUREMENT dataJ1939Dm1Failrs_as[43].dtc_as[20].spn_u32 "" ULONG CnvRule_NumberOneToOne 1 0 0 4294967295 ECU_ADDRESS 0x70016B00 /end MEASUREMENT
/begin MEASUREMENT dataJ1939Dm1Failrs_as[43].dtc_as[20].fmi_u8 "" UBYTE CnvRule_NumberOneToOne 1 0 0 255 ECU_ADDRESS 0x70016B04 /end MEASUREMENT
/begin MEASUREMENT dataJ1939Dm1Failrs_as[43].dtc_as[20].occ_u8 "" UBYTE CnvRule_NumberOneToOne 1 0 0 255 ECU_ADDRESS 0x70016B05 /end MEASUREMENT
/begin MEASUREMENT dataJ1939Dm1Failrs_as[43].dtc_as "" UBYTE CnvRule_NumberOneToOne 1 0 0 255 ECU_ADDRESS 0x70016A68 ARRAY_SIZE 160 /end MEASUREMENT
/begin MEASUREMENT dataJ1939Dm1Failrs_as[44].dtc_as[1].spn_u32 "" ULONG CnvRule_NumberOneToOne 1 0 0 4294967295 ECU_ADDRESS 0x70016B0C /end MEASUREMENT
/begin MEASUREMENT dataJ1939Dm1Failrs_as[44].dtc_as[1].fmi_u8 "" UBYTE CnvRule_NumberOneToOne 1 0 0 255 ECU_ADDRESS 0x70016B10 /end MEASUREMENT
/begin MEASUREMENT dataJ1939Dm1Failrs_as[44].dtc_as[1].occ_u8 "" UBYTE CnvRule_NumberOneToOne 1 0 0 255 ECU_ADDRESS 0x70016B11 /end MEASUREMENT
/begin MEASUREMENT dataJ1939Dm1Failrs_as[44].dtc_as[2].spn_u32 "" ULONG CnvRule_NumberOneToOne 1 0 0 4294967295 ECU_ADDRESS 0x70016B14 /end MEASUREMENT
/begin MEASUREMENT dataJ1939Dm1Failrs_as[44].dtc_as[2].fmi_u8 "" UBYTE CnvRule_NumberOneToOne 1 0 0 255 ECU_ADDRESS 0x70016B18 /end MEASUREMENT
/begin MEASUREMENT dataJ1939Dm1Failrs_as[44].dtc_as[2].occ_u8 "" UBYTE CnvRule_NumberOneToOne 1 0 0 255 ECU_ADDRESS 0x70016B19 /end MEASUREMENT
/begin MEASUREMENT dataJ1939Dm1Failrs_as[44].dtc_as[3].spn_u32 "" ULONG CnvRule_NumberOneToOne 1 0 0 4294967295 ECU_ADDRESS 0x70016B1C /end MEASUREMENT
/begin MEASUREMENT dataJ1939Dm1Failrs_as[44].dtc_as[3].fmi_u8 "" UBYTE CnvRule_NumberOneToOne 1 0 0 255 ECU_ADDRESS 0x70016B20 /end MEASUREMENT
/begin MEASUREMENT dataJ1939Dm1Failrs_as[44].dtc_as[3].occ_u8 "" UBYTE CnvRule_NumberOneToOne 1 0 0 255 ECU_ADDRESS 0x70016B21 /end MEASUREMENT
/begin MEASUREMENT dataJ1939Dm1Failrs_as[44].dtc_as[4].spn_u32 "" ULONG CnvRule_NumberOneToOne 1 0 0 4294967295 ECU_ADDRESS 0x70016B24 /end MEASUREMENT
/begin MEASUREMENT dataJ1939Dm1Failrs_as[44].dtc_as[4].fmi_u8 "" UBYTE CnvRule_NumberOneToOne 1 0 0 255 ECU_ADDRESS 0x70016B28 /end MEASUREMENT
/begin MEASUREMENT dataJ1939Dm1Failrs_as[44].dtc_as[4].occ_u8 "" UBYTE CnvRule_NumberOneToOne 1 0 0 255 ECU_ADDRESS 0x70016B29 /end MEASUREMENT
/begin MEASUREMENT dataJ1939Dm1Failrs_as[44].dtc_as[5].spn_u32 "" ULONG CnvRule_NumberOneToOne 1 0 0 4294967295 ECU_ADDRESS 0x70016B2C /end MEASUREMENT
/begin MEASUREMENT dataJ1939Dm1Failrs_as[44].dtc_as[5].fmi_u8 "" UBYTE CnvRule_NumberOneToOne 1 0 0 255 ECU_ADDRESS 0x70016B30 /end MEASUREMENT
/begin MEASUREMENT dataJ1939Dm1Failrs_as[44].dtc_as[5].occ_u8 "" UBYTE CnvRule_NumberOneToOne 1 0 0 255 ECU_ADDRESS 0x70016B31 /end MEASUREMENT
/begin MEASUREMENT dataJ1939Dm1Failrs_as[44].dtc_as[6].spn_u32 "" ULONG CnvRule_NumberOneToOne 1 0 0 4294967295 ECU_ADDRESS 0x70016B34 /end MEASUREMENT
/begin MEASUREMENT dataJ1939Dm1Failrs_as[44].dtc_as[6].fmi_u8 "" UBYTE CnvRule_NumberOneToOne 1 0 0 255 ECU_ADDRESS 0x70016B38 /end MEASUREMENT
/begin MEASUREMENT dataJ1939Dm1Failrs_as[44].dtc_as[6].occ_u8 "" UBYTE CnvRule_NumberOneToOne 1 0 0 255 ECU_ADDRESS 0x70016B39 /end MEASUREMENT
/begin MEASUREMENT dataJ1939Dm1Failrs_as[44].dtc_as[7].spn_u32 "" ULONG CnvRule_NumberOneToOne 1 0 0 4294967295 ECU_ADDRESS 0x70016B3C /end MEASUREMENT
/begin MEASUREMENT dataJ1939Dm1Failrs_as[44].dtc_as[7].fmi_u8 "" UBYTE CnvRule_NumberOneToOne 1 0 0 255 ECU_ADDRESS 0x70016B40 /end MEASUREMENT
/begin MEASUREMENT dataJ1939Dm1Failrs_as[44].dtc_as[7].occ_u8 "" UBYTE CnvRule_NumberOneToOne 1 0 0 255 ECU_ADDRESS 0x70016B41 /end MEASUREMENT
/begin MEASUREMENT dataJ1939Dm1Failrs_as[44].dtc_as[8].spn_u32 "" ULONG CnvRule_NumberOneToOne 1 0 0 4294967295 ECU_ADDRESS 0x70016B44 /end MEASUREMENT
/begin MEASUREMENT dataJ1939Dm1Failrs_as[44].dtc_as[8].fmi_u8 "" UBYTE CnvRule_NumberOneToOne 1 0 0 255 ECU_ADDRESS 0x70016B48 /end MEASUREMENT
/begin MEASUREMENT dataJ1939Dm1Failrs_as[44].dtc_as[8].occ_u8 "" UBYTE CnvRule_NumberOneToOne 1 0 0 255 ECU_ADDRESS 0x70016B49 /end MEASUREMENT
/begin MEASUREMENT dataJ1939Dm1Failrs_as[44].dtc_as[9].spn_u32 "" ULONG CnvRule_NumberOneToOne 1 0 0 4294967295 ECU_ADDRESS 0x70016B4C /end MEASUREMENT
/begin MEASUREMENT dataJ1939Dm1Failrs_as[44].dtc_as[9].fmi_u8 "" UBYTE CnvRule_NumberOneToOne 1 0 0 255 ECU_ADDRESS 0x70016B50 /end MEASUREMENT
/begin MEASUREMENT dataJ1939Dm1Failrs_as[44].dtc_as[9].occ_u8 "" UBYTE CnvRule_NumberOneToOne 1 0 0 255 ECU_ADDRESS 0x70016B51 /end MEASUREMENT
/begin MEASUREMENT dataJ1939Dm1Failrs_as[44].dtc_as[10].spn_u32 "" ULONG CnvRule_NumberOneToOne 1 0 0 4294967295 ECU_ADDRESS 0x70016B54 /end MEASUREMENT
/begin MEASUREMENT dataJ1939Dm1Failrs_as[44].dtc_as[10].fmi_u8 "" UBYTE CnvRule_NumberOneToOne 1 0 0 255 ECU_ADDRESS 0x70016B58 /end MEASUREMENT
/begin MEASUREMENT dataJ1939Dm1Failrs_as[44].dtc_as[10].occ_u8 "" UBYTE CnvRule_NumberOneToOne 1 0 0 255 ECU_ADDRESS 0x70016B59 /end MEASUREMENT
/begin MEASUREMENT dataJ1939Dm1Failrs_as[44].dtc_as[11].spn_u32 "" ULONG CnvRule_NumberOneToOne 1 0 0 4294967295 ECU_ADDRESS 0x70016B5C /end MEASUREMENT
/begin MEASUREMENT dataJ1939Dm1Failrs_as[44].dtc_as[11].fmi_u8 "" UBYTE CnvRule_NumberOneToOne 1 0 0 255 ECU_ADDRESS 0x70016B60 /end MEASUREMENT
/begin MEASUREMENT dataJ1939Dm1Failrs_as[44].dtc_as[11].occ_u8 "" UBYTE CnvRule_NumberOneToOne 1 0 0 255 ECU_ADDRESS 0x70016B61 /end MEASUREMENT
/begin MEASUREMENT dataJ1939Dm1Failrs_as[44].dtc_as[12].spn_u32 "" ULONG CnvRule_NumberOneToOne 1 0 0 4294967295 ECU_ADDRESS 0x70016B64 /end MEASUREMENT
/begin MEASUREMENT dataJ1939Dm1Failrs_as[44].dtc_as[12].fmi_u8 "" UBYTE CnvRule_NumberOneToOne 1 0 0 255 ECU_ADDRESS 0x70016B68 /end MEASUREMENT
/begin MEASUREMENT dataJ1939Dm1Failrs_as[44].dtc_as[12].occ_u8 "" UBYTE CnvRule_NumberOneToOne 1 0 0 255 ECU_ADDRESS 0x70016B69 /end MEASUREMENT
/begin MEASUREMENT dataJ1939Dm1Failrs_as[44].dtc_as[13].spn_u32 "" ULONG CnvRule_NumberOneToOne 1 0 0 4294967295 ECU_ADDRESS 0x70016B6C /end MEASUREMENT
/begin MEASUREMENT dataJ1939Dm1Failrs_as[44].dtc_as[13].fmi_u8 "" UBYTE CnvRule_NumberOneToOne 1 0 0 255 ECU_ADDRESS 0x70016B70 /end MEASUREMENT
/begin MEASUREMENT dataJ1939Dm1Failrs_as[44].dtc_as[13].occ_u8 "" UBYTE CnvRule_NumberOneToOne 1 0 0 255 ECU_ADDRESS 0x70016B71 /end MEASUREMENT
/begin MEASUREMENT dataJ1939Dm1Failrs_as[44].dtc_as[14].spn_u32 "" ULONG CnvRule_NumberOneToOne 1 0 0 4294967295 ECU_ADDRESS 0x70016B74 /end MEASUREMENT
/begin MEASUREMENT dataJ1939Dm1Failrs_as[44].dtc_as[14].fmi_u8 "" UBYTE CnvRule_NumberOneToOne 1 0 0 255 ECU_ADDRESS 0x70016B78 /end MEASUREMENT
/begin MEASUREMENT dataJ1939Dm1Failrs_as[44].dtc_as[14].occ_u8 "" UBYTE CnvRule_NumberOneToOne 1 0 0 255 ECU_ADDRESS 0x70016B79 /end MEASUREMENT
/begin MEASUREMENT dataJ1939Dm1Failrs_as[44].dtc_as[15].spn_u32 "" ULONG CnvRule_NumberOneToOne 1 0 0 4294967295 ECU_ADDRESS 0x70016B7C /end MEASUREMENT
/begin MEASUREMENT dataJ1939Dm1Failrs_as[44].dtc_as[15].fmi_u8 "" UBYTE CnvRule_NumberOneToOne 1 0 0 255 ECU_ADDRESS 0x70016B80 /end MEASUREMENT
/begin MEASUREMENT dataJ1939Dm1Failrs_as[44].dtc_as[15].occ_u8 "" UBYTE CnvRule_NumberOneToOne 1 0 0 255 ECU_ADDRESS 0x70016B81 /end MEASUREMENT
/begin MEASUREMENT dataJ1939Dm1Failrs_as[44].dtc_as[16].spn_u32 "" ULONG CnvRule_NumberOneToOne 1 0 0 4294967295 ECU_ADDRESS 0x70016B84 /end MEASUREMENT
/begin MEASUREMENT dataJ1939Dm1Failrs_as[44].dtc_as[16].fmi_u8 "" UBYTE CnvRule_NumberOneToOne 1 0 0 255 ECU_ADDRESS 0x70016B88 /end MEASUREMENT
/begin MEASUREMENT dataJ1939Dm1Failrs_as[44].dtc_as[16].occ_u8 "" UBYTE CnvRule_NumberOneToOne 1 0 0 255 ECU_ADDRESS 0x70016B89 /end MEASUREMENT
/begin MEASUREMENT dataJ1939Dm1Failrs_as[44].dtc_as[17].spn_u32 "" ULONG CnvRule_NumberOneToOne 1 0 0 4294967295 ECU_ADDRESS 0x70016B8C /end MEASUREMENT
/begin MEASUREMENT dataJ1939Dm1Failrs_as[44].dtc_as[17].fmi_u8 "" UBYTE CnvRule_NumberOneToOne 1 0 0 255 ECU_ADDRESS 0x70016B90 /end MEASUREMENT
/begin MEASUREMENT dataJ1939Dm1Failrs_as[44].dtc_as[17].occ_u8 "" UBYTE CnvRule_NumberOneToOne 1 0 0 255 ECU_ADDRESS 0x70016B91 /end MEASUREMENT
/begin MEASUREMENT dataJ1939Dm1Failrs_as[44].dtc_as[18].spn_u32 "" ULONG CnvRule_NumberOneToOne 1 0 0 4294967295 ECU_ADDRESS 0x70016B94 /end MEASUREMENT
/begin MEASUREMENT dataJ1939Dm1Failrs_as[44].dtc_as[18].fmi_u8 "" UBYTE CnvRule_NumberOneToOne 1 0 0 255 ECU_ADDRESS 0x70016B98 /end MEASUREMENT
/begin MEASUREMENT dataJ1939Dm1Failrs_as[44].dtc_as[18].occ_u8 "" UBYTE CnvRule_NumberOneToOne 1 0 0 255 ECU_ADDRESS 0x70016B99 /end MEASUREMENT
/begin MEASUREMENT dataJ1939Dm1Failrs_as[44].dtc_as[19].spn_u32 "" ULONG CnvRule_NumberOneToOne 1 0 0 4294967295 ECU_ADDRESS 0x70016B9C /end MEASUREMENT
/begin MEASUREMENT dataJ1939Dm1Failrs_as[44].dtc_as[19].fmi_u8 "" UBYTE CnvRule_NumberOneToOne 1 0 0 255 ECU_ADDRESS 0x70016BA0 /end MEASUREMENT
/begin MEASUREMENT dataJ1939Dm1Failrs_as[44].dtc_as[19].occ_u8 "" UBYTE CnvRule_NumberOneToOne 1 0 0 255 ECU_ADDRESS 0x70016BA1 /end MEASUREMENT
/begin MEASUREMENT dataJ1939Dm1Failrs_as[44].dtc_as[20].spn_u32 "" ULONG CnvRule_NumberOneToOne 1 0 0 4294967295 ECU_ADDRESS 0x70016BA4 /end MEASUREMENT
/begin MEASUREMENT dataJ1939Dm1Failrs_as[44].dtc_as[20].fmi_u8 "" UBYTE CnvRule_NumberOneToOne 1 0 0 255 ECU_ADDRESS 0x70016BA8 /end MEASUREMENT
/begin MEASUREMENT dataJ1939Dm1Failrs_as[44].dtc_as[20].occ_u8 "" UBYTE CnvRule_NumberOneToOne 1 0 0 255 ECU_ADDRESS 0x70016BA9 /end MEASUREMENT
/begin MEASUREMENT dataJ1939Dm1Failrs_as[44].dtc_as "" UBYTE CnvRule_NumberOneToOne 1 0 0 255 ECU_ADDRESS 0x70016B0C ARRAY_SIZE 160 /end MEASUREMENT
/begin MEASUREMENT dataJ1939Dm1Failrs_as[45].dtc_as[1].spn_u32 "" ULONG CnvRule_NumberOneToOne 1 0 0 4294967295 ECU_ADDRESS 0x70016BB0 /end MEASUREMENT
/begin MEASUREMENT dataJ1939Dm1Failrs_as[45].dtc_as[1].fmi_u8 "" UBYTE CnvRule_NumberOneToOne 1 0 0 255 ECU_ADDRESS 0x70016BB4 /end MEASUREMENT
/begin MEASUREMENT dataJ1939Dm1Failrs_as[45].dtc_as[1].occ_u8 "" UBYTE CnvRule_NumberOneToOne 1 0 0 255 ECU_ADDRESS 0x70016BB5 /end MEASUREMENT
/begin MEASUREMENT dataJ1939Dm1Failrs_as[45].dtc_as[2].spn_u32 "" ULONG CnvRule_NumberOneToOne 1 0 0 4294967295 ECU_ADDRESS 0x70016BB8 /end MEASUREMENT
/begin MEASUREMENT dataJ1939Dm1Failrs_as[45].dtc_as[2].fmi_u8 "" UBYTE CnvRule_NumberOneToOne 1 0 0 255 ECU_ADDRESS 0x70016BBC /end MEASUREMENT
/begin MEASUREMENT dataJ1939Dm1Failrs_as[45].dtc_as[2].occ_u8 "" UBYTE CnvRule_NumberOneToOne 1 0 0 255 ECU_ADDRESS 0x70016BBD /end MEASUREMENT
/begin MEASUREMENT dataJ1939Dm1Failrs_as[45].dtc_as[3].spn_u32 "" ULONG CnvRule_NumberOneToOne 1 0 0 4294967295 ECU_ADDRESS 0x70016BC0 /end MEASUREMENT
/begin MEASUREMENT dataJ1939Dm1Failrs_as[45].dtc_as[3].fmi_u8 "" UBYTE CnvRule_NumberOneToOne 1 0 0 255 ECU_ADDRESS 0x70016BC4 /end MEASUREMENT
/begin MEASUREMENT dataJ1939Dm1Failrs_as[45].dtc_as[3].occ_u8 "" UBYTE CnvRule_NumberOneToOne 1 0 0 255 ECU_ADDRESS 0x70016BC5 /end MEASUREMENT
/begin MEASUREMENT dataJ1939Dm1Failrs_as[45].dtc_as[4].spn_u32 "" ULONG CnvRule_NumberOneToOne 1 0 0 4294967295 ECU_ADDRESS 0x70016BC8 /end MEASUREMENT
/begin MEASUREMENT dataJ1939Dm1Failrs_as[45].dtc_as[4].fmi_u8 "" UBYTE CnvRule_NumberOneToOne 1 0 0 255 ECU_ADDRESS 0x70016BCC /end MEASUREMENT
/begin MEASUREMENT dataJ1939Dm1Failrs_as[45].dtc_as[4].occ_u8 "" UBYTE CnvRule_NumberOneToOne 1 0 0 255 ECU_ADDRESS 0x70016BCD /end MEASUREMENT
/begin MEASUREMENT dataJ1939Dm1Failrs_as[45].dtc_as[5].spn_u32 "" ULONG CnvRule_NumberOneToOne 1 0 0 4294967295 ECU_ADDRESS 0x70016BD0 /end MEASUREMENT
/begin MEASUREMENT dataJ1939Dm1Failrs_as[45].dtc_as[5].fmi_u8 "" UBYTE CnvRule_NumberOneToOne 1 0 0 255 ECU_ADDRESS 0x70016BD4 /end MEASUREMENT
/begin MEASUREMENT dataJ1939Dm1Failrs_as[45].dtc_as[5].occ_u8 "" UBYTE CnvRule_NumberOneToOne 1 0 0 255 ECU_ADDRESS 0x70016BD5 /end MEASUREMENT
/begin MEASUREMENT dataJ1939Dm1Failrs_as[45].dtc_as[6].spn_u32 "" ULONG CnvRule_NumberOneToOne 1 0 0 4294967295 ECU_ADDRESS 0x70016BD8 /end MEASUREMENT
/begin MEASUREMENT dataJ1939Dm1Failrs_as[45].dtc_as[6].fmi_u8 "" UBYTE CnvRule_NumberOneToOne 1 0 0 255 ECU_ADDRESS 0x70016BDC /end MEASUREMENT
/begin MEASUREMENT dataJ1939Dm1Failrs_as[45].dtc_as[6].occ_u8 "" UBYTE CnvRule_NumberOneToOne 1 0 0 255 ECU_ADDRESS 0x70016BDD /end MEASUREMENT
/begin MEASUREMENT dataJ1939Dm1Failrs_as[45].dtc_as[7].spn_u32 "" ULONG CnvRule_NumberOneToOne 1 0 0 4294967295 ECU_ADDRESS 0x70016BE0 /end MEASUREMENT
/begin MEASUREMENT dataJ1939Dm1Failrs_as[45].dtc_as[7].fmi_u8 "" UBYTE CnvRule_NumberOneToOne 1 0 0 255 ECU_ADDRESS 0x70016BE4 /end MEASUREMENT
/begin MEASUREMENT dataJ1939Dm1Failrs_as[45].dtc_as[7].occ_u8 "" UBYTE CnvRule_NumberOneToOne 1 0 0 255 ECU_ADDRESS 0x70016BE5 /end MEASUREMENT
/begin MEASUREMENT dataJ1939Dm1Failrs_as[45].dtc_as[8].spn_u32 "" ULONG CnvRule_NumberOneToOne 1 0 0 4294967295 ECU_ADDRESS 0x70016BE8 /end MEASUREMENT
/begin MEASUREMENT dataJ1939Dm1Failrs_as[45].dtc_as[8].fmi_u8 "" UBYTE CnvRule_NumberOneToOne 1 0 0 255 ECU_ADDRESS 0x70016BEC /end MEASUREMENT
/begin MEASUREMENT dataJ1939Dm1Failrs_as[45].dtc_as[8].occ_u8 "" UBYTE CnvRule_NumberOneToOne 1 0 0 255 ECU_ADDRESS 0x70016BED /end MEASUREMENT
/begin MEASUREMENT dataJ1939Dm1Failrs_as[45].dtc_as[9].spn_u32 "" ULONG CnvRule_NumberOneToOne 1 0 0 4294967295 ECU_ADDRESS 0x70016BF0 /end MEASUREMENT
/begin MEASUREMENT dataJ1939Dm1Failrs_as[45].dtc_as[9].fmi_u8 "" UBYTE CnvRule_NumberOneToOne 1 0 0 255 ECU_ADDRESS 0x70016BF4 /end MEASUREMENT
/begin MEASUREMENT dataJ1939Dm1Failrs_as[45].dtc_as[9].occ_u8 "" UBYTE CnvRule_NumberOneToOne 1 0 0 255 ECU_ADDRESS 0x70016BF5 /end MEASUREMENT
/begin MEASUREMENT dataJ1939Dm1Failrs_as[45].dtc_as[10].spn_u32 "" ULONG CnvRule_NumberOneToOne 1 0 0 4294967295 ECU_ADDRESS 0x70016BF8 /end MEASUREMENT
/begin MEASUREMENT dataJ1939Dm1Failrs_as[45].dtc_as[10].fmi_u8 "" UBYTE CnvRule_NumberOneToOne 1 0 0 255 ECU_ADDRESS 0x70016BFC /end MEASUREMENT
/begin MEASUREMENT dataJ1939Dm1Failrs_as[45].dtc_as[10].occ_u8 "" UBYTE CnvRule_NumberOneToOne 1 0 0 255 ECU_ADDRESS 0x70016BFD /end MEASUREMENT
/begin MEASUREMENT dataJ1939Dm1Failrs_as[45].dtc_as[11].spn_u32 "" ULONG CnvRule_NumberOneToOne 1 0 0 4294967295 ECU_ADDRESS 0x70016C00 /end MEASUREMENT
/begin MEASUREMENT dataJ1939Dm1Failrs_as[45].dtc_as[11].fmi_u8 "" UBYTE CnvRule_NumberOneToOne 1 0 0 255 ECU_ADDRESS 0x70016C04 /end MEASUREMENT
/begin MEASUREMENT dataJ1939Dm1Failrs_as[45].dtc_as[11].occ_u8 "" UBYTE CnvRule_NumberOneToOne 1 0 0 255 ECU_ADDRESS 0x70016C05 /end MEASUREMENT
/begin MEASUREMENT dataJ1939Dm1Failrs_as[45].dtc_as[12].spn_u32 "" ULONG CnvRule_NumberOneToOne 1 0 0 4294967295 ECU_ADDRESS 0x70016C08 /end MEASUREMENT
/begin MEASUREMENT dataJ1939Dm1Failrs_as[45].dtc_as[12].fmi_u8 "" UBYTE CnvRule_NumberOneToOne 1 0 0 255 ECU_ADDRESS 0x70016C0C /end MEASUREMENT
/begin MEASUREMENT dataJ1939Dm1Failrs_as[45].dtc_as[12].occ_u8 "" UBYTE CnvRule_NumberOneToOne 1 0 0 255 ECU_ADDRESS 0x70016C0D /end MEASUREMENT
/begin MEASUREMENT dataJ1939Dm1Failrs_as[45].dtc_as[13].spn_u32 "" ULONG CnvRule_NumberOneToOne 1 0 0 4294967295 ECU_ADDRESS 0x70016C10 /end MEASUREMENT
/begin MEASUREMENT dataJ1939Dm1Failrs_as[45].dtc_as[13].fmi_u8 "" UBYTE CnvRule_NumberOneToOne 1 0 0 255 ECU_ADDRESS 0x70016C14 /end MEASUREMENT
/begin MEASUREMENT dataJ1939Dm1Failrs_as[45].dtc_as[13].occ_u8 "" UBYTE CnvRule_NumberOneToOne 1 0 0 255 ECU_ADDRESS 0x70016C15 /end MEASUREMENT
/begin MEASUREMENT dataJ1939Dm1Failrs_as[45].dtc_as[14].spn_u32 "" ULONG CnvRule_NumberOneToOne 1 0 0 4294967295 ECU_ADDRESS 0x70016C18 /end MEASUREMENT
/begin MEASUREMENT dataJ1939Dm1Failrs_as[45].dtc_as[14].fmi_u8 "" UBYTE CnvRule_NumberOneToOne 1 0 0 255 ECU_ADDRESS 0x70016C1C /end MEASUREMENT
/begin MEASUREMENT dataJ1939Dm1Failrs_as[45].dtc_as[14].occ_u8 "" UBYTE CnvRule_NumberOneToOne 1 0 0 255 ECU_ADDRESS 0x70016C1D /end MEASUREMENT
/begin MEASUREMENT dataJ1939Dm1Failrs_as[45].dtc_as[15].spn_u32 "" ULONG CnvRule_NumberOneToOne 1 0 0 4294967295 ECU_ADDRESS 0x70016C20 /end MEASUREMENT
/begin MEASUREMENT dataJ1939Dm1Failrs_as[45].dtc_as[15].fmi_u8 "" UBYTE CnvRule_NumberOneToOne 1 0 0 255 ECU_ADDRESS 0x70016C24 /end MEASUREMENT
/begin MEASUREMENT dataJ1939Dm1Failrs_as[45].dtc_as[15].occ_u8 "" UBYTE CnvRule_NumberOneToOne 1 0 0 255 ECU_ADDRESS 0x70016C25 /end MEASUREMENT
/begin MEASUREMENT dataJ1939Dm1Failrs_as[45].dtc_as[16].spn_u32 "" ULONG CnvRule_NumberOneToOne 1 0 0 4294967295 ECU_ADDRESS 0x70016C28 /end MEASUREMENT
/begin MEASUREMENT dataJ1939Dm1Failrs_as[45].dtc_as[16].fmi_u8 "" UBYTE CnvRule_NumberOneToOne 1 0 0 255 ECU_ADDRESS 0x70016C2C /end MEASUREMENT
/begin MEASUREMENT dataJ1939Dm1Failrs_as[45].dtc_as[16].occ_u8 "" UBYTE CnvRule_NumberOneToOne 1 0 0 255 ECU_ADDRESS 0x70016C2D /end MEASUREMENT
/begin MEASUREMENT dataJ1939Dm1Failrs_as[45].dtc_as[17].spn_u32 "" ULONG CnvRule_NumberOneToOne 1 0 0 4294967295 ECU_ADDRESS 0x70016C30 /end MEASUREMENT
/begin MEASUREMENT dataJ1939Dm1Failrs_as[45].dtc_as[17].fmi_u8 "" UBYTE CnvRule_NumberOneToOne 1 0 0 255 ECU_ADDRESS 0x70016C34 /end MEASUREMENT
/begin MEASUREMENT dataJ1939Dm1Failrs_as[45].dtc_as[17].occ_u8 "" UBYTE CnvRule_NumberOneToOne 1 0 0 255 ECU_ADDRESS 0x70016C35 /end MEASUREMENT
/begin MEASUREMENT dataJ1939Dm1Failrs_as[45].dtc_as[18].spn_u32 "" ULONG CnvRule_NumberOneToOne 1 0 0 4294967295 ECU_ADDRESS 0x70016C38 /end MEASUREMENT
/begin MEASUREMENT dataJ1939Dm1Failrs_as[45].dtc_as[18].fmi_u8 "" UBYTE CnvRule_NumberOneToOne 1 0 0 255 ECU_ADDRESS 0x70016C3C /end MEASUREMENT
/begin MEASUREMENT dataJ1939Dm1Failrs_as[45].dtc_as[18].occ_u8 "" UBYTE CnvRule_NumberOneToOne 1 0 0 255 ECU_ADDRESS 0x70016C3D /end MEASUREMENT
/begin MEASUREMENT dataJ1939Dm1Failrs_as[45].dtc_as[19].spn_u32 "" ULONG CnvRule_NumberOneToOne 1 0 0 4294967295 ECU_ADDRESS 0x70016C40 /end MEASUREMENT
/begin MEASUREMENT dataJ1939Dm1Failrs_as[45].dtc_as[19].fmi_u8 "" UBYTE CnvRule_NumberOneToOne 1 0 0 255 ECU_ADDRESS 0x70016C44 /end MEASUREMENT
/begin MEASUREMENT dataJ1939Dm1Failrs_as[45].dtc_as[19].occ_u8 "" UBYTE CnvRule_NumberOneToOne 1 0 0 255 ECU_ADDRESS 0x70016C45 /end MEASUREMENT
/begin MEASUREMENT dataJ1939Dm1Failrs_as[45].dtc_as[20].spn_u32 "" ULONG CnvRule_NumberOneToOne 1 0 0 4294967295 ECU_ADDRESS 0x70016C48 /end MEASUREMENT
/begin MEASUREMENT dataJ1939Dm1Failrs_as[45].dtc_as[20].fmi_u8 "" UBYTE CnvRule_NumberOneToOne 1 0 0 255 ECU_ADDRESS 0x70016C4C /end MEASUREMENT
/begin MEASUREMENT dataJ1939Dm1Failrs_as[45].dtc_as[20].occ_u8 "" UBYTE CnvRule_NumberOneToOne 1 0 0 255 ECU_ADDRESS 0x70016C4D /end MEASUREMENT
/begin MEASUREMENT dataJ1939Dm1Failrs_as[45].dtc_as "" UBYTE CnvRule_NumberOneToOne 1 0 0 255 ECU_ADDRESS 0x70016BB0 ARRAY_SIZE 160 /end MEASUREMENT
/begin MEASUREMENT dataJ1939Dm1Failrs_as[46].dtc_as[1].spn_u32 "" ULONG CnvRule_NumberOneToOne 1 0 0 4294967295 ECU_ADDRESS 0x70016C54 /end MEASUREMENT
/begin MEASUREMENT dataJ1939Dm1Failrs_as[46].dtc_as[1].fmi_u8 "" UBYTE CnvRule_NumberOneToOne 1 0 0 255 ECU_ADDRESS 0x70016C58 /end MEASUREMENT
/begin MEASUREMENT dataJ1939Dm1Failrs_as[46].dtc_as[1].occ_u8 "" UBYTE CnvRule_NumberOneToOne 1 0 0 255 ECU_ADDRESS 0x70016C59 /end MEASUREMENT
/begin MEASUREMENT dataJ1939Dm1Failrs_as[46].dtc_as[2].spn_u32 "" ULONG CnvRule_NumberOneToOne 1 0 0 4294967295 ECU_ADDRESS 0x70016C5C /end MEASUREMENT
/begin MEASUREMENT dataJ1939Dm1Failrs_as[46].dtc_as[2].fmi_u8 "" UBYTE CnvRule_NumberOneToOne 1 0 0 255 ECU_ADDRESS 0x70016C60 /end MEASUREMENT
/begin MEASUREMENT dataJ1939Dm1Failrs_as[46].dtc_as[2].occ_u8 "" UBYTE CnvRule_NumberOneToOne 1 0 0 255 ECU_ADDRESS 0x70016C61 /end MEASUREMENT
/begin MEASUREMENT dataJ1939Dm1Failrs_as[46].dtc_as[3].spn_u32 "" ULONG CnvRule_NumberOneToOne 1 0 0 4294967295 ECU_ADDRESS 0x70016C64 /end MEASUREMENT
/begin MEASUREMENT dataJ1939Dm1Failrs_as[46].dtc_as[3].fmi_u8 "" UBYTE CnvRule_NumberOneToOne 1 0 0 255 ECU_ADDRESS 0x70016C68 /end MEASUREMENT
/begin MEASUREMENT dataJ1939Dm1Failrs_as[46].dtc_as[3].occ_u8 "" UBYTE CnvRule_NumberOneToOne 1 0 0 255 ECU_ADDRESS 0x70016C69 /end MEASUREMENT
/begin MEASUREMENT dataJ1939Dm1Failrs_as[46].dtc_as[4].spn_u32 "" ULONG CnvRule_NumberOneToOne 1 0 0 4294967295 ECU_ADDRESS 0x70016C6C /end MEASUREMENT
/begin MEASUREMENT dataJ1939Dm1Failrs_as[46].dtc_as[4].fmi_u8 "" UBYTE CnvRule_NumberOneToOne 1 0 0 255 ECU_ADDRESS 0x70016C70 /end MEASUREMENT
/begin MEASUREMENT dataJ1939Dm1Failrs_as[46].dtc_as[4].occ_u8 "" UBYTE CnvRule_NumberOneToOne 1 0 0 255 ECU_ADDRESS 0x70016C71 /end MEASUREMENT
/begin MEASUREMENT dataJ1939Dm1Failrs_as[46].dtc_as[5].spn_u32 "" ULONG CnvRule_NumberOneToOne 1 0 0 4294967295 ECU_ADDRESS 0x70016C74 /end MEASUREMENT
/begin MEASUREMENT dataJ1939Dm1Failrs_as[46].dtc_as[5].fmi_u8 "" UBYTE CnvRule_NumberOneToOne 1 0 0 255 ECU_ADDRESS 0x70016C78 /end MEASUREMENT
/begin MEASUREMENT dataJ1939Dm1Failrs_as[46].dtc_as[5].occ_u8 "" UBYTE CnvRule_NumberOneToOne 1 0 0 255 ECU_ADDRESS 0x70016C79 /end MEASUREMENT
/begin MEASUREMENT dataJ1939Dm1Failrs_as[46].dtc_as[6].spn_u32 "" ULONG CnvRule_NumberOneToOne 1 0 0 4294967295 ECU_ADDRESS 0x70016C7C /end MEASUREMENT
/begin MEASUREMENT dataJ1939Dm1Failrs_as[46].dtc_as[6].fmi_u8 "" UBYTE CnvRule_NumberOneToOne 1 0 0 255 ECU_ADDRESS 0x70016C80 /end MEASUREMENT
/begin MEASUREMENT dataJ1939Dm1Failrs_as[46].dtc_as[6].occ_u8 "" UBYTE CnvRule_NumberOneToOne 1 0 0 255 ECU_ADDRESS 0x70016C81 /end MEASUREMENT
/begin MEASUREMENT dataJ1939Dm1Failrs_as[46].dtc_as[7].spn_u32 "" ULONG CnvRule_NumberOneToOne 1 0 0 4294967295 ECU_ADDRESS 0x70016C84 /end MEASUREMENT
/begin MEASUREMENT dataJ1939Dm1Failrs_as[46].dtc_as[7].fmi_u8 "" UBYTE CnvRule_NumberOneToOne 1 0 0 255 ECU_ADDRESS 0x70016C88 /end MEASUREMENT
/begin MEASUREMENT dataJ1939Dm1Failrs_as[46].dtc_as[7].occ_u8 "" UBYTE CnvRule_NumberOneToOne 1 0 0 255 ECU_ADDRESS 0x70016C89 /end MEASUREMENT
/begin MEASUREMENT dataJ1939Dm1Failrs_as[46].dtc_as[8].spn_u32 "" ULONG CnvRule_NumberOneToOne 1 0 0 4294967295 ECU_ADDRESS 0x70016C8C /end MEASUREMENT
/begin MEASUREMENT dataJ1939Dm1Failrs_as[46].dtc_as[8].fmi_u8 "" UBYTE CnvRule_NumberOneToOne 1 0 0 255 ECU_ADDRESS 0x70016C90 /end MEASUREMENT
/begin MEASUREMENT dataJ1939Dm1Failrs_as[46].dtc_as[8].occ_u8 "" UBYTE CnvRule_NumberOneToOne 1 0 0 255 ECU_ADDRESS 0x70016C91 /end MEASUREMENT
/begin MEASUREMENT dataJ1939Dm1Failrs_as[46].dtc_as[9].spn_u32 "" ULONG CnvRule_NumberOneToOne 1 0 0 4294967295 ECU_ADDRESS 0x70016C94 /end MEASUREMENT
/begin MEASUREMENT dataJ1939Dm1Failrs_as[46].dtc_as[9].fmi_u8 "" UBYTE CnvRule_NumberOneToOne 1 0 0 255 ECU_ADDRESS 0x70016C98 /end MEASUREMENT
/begin MEASUREMENT dataJ1939Dm1Failrs_as[46].dtc_as[9].occ_u8 "" UBYTE CnvRule_NumberOneToOne 1 0 0 255 ECU_ADDRESS 0x70016C99 /end MEASUREMENT
/begin MEASUREMENT dataJ1939Dm1Failrs_as[46].dtc_as[10].spn_u32 "" ULONG CnvRule_NumberOneToOne 1 0 0 4294967295 ECU_ADDRESS 0x70016C9C /end MEASUREMENT
/begin MEASUREMENT dataJ1939Dm1Failrs_as[46].dtc_as[10].fmi_u8 "" UBYTE CnvRule_NumberOneToOne 1 0 0 255 ECU_ADDRESS 0x70016CA0 /end MEASUREMENT
/begin MEASUREMENT dataJ1939Dm1Failrs_as[46].dtc_as[10].occ_u8 "" UBYTE CnvRule_NumberOneToOne 1 0 0 255 ECU_ADDRESS 0x70016CA1 /end MEASUREMENT
/begin MEASUREMENT dataJ1939Dm1Failrs_as[46].dtc_as[11].spn_u32 "" ULONG CnvRule_NumberOneToOne 1 0 0 4294967295 ECU_ADDRESS 0x70016CA4 /end MEASUREMENT
/begin MEASUREMENT dataJ1939Dm1Failrs_as[46].dtc_as[11].fmi_u8 "" UBYTE CnvRule_NumberOneToOne 1 0 0 255 ECU_ADDRESS 0x70016CA8 /end MEASUREMENT
/begin MEASUREMENT dataJ1939Dm1Failrs_as[46].dtc_as[11].occ_u8 "" UBYTE CnvRule_NumberOneToOne 1 0 0 255 ECU_ADDRESS 0x70016CA9 /end MEASUREMENT
/begin MEASUREMENT dataJ1939Dm1Failrs_as[46].dtc_as[12].spn_u32 "" ULONG CnvRule_NumberOneToOne 1 0 0 4294967295 ECU_ADDRESS 0x70016CAC /end MEASUREMENT
/begin MEASUREMENT dataJ1939Dm1Failrs_as[46].dtc_as[12].fmi_u8 "" UBYTE CnvRule_NumberOneToOne 1 0 0 255 ECU_ADDRESS 0x70016CB0 /end MEASUREMENT
/begin MEASUREMENT dataJ1939Dm1Failrs_as[46].dtc_as[12].occ_u8 "" UBYTE CnvRule_NumberOneToOne 1 0 0 255 ECU_ADDRESS 0x70016CB1 /end MEASUREMENT
/begin MEASUREMENT dataJ1939Dm1Failrs_as[46].dtc_as[13].spn_u32 "" ULONG CnvRule_NumberOneToOne 1 0 0 4294967295 ECU_ADDRESS 0x70016CB4 /end MEASUREMENT
/begin MEASUREMENT dataJ1939Dm1Failrs_as[46].dtc_as[13].fmi_u8 "" UBYTE CnvRule_NumberOneToOne 1 0 0 255 ECU_ADDRESS 0x70016CB8 /end MEASUREMENT
/begin MEASUREMENT dataJ1939Dm1Failrs_as[46].dtc_as[13].occ_u8 "" UBYTE CnvRule_NumberOneToOne 1 0 0 255 ECU_ADDRESS 0x70016CB9 /end MEASUREMENT
/begin MEASUREMENT dataJ1939Dm1Failrs_as[46].dtc_as[14].spn_u32 "" ULONG CnvRule_NumberOneToOne 1 0 0 4294967295 ECU_ADDRESS 0x70016CBC /end MEASUREMENT
/begin MEASUREMENT dataJ1939Dm1Failrs_as[46].dtc_as[14].fmi_u8 "" UBYTE CnvRule_NumberOneToOne 1 0 0 255 ECU_ADDRESS 0x70016CC0 /end MEASUREMENT
/begin MEASUREMENT dataJ1939Dm1Failrs_as[46].dtc_as[14].occ_u8 "" UBYTE CnvRule_NumberOneToOne 1 0 0 255 ECU_ADDRESS 0x70016CC1 /end MEASUREMENT
/begin MEASUREMENT dataJ1939Dm1Failrs_as[46].dtc_as[15].spn_u32 "" ULONG CnvRule_NumberOneToOne 1 0 0 4294967295 ECU_ADDRESS 0x70016CC4 /end MEASUREMENT
/begin MEASUREMENT dataJ1939Dm1Failrs_as[46].dtc_as[15].fmi_u8 "" UBYTE CnvRule_NumberOneToOne 1 0 0 255 ECU_ADDRESS 0x70016CC8 /end MEASUREMENT
/begin MEASUREMENT dataJ1939Dm1Failrs_as[46].dtc_as[15].occ_u8 "" UBYTE CnvRule_NumberOneToOne 1 0 0 255 ECU_ADDRESS 0x70016CC9 /end MEASUREMENT
/begin MEASUREMENT dataJ1939Dm1Failrs_as[46].dtc_as[16].spn_u32 "" ULONG CnvRule_NumberOneToOne 1 0 0 4294967295 ECU_ADDRESS 0x70016CCC /end MEASUREMENT
/begin MEASUREMENT dataJ1939Dm1Failrs_as[46].dtc_as[16].fmi_u8 "" UBYTE CnvRule_NumberOneToOne 1 0 0 255 ECU_ADDRESS 0x70016CD0 /end MEASUREMENT
/begin MEASUREMENT dataJ1939Dm1Failrs_as[46].dtc_as[16].occ_u8 "" UBYTE CnvRule_NumberOneToOne 1 0 0 255 ECU_ADDRESS 0x70016CD1 /end MEASUREMENT
/begin MEASUREMENT dataJ1939Dm1Failrs_as[46].dtc_as[17].spn_u32 "" ULONG CnvRule_NumberOneToOne 1 0 0 4294967295 ECU_ADDRESS 0x70016CD4 /end MEASUREMENT
/begin MEASUREMENT dataJ1939Dm1Failrs_as[46].dtc_as[17].fmi_u8 "" UBYTE CnvRule_NumberOneToOne 1 0 0 255 ECU_ADDRESS 0x70016CD8 /end MEASUREMENT
/begin MEASUREMENT dataJ1939Dm1Failrs_as[46].dtc_as[17].occ_u8 "" UBYTE CnvRule_NumberOneToOne 1 0 0 255 ECU_ADDRESS 0x70016CD9 /end MEASUREMENT
/begin MEASUREMENT dataJ1939Dm1Failrs_as[46].dtc_as[18].spn_u32 "" ULONG CnvRule_NumberOneToOne 1 0 0 4294967295 ECU_ADDRESS 0x70016CDC /end MEASUREMENT
/begin MEASUREMENT dataJ1939Dm1Failrs_as[46].dtc_as[18].fmi_u8 "" UBYTE CnvRule_NumberOneToOne 1 0 0 255 ECU_ADDRESS 0x70016CE0 /end MEASUREMENT
/begin MEASUREMENT dataJ1939Dm1Failrs_as[46].dtc_as[18].occ_u8 "" UBYTE CnvRule_NumberOneToOne 1 0 0 255 ECU_ADDRESS 0x70016CE1 /end MEASUREMENT
/begin MEASUREMENT dataJ1939Dm1Failrs_as[46].dtc_as[19].spn_u32 "" ULONG CnvRule_NumberOneToOne 1 0 0 4294967295 ECU_ADDRESS 0x70016CE4 /end MEASUREMENT
/begin MEASUREMENT dataJ1939Dm1Failrs_as[46].dtc_as[19].fmi_u8 "" UBYTE CnvRule_NumberOneToOne 1 0 0 255 ECU_ADDRESS 0x70016CE8 /end MEASUREMENT
/begin MEASUREMENT dataJ1939Dm1Failrs_as[46].dtc_as[19].occ_u8 "" UBYTE CnvRule_NumberOneToOne 1 0 0 255 ECU_ADDRESS 0x70016CE9 /end MEASUREMENT
/begin MEASUREMENT dataJ1939Dm1Failrs_as[46].dtc_as[20].spn_u32 "" ULONG CnvRule_NumberOneToOne 1 0 0 4294967295 ECU_ADDRESS 0x70016CEC /end MEASUREMENT
/begin MEASUREMENT dataJ1939Dm1Failrs_as[46].dtc_as[20].fmi_u8 "" UBYTE CnvRule_NumberOneToOne 1 0 0 255 ECU_ADDRESS 0x70016CF0 /end MEASUREMENT
/begin MEASUREMENT dataJ1939Dm1Failrs_as[46].dtc_as[20].occ_u8 "" UBYTE CnvRule_NumberOneToOne 1 0 0 255 ECU_ADDRESS 0x70016CF1 /end MEASUREMENT
/begin MEASUREMENT dataJ1939Dm1Failrs_as[46].dtc_as "" UBYTE CnvRule_NumberOneToOne 1 0 0 255 ECU_ADDRESS 0x70016C54 ARRAY_SIZE 160 /end MEASUREMENT
/begin MEASUREMENT dataJ1939Dm1Failrs_as[47].dtc_as[1].spn_u32 "" ULONG CnvRule_NumberOneToOne 1 0 0 4294967295 ECU_ADDRESS 0x70016CF8 /end MEASUREMENT
/begin MEASUREMENT dataJ1939Dm1Failrs_as[47].dtc_as[1].fmi_u8 "" UBYTE CnvRule_NumberOneToOne 1 0 0 255 ECU_ADDRESS 0x70016CFC /end MEASUREMENT
/begin MEASUREMENT dataJ1939Dm1Failrs_as[47].dtc_as[1].occ_u8 "" UBYTE CnvRule_NumberOneToOne 1 0 0 255 ECU_ADDRESS 0x70016CFD /end MEASUREMENT
/begin MEASUREMENT dataJ1939Dm1Failrs_as[47].dtc_as[2].spn_u32 "" ULONG CnvRule_NumberOneToOne 1 0 0 4294967295 ECU_ADDRESS 0x70016D00 /end MEASUREMENT
/begin MEASUREMENT dataJ1939Dm1Failrs_as[47].dtc_as[2].fmi_u8 "" UBYTE CnvRule_NumberOneToOne 1 0 0 255 ECU_ADDRESS 0x70016D04 /end MEASUREMENT
/begin MEASUREMENT dataJ1939Dm1Failrs_as[47].dtc_as[2].occ_u8 "" UBYTE CnvRule_NumberOneToOne 1 0 0 255 ECU_ADDRESS 0x70016D05 /end MEASUREMENT
/begin MEASUREMENT dataJ1939Dm1Failrs_as[47].dtc_as[3].spn_u32 "" ULONG CnvRule_NumberOneToOne 1 0 0 4294967295 ECU_ADDRESS 0x70016D08 /end MEASUREMENT
/begin MEASUREMENT dataJ1939Dm1Failrs_as[47].dtc_as[3].fmi_u8 "" UBYTE CnvRule_NumberOneToOne 1 0 0 255 ECU_ADDRESS 0x70016D0C /end MEASUREMENT
/begin MEASUREMENT dataJ1939Dm1Failrs_as[47].dtc_as[3].occ_u8 "" UBYTE CnvRule_NumberOneToOne 1 0 0 255 ECU_ADDRESS 0x70016D0D /end MEASUREMENT
/begin MEASUREMENT dataJ1939Dm1Failrs_as[47].dtc_as[4].spn_u32 "" ULONG CnvRule_NumberOneToOne 1 0 0 4294967295 ECU_ADDRESS 0x70016D10 /end MEASUREMENT
/begin MEASUREMENT dataJ1939Dm1Failrs_as[47].dtc_as[4].fmi_u8 "" UBYTE CnvRule_NumberOneToOne 1 0 0 255 ECU_ADDRESS 0x70016D14 /end MEASUREMENT
/begin MEASUREMENT dataJ1939Dm1Failrs_as[47].dtc_as[4].occ_u8 "" UBYTE CnvRule_NumberOneToOne 1 0 0 255 ECU_ADDRESS 0x70016D15 /end MEASUREMENT
/begin MEASUREMENT dataJ1939Dm1Failrs_as[47].dtc_as[5].spn_u32 "" ULONG CnvRule_NumberOneToOne 1 0 0 4294967295 ECU_ADDRESS 0x70016D18 /end MEASUREMENT
/begin MEASUREMENT dataJ1939Dm1Failrs_as[47].dtc_as[5].fmi_u8 "" UBYTE CnvRule_NumberOneToOne 1 0 0 255 ECU_ADDRESS 0x70016D1C /end MEASUREMENT
/begin MEASUREMENT dataJ1939Dm1Failrs_as[47].dtc_as[5].occ_u8 "" UBYTE CnvRule_NumberOneToOne 1 0 0 255 ECU_ADDRESS 0x70016D1D /end MEASUREMENT
/begin MEASUREMENT dataJ1939Dm1Failrs_as[47].dtc_as[6].spn_u32 "" ULONG CnvRule_NumberOneToOne 1 0 0 4294967295 ECU_ADDRESS 0x70016D20 /end MEASUREMENT
/begin MEASUREMENT dataJ1939Dm1Failrs_as[47].dtc_as[6].fmi_u8 "" UBYTE CnvRule_NumberOneToOne 1 0 0 255 ECU_ADDRESS 0x70016D24 /end MEASUREMENT
/begin MEASUREMENT dataJ1939Dm1Failrs_as[47].dtc_as[6].occ_u8 "" UBYTE CnvRule_NumberOneToOne 1 0 0 255 ECU_ADDRESS 0x70016D25 /end MEASUREMENT
/begin MEASUREMENT dataJ1939Dm1Failrs_as[47].dtc_as[7].spn_u32 "" ULONG CnvRule_NumberOneToOne 1 0 0 4294967295 ECU_ADDRESS 0x70016D28 /end MEASUREMENT
/begin MEASUREMENT dataJ1939Dm1Failrs_as[47].dtc_as[7].fmi_u8 "" UBYTE CnvRule_NumberOneToOne 1 0 0 255 ECU_ADDRESS 0x70016D2C /end MEASUREMENT
/begin MEASUREMENT dataJ1939Dm1Failrs_as[47].dtc_as[7].occ_u8 "" UBYTE CnvRule_NumberOneToOne 1 0 0 255 ECU_ADDRESS 0x70016D2D /end MEASUREMENT
/begin MEASUREMENT dataJ1939Dm1Failrs_as[47].dtc_as[8].spn_u32 "" ULONG CnvRule_NumberOneToOne 1 0 0 4294967295 ECU_ADDRESS 0x70016D30 /end MEASUREMENT
/begin MEASUREMENT dataJ1939Dm1Failrs_as[47].dtc_as[8].fmi_u8 "" UBYTE CnvRule_NumberOneToOne 1 0 0 255 ECU_ADDRESS 0x70016D34 /end MEASUREMENT
/begin MEASUREMENT dataJ1939Dm1Failrs_as[47].dtc_as[8].occ_u8 "" UBYTE CnvRule_NumberOneToOne 1 0 0 255 ECU_ADDRESS 0x70016D35 /end MEASUREMENT
/begin MEASUREMENT dataJ1939Dm1Failrs_as[47].dtc_as[9].spn_u32 "" ULONG CnvRule_NumberOneToOne 1 0 0 4294967295 ECU_ADDRESS 0x70016D38 /end MEASUREMENT
/begin MEASUREMENT dataJ1939Dm1Failrs_as[47].dtc_as[9].fmi_u8 "" UBYTE CnvRule_NumberOneToOne 1 0 0 255 ECU_ADDRESS 0x70016D3C /end MEASUREMENT
/begin MEASUREMENT dataJ1939Dm1Failrs_as[47].dtc_as[9].occ_u8 "" UBYTE CnvRule_NumberOneToOne 1 0 0 255 ECU_ADDRESS 0x70016D3D /end MEASUREMENT
/begin MEASUREMENT dataJ1939Dm1Failrs_as[47].dtc_as[10].spn_u32 "" ULONG CnvRule_NumberOneToOne 1 0 0 4294967295 ECU_ADDRESS 0x70016D40 /end MEASUREMENT
/begin MEASUREMENT dataJ1939Dm1Failrs_as[47].dtc_as[10].fmi_u8 "" UBYTE CnvRule_NumberOneToOne 1 0 0 255 ECU_ADDRESS 0x70016D44 /end MEASUREMENT
/begin MEASUREMENT dataJ1939Dm1Failrs_as[47].dtc_as[10].occ_u8 "" UBYTE CnvRule_NumberOneToOne 1 0 0 255 ECU_ADDRESS 0x70016D45 /end MEASUREMENT
/begin MEASUREMENT dataJ1939Dm1Failrs_as[47].dtc_as[11].spn_u32 "" ULONG CnvRule_NumberOneToOne 1 0 0 4294967295 ECU_ADDRESS 0x70016D48 /end MEASUREMENT
/begin MEASUREMENT dataJ1939Dm1Failrs_as[47].dtc_as[11].fmi_u8 "" UBYTE CnvRule_NumberOneToOne 1 0 0 255 ECU_ADDRESS 0x70016D4C /end MEASUREMENT
/begin MEASUREMENT dataJ1939Dm1Failrs_as[47].dtc_as[11].occ_u8 "" UBYTE CnvRule_NumberOneToOne 1 0 0 255 ECU_ADDRESS 0x70016D4D /end MEASUREMENT
/begin MEASUREMENT dataJ1939Dm1Failrs_as[47].dtc_as[12].spn_u32 "" ULONG CnvRule_NumberOneToOne 1 0 0 4294967295 ECU_ADDRESS 0x70016D50 /end MEASUREMENT
/begin MEASUREMENT dataJ1939Dm1Failrs_as[47].dtc_as[12].fmi_u8 "" UBYTE CnvRule_NumberOneToOne 1 0 0 255 ECU_ADDRESS 0x70016D54 /end MEASUREMENT
/begin MEASUREMENT dataJ1939Dm1Failrs_as[47].dtc_as[12].occ_u8 "" UBYTE CnvRule_NumberOneToOne 1 0 0 255 ECU_ADDRESS 0x70016D55 /end MEASUREMENT
/begin MEASUREMENT dataJ1939Dm1Failrs_as[47].dtc_as[13].spn_u32 "" ULONG CnvRule_NumberOneToOne 1 0 0 4294967295 ECU_ADDRESS 0x70016D58 /end MEASUREMENT
/begin MEASUREMENT dataJ1939Dm1Failrs_as[47].dtc_as[13].fmi_u8 "" UBYTE CnvRule_NumberOneToOne 1 0 0 255 ECU_ADDRESS 0x70016D5C /end MEASUREMENT
/begin MEASUREMENT dataJ1939Dm1Failrs_as[47].dtc_as[13].occ_u8 "" UBYTE CnvRule_NumberOneToOne 1 0 0 255 ECU_ADDRESS 0x70016D5D /end MEASUREMENT
/begin MEASUREMENT dataJ1939Dm1Failrs_as[47].dtc_as[14].spn_u32 "" ULONG CnvRule_NumberOneToOne 1 0 0 4294967295 ECU_ADDRESS 0x70016D60 /end MEASUREMENT
/begin MEASUREMENT dataJ1939Dm1Failrs_as[47].dtc_as[14].fmi_u8 "" UBYTE CnvRule_NumberOneToOne 1 0 0 255 ECU_ADDRESS 0x70016D64 /end MEASUREMENT
/begin MEASUREMENT dataJ1939Dm1Failrs_as[47].dtc_as[14].occ_u8 "" UBYTE CnvRule_NumberOneToOne 1 0 0 255 ECU_ADDRESS 0x70016D65 /end MEASUREMENT
/begin MEASUREMENT dataJ1939Dm1Failrs_as[47].dtc_as[15].spn_u32 "" ULONG CnvRule_NumberOneToOne 1 0 0 4294967295 ECU_ADDRESS 0x70016D68 /end MEASUREMENT
/begin MEASUREMENT dataJ1939Dm1Failrs_as[47].dtc_as[15].fmi_u8 "" UBYTE CnvRule_NumberOneToOne 1 0 0 255 ECU_ADDRESS 0x70016D6C /end MEASUREMENT
/begin MEASUREMENT dataJ1939Dm1Failrs_as[47].dtc_as[15].occ_u8 "" UBYTE CnvRule_NumberOneToOne 1 0 0 255 ECU_ADDRESS 0x70016D6D /end MEASUREMENT
/begin MEASUREMENT dataJ1939Dm1Failrs_as[47].dtc_as[16].spn_u32 "" ULONG CnvRule_NumberOneToOne 1 0 0 4294967295 ECU_ADDRESS 0x70016D70 /end MEASUREMENT
/begin MEASUREMENT dataJ1939Dm1Failrs_as[47].dtc_as[16].fmi_u8 "" UBYTE CnvRule_NumberOneToOne 1 0 0 255 ECU_ADDRESS 0x70016D74 /end MEASUREMENT
/begin MEASUREMENT dataJ1939Dm1Failrs_as[47].dtc_as[16].occ_u8 "" UBYTE CnvRule_NumberOneToOne 1 0 0 255 ECU_ADDRESS 0x70016D75 /end MEASUREMENT
/begin MEASUREMENT dataJ1939Dm1Failrs_as[47].dtc_as[17].spn_u32 "" ULONG CnvRule_NumberOneToOne 1 0 0 4294967295 ECU_ADDRESS 0x70016D78 /end MEASUREMENT
/begin MEASUREMENT dataJ1939Dm1Failrs_as[47].dtc_as[17].fmi_u8 "" UBYTE CnvRule_NumberOneToOne 1 0 0 255 ECU_ADDRESS 0x70016D7C /end MEASUREMENT
/begin MEASUREMENT dataJ1939Dm1Failrs_as[47].dtc_as[17].occ_u8 "" UBYTE CnvRule_NumberOneToOne 1 0 0 255 ECU_ADDRESS 0x70016D7D /end MEASUREMENT
/begin MEASUREMENT dataJ1939Dm1Failrs_as[47].dtc_as[18].spn_u32 "" ULONG CnvRule_NumberOneToOne 1 0 0 4294967295 ECU_ADDRESS 0x70016D80 /end MEASUREMENT
/begin MEASUREMENT dataJ1939Dm1Failrs_as[47].dtc_as[18].fmi_u8 "" UBYTE CnvRule_NumberOneToOne 1 0 0 255 ECU_ADDRESS 0x70016D84 /end MEASUREMENT
/begin MEASUREMENT dataJ1939Dm1Failrs_as[47].dtc_as[18].occ_u8 "" UBYTE CnvRule_NumberOneToOne 1 0 0 255 ECU_ADDRESS 0x70016D85 /end MEASUREMENT
/begin MEASUREMENT dataJ1939Dm1Failrs_as[47].dtc_as[19].spn_u32 "" ULONG CnvRule_NumberOneToOne 1 0 0 4294967295 ECU_ADDRESS 0x70016D88 /end MEASUREMENT
/begin MEASUREMENT dataJ1939Dm1Failrs_as[47].dtc_as[19].fmi_u8 "" UBYTE CnvRule_NumberOneToOne 1 0 0 255 ECU_ADDRESS 0x70016D8C /end MEASUREMENT
/begin MEASUREMENT dataJ1939Dm1Failrs_as[47].dtc_as[19].occ_u8 "" UBYTE CnvRule_NumberOneToOne 1 0 0 255 ECU_ADDRESS 0x70016D8D /end MEASUREMENT
/begin MEASUREMENT dataJ1939Dm1Failrs_as[47].dtc_as[20].spn_u32 "" ULONG CnvRule_NumberOneToOne 1 0 0 4294967295 ECU_ADDRESS 0x70016D90 /end MEASUREMENT
/begin MEASUREMENT dataJ1939Dm1Failrs_as[47].dtc_as[20].fmi_u8 "" UBYTE CnvRule_NumberOneToOne 1 0 0 255 ECU_ADDRESS 0x70016D94 /end MEASUREMENT
/begin MEASUREMENT dataJ1939Dm1Failrs_as[47].dtc_as[20].occ_u8 "" UBYTE CnvRule_NumberOneToOne 1 0 0 255 ECU_ADDRESS 0x70016D95 /end MEASUREMENT
/begin MEASUREMENT dataJ1939Dm1Failrs_as[47].dtc_as "" UBYTE CnvRule_NumberOneToOne 1 0 0 255 ECU_ADDRESS 0x70016CF8 ARRAY_SIZE 160 /end MEASUREMENT
/begin MEASUREMENT dataJ1939Dm1Failrs_as[48].dtc_as[1].spn_u32 "" ULONG CnvRule_NumberOneToOne 1 0 0 4294967295 ECU_ADDRESS 0x70016D9C /end MEASUREMENT
/begin MEASUREMENT dataJ1939Dm1Failrs_as[48].dtc_as[1].fmi_u8 "" UBYTE CnvRule_NumberOneToOne 1 0 0 255 ECU_ADDRESS 0x70016DA0 /end MEASUREMENT
/begin MEASUREMENT dataJ1939Dm1Failrs_as[48].dtc_as[1].occ_u8 "" UBYTE CnvRule_NumberOneToOne 1 0 0 255 ECU_ADDRESS 0x70016DA1 /end MEASUREMENT
/begin MEASUREMENT dataJ1939Dm1Failrs_as[48].dtc_as[2].spn_u32 "" ULONG CnvRule_NumberOneToOne 1 0 0 4294967295 ECU_ADDRESS 0x70016DA4 /end MEASUREMENT
/begin MEASUREMENT dataJ1939Dm1Failrs_as[48].dtc_as[2].fmi_u8 "" UBYTE CnvRule_NumberOneToOne 1 0 0 255 ECU_ADDRESS 0x70016DA8 /end MEASUREMENT
/begin MEASUREMENT dataJ1939Dm1Failrs_as[48].dtc_as[2].occ_u8 "" UBYTE CnvRule_NumberOneToOne 1 0 0 255 ECU_ADDRESS 0x70016DA9 /end MEASUREMENT
/begin MEASUREMENT dataJ1939Dm1Failrs_as[48].dtc_as[3].spn_u32 "" ULONG CnvRule_NumberOneToOne 1 0 0 4294967295 ECU_ADDRESS 0x70016DAC /end MEASUREMENT
/begin MEASUREMENT dataJ1939Dm1Failrs_as[48].dtc_as[3].fmi_u8 "" UBYTE CnvRule_NumberOneToOne 1 0 0 255 ECU_ADDRESS 0x70016DB0 /end MEASUREMENT
/begin MEASUREMENT dataJ1939Dm1Failrs_as[48].dtc_as[3].occ_u8 "" UBYTE CnvRule_NumberOneToOne 1 0 0 255 ECU_ADDRESS 0x70016DB1 /end MEASUREMENT
/begin MEASUREMENT dataJ1939Dm1Failrs_as[48].dtc_as[4].spn_u32 "" ULONG CnvRule_NumberOneToOne 1 0 0 4294967295 ECU_ADDRESS 0x70016DB4 /end MEASUREMENT
/begin MEASUREMENT dataJ1939Dm1Failrs_as[48].dtc_as[4].fmi_u8 "" UBYTE CnvRule_NumberOneToOne 1 0 0 255 ECU_ADDRESS 0x70016DB8 /end MEASUREMENT
/begin MEASUREMENT dataJ1939Dm1Failrs_as[48].dtc_as[4].occ_u8 "" UBYTE CnvRule_NumberOneToOne 1 0 0 255 ECU_ADDRESS 0x70016DB9 /end MEASUREMENT
/begin MEASUREMENT dataJ1939Dm1Failrs_as[48].dtc_as[5].spn_u32 "" ULONG CnvRule_NumberOneToOne 1 0 0 4294967295 ECU_ADDRESS 0x70016DBC /end MEASUREMENT
/begin MEASUREMENT dataJ1939Dm1Failrs_as[48].dtc_as[5].fmi_u8 "" UBYTE CnvRule_NumberOneToOne 1 0 0 255 ECU_ADDRESS 0x70016DC0 /end MEASUREMENT
/begin MEASUREMENT dataJ1939Dm1Failrs_as[48].dtc_as[5].occ_u8 "" UBYTE CnvRule_NumberOneToOne 1 0 0 255 ECU_ADDRESS 0x70016DC1 /end MEASUREMENT
/begin MEASUREMENT dataJ1939Dm1Failrs_as[48].dtc_as[6].spn_u32 "" ULONG CnvRule_NumberOneToOne 1 0 0 4294967295 ECU_ADDRESS 0x70016DC4 /end MEASUREMENT
/begin MEASUREMENT dataJ1939Dm1Failrs_as[48].dtc_as[6].fmi_u8 "" UBYTE CnvRule_NumberOneToOne 1 0 0 255 ECU_ADDRESS 0x70016DC8 /end MEASUREMENT
/begin MEASUREMENT dataJ1939Dm1Failrs_as[48].dtc_as[6].occ_u8 "" UBYTE CnvRule_NumberOneToOne 1 0 0 255 ECU_ADDRESS 0x70016DC9 /end MEASUREMENT
/begin MEASUREMENT dataJ1939Dm1Failrs_as[48].dtc_as[7].spn_u32 "" ULONG CnvRule_NumberOneToOne 1 0 0 4294967295 ECU_ADDRESS 0x70016DCC /end MEASUREMENT
/begin MEASUREMENT dataJ1939Dm1Failrs_as[48].dtc_as[7].fmi_u8 "" UBYTE CnvRule_NumberOneToOne 1 0 0 255 ECU_ADDRESS 0x70016DD0 /end MEASUREMENT
/begin MEASUREMENT dataJ1939Dm1Failrs_as[48].dtc_as[7].occ_u8 "" UBYTE CnvRule_NumberOneToOne 1 0 0 255 ECU_ADDRESS 0x70016DD1 /end MEASUREMENT
/begin MEASUREMENT dataJ1939Dm1Failrs_as[48].dtc_as[8].spn_u32 "" ULONG CnvRule_NumberOneToOne 1 0 0 4294967295 ECU_ADDRESS 0x70016DD4 /end MEASUREMENT
/begin MEASUREMENT dataJ1939Dm1Failrs_as[48].dtc_as[8].fmi_u8 "" UBYTE CnvRule_NumberOneToOne 1 0 0 255 ECU_ADDRESS 0x70016DD8 /end MEASUREMENT
/begin MEASUREMENT dataJ1939Dm1Failrs_as[48].dtc_as[8].occ_u8 "" UBYTE CnvRule_NumberOneToOne 1 0 0 255 ECU_ADDRESS 0x70016DD9 /end MEASUREMENT
/begin MEASUREMENT dataJ1939Dm1Failrs_as[48].dtc_as[9].spn_u32 "" ULONG CnvRule_NumberOneToOne 1 0 0 4294967295 ECU_ADDRESS 0x70016DDC /end MEASUREMENT
/begin MEASUREMENT dataJ1939Dm1Failrs_as[48].dtc_as[9].fmi_u8 "" UBYTE CnvRule_NumberOneToOne 1 0 0 255 ECU_ADDRESS 0x70016DE0 /end MEASUREMENT
/begin MEASUREMENT dataJ1939Dm1Failrs_as[48].dtc_as[9].occ_u8 "" UBYTE CnvRule_NumberOneToOne 1 0 0 255 ECU_ADDRESS 0x70016DE1 /end MEASUREMENT
/begin MEASUREMENT dataJ1939Dm1Failrs_as[48].dtc_as[10].spn_u32 "" ULONG CnvRule_NumberOneToOne 1 0 0 4294967295 ECU_ADDRESS 0x70016DE4 /end MEASUREMENT
/begin MEASUREMENT dataJ1939Dm1Failrs_as[48].dtc_as[10].fmi_u8 "" UBYTE CnvRule_NumberOneToOne 1 0 0 255 ECU_ADDRESS 0x70016DE8 /end MEASUREMENT
/begin MEASUREMENT dataJ1939Dm1Failrs_as[48].dtc_as[10].occ_u8 "" UBYTE CnvRule_NumberOneToOne 1 0 0 255 ECU_ADDRESS 0x70016DE9 /end MEASUREMENT
/begin MEASUREMENT dataJ1939Dm1Failrs_as[48].dtc_as[11].spn_u32 "" ULONG CnvRule_NumberOneToOne 1 0 0 4294967295 ECU_ADDRESS 0x70016DEC /end MEASUREMENT
/begin MEASUREMENT dataJ1939Dm1Failrs_as[48].dtc_as[11].fmi_u8 "" UBYTE CnvRule_NumberOneToOne 1 0 0 255 ECU_ADDRESS 0x70016DF0 /end MEASUREMENT
/begin MEASUREMENT dataJ1939Dm1Failrs_as[48].dtc_as[11].occ_u8 "" UBYTE CnvRule_NumberOneToOne 1 0 0 255 ECU_ADDRESS 0x70016DF1 /end MEASUREMENT
/begin MEASUREMENT dataJ1939Dm1Failrs_as[48].dtc_as[12].spn_u32 "" ULONG CnvRule_NumberOneToOne 1 0 0 4294967295 ECU_ADDRESS 0x70016DF4 /end MEASUREMENT
/begin MEASUREMENT dataJ1939Dm1Failrs_as[48].dtc_as[12].fmi_u8 "" UBYTE CnvRule_NumberOneToOne 1 0 0 255 ECU_ADDRESS 0x70016DF8 /end MEASUREMENT
/begin MEASUREMENT dataJ1939Dm1Failrs_as[48].dtc_as[12].occ_u8 "" UBYTE CnvRule_NumberOneToOne 1 0 0 255 ECU_ADDRESS 0x70016DF9 /end MEASUREMENT
/begin MEASUREMENT dataJ1939Dm1Failrs_as[48].dtc_as[13].spn_u32 "" ULONG CnvRule_NumberOneToOne 1 0 0 4294967295 ECU_ADDRESS 0x70016DFC /end MEASUREMENT
/begin MEASUREMENT dataJ1939Dm1Failrs_as[48].dtc_as[13].fmi_u8 "" UBYTE CnvRule_NumberOneToOne 1 0 0 255 ECU_ADDRESS 0x70016E00 /end MEASUREMENT
/begin MEASUREMENT dataJ1939Dm1Failrs_as[48].dtc_as[13].occ_u8 "" UBYTE CnvRule_NumberOneToOne 1 0 0 255 ECU_ADDRESS 0x70016E01 /end MEASUREMENT
/begin MEASUREMENT dataJ1939Dm1Failrs_as[48].dtc_as[14].spn_u32 "" ULONG CnvRule_NumberOneToOne 1 0 0 4294967295 ECU_ADDRESS 0x70016E04 /end MEASUREMENT
/begin MEASUREMENT dataJ1939Dm1Failrs_as[48].dtc_as[14].fmi_u8 "" UBYTE CnvRule_NumberOneToOne 1 0 0 255 ECU_ADDRESS 0x70016E08 /end MEASUREMENT
/begin MEASUREMENT dataJ1939Dm1Failrs_as[48].dtc_as[14].occ_u8 "" UBYTE CnvRule_NumberOneToOne 1 0 0 255 ECU_ADDRESS 0x70016E09 /end MEASUREMENT
/begin MEASUREMENT dataJ1939Dm1Failrs_as[48].dtc_as[15].spn_u32 "" ULONG CnvRule_NumberOneToOne 1 0 0 4294967295 ECU_ADDRESS 0x70016E0C /end MEASUREMENT
/begin MEASUREMENT dataJ1939Dm1Failrs_as[48].dtc_as[15].fmi_u8 "" UBYTE CnvRule_NumberOneToOne 1 0 0 255 ECU_ADDRESS 0x70016E10 /end MEASUREMENT
/begin MEASUREMENT dataJ1939Dm1Failrs_as[48].dtc_as[15].occ_u8 "" UBYTE CnvRule_NumberOneToOne 1 0 0 255 ECU_ADDRESS 0x70016E11 /end MEASUREMENT
/begin MEASUREMENT dataJ1939Dm1Failrs_as[48].dtc_as[16].spn_u32 "" ULONG CnvRule_NumberOneToOne 1 0 0 4294967295 ECU_ADDRESS 0x70016E14 /end MEASUREMENT
/begin MEASUREMENT dataJ1939Dm1Failrs_as[48].dtc_as[16].fmi_u8 "" UBYTE CnvRule_NumberOneToOne 1 0 0 255 ECU_ADDRESS 0x70016E18 /end MEASUREMENT
/begin MEASUREMENT dataJ1939Dm1Failrs_as[48].dtc_as[16].occ_u8 "" UBYTE CnvRule_NumberOneToOne 1 0 0 255 ECU_ADDRESS 0x70016E19 /end MEASUREMENT
/begin MEASUREMENT dataJ1939Dm1Failrs_as[48].dtc_as[17].spn_u32 "" ULONG CnvRule_NumberOneToOne 1 0 0 4294967295 ECU_ADDRESS 0x70016E1C /end MEASUREMENT
/begin MEASUREMENT dataJ1939Dm1Failrs_as[48].dtc_as[17].fmi_u8 "" UBYTE CnvRule_NumberOneToOne 1 0 0 255 ECU_ADDRESS 0x70016E20 /end MEASUREMENT
/begin MEASUREMENT dataJ1939Dm1Failrs_as[48].dtc_as[17].occ_u8 "" UBYTE CnvRule_NumberOneToOne 1 0 0 255 ECU_ADDRESS 0x70016E21 /end MEASUREMENT
/begin MEASUREMENT dataJ1939Dm1Failrs_as[48].dtc_as[18].spn_u32 "" ULONG CnvRule_NumberOneToOne 1 0 0 4294967295 ECU_ADDRESS 0x70016E24 /end MEASUREMENT
/begin MEASUREMENT dataJ1939Dm1Failrs_as[48].dtc_as[18].fmi_u8 "" UBYTE CnvRule_NumberOneToOne 1 0 0 255 ECU_ADDRESS 0x70016E28 /end MEASUREMENT
/begin MEASUREMENT dataJ1939Dm1Failrs_as[48].dtc_as[18].occ_u8 "" UBYTE CnvRule_NumberOneToOne 1 0 0 255 ECU_ADDRESS 0x70016E29 /end MEASUREMENT
/begin MEASUREMENT dataJ1939Dm1Failrs_as[48].dtc_as[19].spn_u32 "" ULONG CnvRule_NumberOneToOne 1 0 0 4294967295 ECU_ADDRESS 0x70016E2C /end MEASUREMENT
/begin MEASUREMENT dataJ1939Dm1Failrs_as[48].dtc_as[19].fmi_u8 "" UBYTE CnvRule_NumberOneToOne 1 0 0 255 ECU_ADDRESS 0x70016E30 /end MEASUREMENT
/begin MEASUREMENT dataJ1939Dm1Failrs_as[48].dtc_as[19].occ_u8 "" UBYTE CnvRule_NumberOneToOne 1 0 0 255 ECU_ADDRESS 0x70016E31 /end MEASUREMENT
/begin MEASUREMENT dataJ1939Dm1Failrs_as[48].dtc_as[20].spn_u32 "" ULONG CnvRule_NumberOneToOne 1 0 0 4294967295 ECU_ADDRESS 0x70016E34 /end MEASUREMENT
/begin MEASUREMENT dataJ1939Dm1Failrs_as[48].dtc_as[20].fmi_u8 "" UBYTE CnvRule_NumberOneToOne 1 0 0 255 ECU_ADDRESS 0x70016E38 /end MEASUREMENT
/begin MEASUREMENT dataJ1939Dm1Failrs_as[48].dtc_as[20].occ_u8 "" UBYTE CnvRule_NumberOneToOne 1 0 0 255 ECU_ADDRESS 0x70016E39 /end MEASUREMENT
/begin MEASUREMENT dataJ1939Dm1Failrs_as[48].dtc_as "" UBYTE CnvRule_NumberOneToOne 1 0 0 255 ECU_ADDRESS 0x70016D9C ARRAY_SIZE 160 /end MEASUREMENT
/begin MEASUREMENT dataJ1939Dm1Failrs_as[49].dtc_as[1].spn_u32 "" ULONG CnvRule_NumberOneToOne 1 0 0 4294967295 ECU_ADDRESS 0x70016E40 /end MEASUREMENT
/begin MEASUREMENT dataJ1939Dm1Failrs_as[49].dtc_as[1].fmi_u8 "" UBYTE CnvRule_NumberOneToOne 1 0 0 255 ECU_ADDRESS 0x70016E44 /end MEASUREMENT
/begin MEASUREMENT dataJ1939Dm1Failrs_as[49].dtc_as[1].occ_u8 "" UBYTE CnvRule_NumberOneToOne 1 0 0 255 ECU_ADDRESS 0x70016E45 /end MEASUREMENT
/begin MEASUREMENT dataJ1939Dm1Failrs_as[49].dtc_as[2].spn_u32 "" ULONG CnvRule_NumberOneToOne 1 0 0 4294967295 ECU_ADDRESS 0x70016E48 /end MEASUREMENT
/begin MEASUREMENT dataJ1939Dm1Failrs_as[49].dtc_as[2].fmi_u8 "" UBYTE CnvRule_NumberOneToOne 1 0 0 255 ECU_ADDRESS 0x70016E4C /end MEASUREMENT
/begin MEASUREMENT dataJ1939Dm1Failrs_as[49].dtc_as[2].occ_u8 "" UBYTE CnvRule_NumberOneToOne 1 0 0 255 ECU_ADDRESS 0x70016E4D /end MEASUREMENT
/begin MEASUREMENT dataJ1939Dm1Failrs_as[49].dtc_as[3].spn_u32 "" ULONG CnvRule_NumberOneToOne 1 0 0 4294967295 ECU_ADDRESS 0x70016E50 /end MEASUREMENT
/begin MEASUREMENT dataJ1939Dm1Failrs_as[49].dtc_as[3].fmi_u8 "" UBYTE CnvRule_NumberOneToOne 1 0 0 255 ECU_ADDRESS 0x70016E54 /end MEASUREMENT
/begin MEASUREMENT dataJ1939Dm1Failrs_as[49].dtc_as[3].occ_u8 "" UBYTE CnvRule_NumberOneToOne 1 0 0 255 ECU_ADDRESS 0x70016E55 /end MEASUREMENT
/begin MEASUREMENT dataJ1939Dm1Failrs_as[49].dtc_as[4].spn_u32 "" ULONG CnvRule_NumberOneToOne 1 0 0 4294967295 ECU_ADDRESS 0x70016E58 /end MEASUREMENT
/begin MEASUREMENT dataJ1939Dm1Failrs_as[49].dtc_as[4].fmi_u8 "" UBYTE CnvRule_NumberOneToOne 1 0 0 255 ECU_ADDRESS 0x70016E5C /end MEASUREMENT
/begin MEASUREMENT dataJ1939Dm1Failrs_as[49].dtc_as[4].occ_u8 "" UBYTE CnvRule_NumberOneToOne 1 0 0 255 ECU_ADDRESS 0x70016E5D /end MEASUREMENT
/begin MEASUREMENT dataJ1939Dm1Failrs_as[49].dtc_as[5].spn_u32 "" ULONG CnvRule_NumberOneToOne 1 0 0 4294967295 ECU_ADDRESS 0x70016E60 /end MEASUREMENT
/begin MEASUREMENT dataJ1939Dm1Failrs_as[49].dtc_as[5].fmi_u8 "" UBYTE CnvRule_NumberOneToOne 1 0 0 255 ECU_ADDRESS 0x70016E64 /end MEASUREMENT
/begin MEASUREMENT dataJ1939Dm1Failrs_as[49].dtc_as[5].occ_u8 "" UBYTE CnvRule_NumberOneToOne 1 0 0 255 ECU_ADDRESS 0x70016E65 /end MEASUREMENT
/begin MEASUREMENT dataJ1939Dm1Failrs_as[49].dtc_as[6].spn_u32 "" ULONG CnvRule_NumberOneToOne 1 0 0 4294967295 ECU_ADDRESS 0x70016E68 /end MEASUREMENT
/begin MEASUREMENT dataJ1939Dm1Failrs_as[49].dtc_as[6].fmi_u8 "" UBYTE CnvRule_NumberOneToOne 1 0 0 255 ECU_ADDRESS 0x70016E6C /end MEASUREMENT
/begin MEASUREMENT dataJ1939Dm1Failrs_as[49].dtc_as[6].occ_u8 "" UBYTE CnvRule_NumberOneToOne 1 0 0 255 ECU_ADDRESS 0x70016E6D /end MEASUREMENT
/begin MEASUREMENT dataJ1939Dm1Failrs_as[49].dtc_as[7].spn_u32 "" ULONG CnvRule_NumberOneToOne 1 0 0 4294967295 ECU_ADDRESS 0x70016E70 /end MEASUREMENT
/begin MEASUREMENT dataJ1939Dm1Failrs_as[49].dtc_as[7].fmi_u8 "" UBYTE CnvRule_NumberOneToOne 1 0 0 255 ECU_ADDRESS 0x70016E74 /end MEASUREMENT
/begin MEASUREMENT dataJ1939Dm1Failrs_as[49].dtc_as[7].occ_u8 "" UBYTE CnvRule_NumberOneToOne 1 0 0 255 ECU_ADDRESS 0x70016E75 /end MEASUREMENT
/begin MEASUREMENT dataJ1939Dm1Failrs_as[49].dtc_as[8].spn_u32 "" ULONG CnvRule_NumberOneToOne 1 0 0 4294967295 ECU_ADDRESS 0x70016E78 /end MEASUREMENT
/begin MEASUREMENT dataJ1939Dm1Failrs_as[49].dtc_as[8].fmi_u8 "" UBYTE CnvRule_NumberOneToOne 1 0 0 255 ECU_ADDRESS 0x70016E7C /end MEASUREMENT
/begin MEASUREMENT dataJ1939Dm1Failrs_as[49].dtc_as[8].occ_u8 "" UBYTE CnvRule_NumberOneToOne 1 0 0 255 ECU_ADDRESS 0x70016E7D /end MEASUREMENT
/begin MEASUREMENT dataJ1939Dm1Failrs_as[49].dtc_as[9].spn_u32 "" ULONG CnvRule_NumberOneToOne 1 0 0 4294967295 ECU_ADDRESS 0x70016E80 /end MEASUREMENT
/begin MEASUREMENT dataJ1939Dm1Failrs_as[49].dtc_as[9].fmi_u8 "" UBYTE CnvRule_NumberOneToOne 1 0 0 255 ECU_ADDRESS 0x70016E84 /end MEASUREMENT
/begin MEASUREMENT dataJ1939Dm1Failrs_as[49].dtc_as[9].occ_u8 "" UBYTE CnvRule_NumberOneToOne 1 0 0 255 ECU_ADDRESS 0x70016E85 /end MEASUREMENT
/begin MEASUREMENT dataJ1939Dm1Failrs_as[49].dtc_as[10].spn_u32 "" ULONG CnvRule_NumberOneToOne 1 0 0 4294967295 ECU_ADDRESS 0x70016E88 /end MEASUREMENT
/begin MEASUREMENT dataJ1939Dm1Failrs_as[49].dtc_as[10].fmi_u8 "" UBYTE CnvRule_NumberOneToOne 1 0 0 255 ECU_ADDRESS 0x70016E8C /end MEASUREMENT
/begin MEASUREMENT dataJ1939Dm1Failrs_as[49].dtc_as[10].occ_u8 "" UBYTE CnvRule_NumberOneToOne 1 0 0 255 ECU_ADDRESS 0x70016E8D /end MEASUREMENT
/begin MEASUREMENT dataJ1939Dm1Failrs_as[49].dtc_as[11].spn_u32 "" ULONG CnvRule_NumberOneToOne 1 0 0 4294967295 ECU_ADDRESS 0x70016E90 /end MEASUREMENT
/begin MEASUREMENT dataJ1939Dm1Failrs_as[49].dtc_as[11].fmi_u8 "" UBYTE CnvRule_NumberOneToOne 1 0 0 255 ECU_ADDRESS 0x70016E94 /end MEASUREMENT
/begin MEASUREMENT dataJ1939Dm1Failrs_as[49].dtc_as[11].occ_u8 "" UBYTE CnvRule_NumberOneToOne 1 0 0 255 ECU_ADDRESS 0x70016E95 /end MEASUREMENT
/begin MEASUREMENT dataJ1939Dm1Failrs_as[49].dtc_as[12].spn_u32 "" ULONG CnvRule_NumberOneToOne 1 0 0 4294967295 ECU_ADDRESS 0x70016E98 /end MEASUREMENT
/begin MEASUREMENT dataJ1939Dm1Failrs_as[49].dtc_as[12].fmi_u8 "" UBYTE CnvRule_NumberOneToOne 1 0 0 255 ECU_ADDRESS 0x70016E9C /end MEASUREMENT
/begin MEASUREMENT dataJ1939Dm1Failrs_as[49].dtc_as[12].occ_u8 "" UBYTE CnvRule_NumberOneToOne 1 0 0 255 ECU_ADDRESS 0x70016E9D /end MEASUREMENT
/begin MEASUREMENT dataJ1939Dm1Failrs_as[49].dtc_as[13].spn_u32 "" ULONG CnvRule_NumberOneToOne 1 0 0 4294967295 ECU_ADDRESS 0x70016EA0 /end MEASUREMENT
/begin MEASUREMENT dataJ1939Dm1Failrs_as[49].dtc_as[13].fmi_u8 "" UBYTE CnvRule_NumberOneToOne 1 0 0 255 ECU_ADDRESS 0x70016EA4 /end MEASUREMENT
/begin COMPU_METHOD CnvRule_NumberOneToOne "This is a predefined standard conversion rule for signals representing a number with a 1:1 conversion (*nr*_*)." IDENTICAL "%.0" "-" /end COMPU_METHOD
